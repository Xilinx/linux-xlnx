## drivers/staging/xilinx-tsn/Kconfig
```kconfig
# SPDX-License-Identifier: GPL-2.0-only
#
# Xilinx device configuration
#

if NET_VENDOR_XILINX

config XILINX_TSN
	tristate "Enable Xilinx's TSN IP"
	select PHYLIB
	help
	  Enable Xilinx's TSN IP.

	  If built as a module (m) or static (y), then all its submodules
	  follow the same build mode.

if XILINX_TSN
config AXIENET_HAS_TADMA
	bool "AxiEthernet is configured with TADMA"
	depends on XILINX_TSN
	help
	  When hardware is generated with Axi Ethernet with TADMA select this option.
	  This driver enables Time Aware DMA to support TSN Qbv clause accurately.
	  It is used to fetch schedule traffic.
	  It contains one queue.

	  If XILINX_TSN is built as a module (m) or static (y), then this
	  submodule follows the same build mode.

config XILINX_TSN_PTP
	bool "Generate hardware packet timestamps using Xilinx's TSN IP"
	depends on XILINX_TSN && PTP_1588_CLOCK
	default XILINX_TSN
	help
	  Generate hardware packet timestamps. This is to facilitate IEEE 1588.

	  If XILINX_TSN is built as a module (m) or static (y), then this
	  submodule follows the same build mode.

config XILINX_TSN_QBV
	bool "Support Qbv protocol in TSN"
	depends on XILINX_TSN_PTP
	default XILINX_TSN
	help
	  Enables TSN Qbv protocol.

	  If XILINX_TSN is built as a module (m) or static (y), then this
	  submodule follows the same build mode.

config XILINX_TSN_SWITCH
	bool "Support TSN switch"
	depends on XILINX_TSN && NET_SWITCHDEV
	default XILINX_TSN
	help
	  Enable Xilinx's TSN Switch support.

	  If XILINX_TSN is built as a module (m) or static (y), then this
	  submodule follows the same build mode.

config XILINX_TSN_QCI
	bool "Support Qci protocol in TSN"
	depends on XILINX_TSN_SWITCH
	default XILINX_TSN
	help
	  Enable TSN QCI protocol.

	  If XILINX_TSN is built as a module (m) or static (y), then this
	  submodule follows the same build mode.

config XILINX_TSN_CB
	bool "Support CB protocol in TSN"
	depends on XILINX_TSN_SWITCH
	default XILINX_TSN
	help
	  Enable TSN CB protocol support.

	  If XILINX_TSN is built as a module (m) or static (y), then this
	  submodule follows the same build mode.

config XILINX_TSN_QBR
	bool "Support QBR protocol in TSN"
	depends on XILINX_TSN_SWITCH
	default XILINX_TSN
	help
	  Enable TSN QBR protocol support.

	  If XILINX_TSN is built as a module (m) or static (y), then this
	  submodule follows the same build mode.

endif #XILINX_TSN
endif # NET_VENDOR_XILINX
```

## drivers/staging/xilinx/Kconfig
```kconfig
if STAGING

source "drivers/staging/xilinx/hdmi/Kconfig"

source "drivers/staging/xilinx/clk/Kconfig"

source "drivers/staging/xilinx/misc/Kconfig"

source "drivers/staging/xilinx/xvmixer/Kconfig"

endif # STAGING
```

## drivers/staging/xilinx/clk/Kconfig
```kconfig
config COMMON_CLK_SI5324
	tristate "Clock driver for SiLabs 5324"
	depends on I2C && COMMON_CLK
	select REGMAP_I2C
	select RATIONAL
	---help---
	  This driver supports the Silicon Labs 5324 jitter attenuating clock
	  multiplier.
```

## drivers/staging/xilinx/hdmi/Kconfig
```kconfig
config VIDEO_XILINX_HDMI_RX
	tristate "Xilinx HDMI RX V4L2"
	depends on VIDEO_XILINX
	select PHY_XILINX_VPHY 
	---help---
	   V4L2 driver for the Xilinx HDMI RX Subsystem IP.

config DRM_XILINX_HDMI
	tristate "Xilinx DRM HDMI Driver"
	depends on DRM_XILINX
	select PHY_XILINX_VPHY
	help
	  DRM driver for the Xilinx HDMI TX Subsystem IP.

config PHY_XILINX_VPHY
	tristate "Xilinx Video PHY driver"
	depends on ARCH_ZYNQMP
	select GENERIC_PHY
	help
	  Enable this to support the Video PHY for HDMI.
```

## drivers/staging/xilinx/misc/Kconfig
```kconfig
config RETIMER_DP159
        tristate "Texas Instruments DP159 Redriver/retimer"
        depends on COMMON_CLK && I2C
        ---help---
         Support for the Texas Instruments DP159 Redriver/retimer.

         To compile this driver as a module, choose M here: the
         module will be called dp159.
```

## drivers/staging/xilinx/xvmixer/Kconfig
```kconfig
config DRM_XILINX_XVMIXER
	tristate "Xilinx DRM Video Mixer"
	depends on DRM && HAVE_CLK
	select DRM_KMS_HELPER
	select DRM_KMS_CMA_HELPER
	select DRM_GEM_CMA_HELPER
	select DMA_ENGINE
	select XILINX_FRMBUF
	default y
	help
		DRM display driver for the Xilinx Video Mixer IP
```

## drivers/staging/xilinx_hdcp/Kconfig
```kconfig
config XILINX_HDCP_COMMON
	bool
	help
	  This driver supports HDCP 1x/2x common functionalities for
	  Xilinx devices

	  This code will be compiled by selection from the interface
	  drivers (DisplayPort/HDMI) of Xilinx.
```

## drivers/staging/xlnx-mmi-dptx/Kconfig
```kconfig
config DRM_AMD_MMI_DPTX
	tristate "AMD Multimedia Integrated DisplayPort Tx driver"
	depends on DRM && OF
	select DRM_DISPLAY_DP_HELPER
	select DRM_DISPLAY_HELPER
	select DRM_KMS_HELPER
	help
	  Enable driver support for AMD Multimedia Integrated DisplayPort Tx.
	  It is implemented as a bridge driver to be connected to AMD
	  Multimedia Integrated Display Controller CRTC driver.
	  Use this option if you plan to use the built in DisplayPort
	  in Versal Gen 2 devices.
```

## drivers/staging/xlnx_ctrl_driver/Kconfig
```kconfig
config XLNX_CTRL_FRMBUF
	tristate "FB Control driver"
	help
	  This driver is to support Xilinx Framebuffer read and write IP. This
	  driver is simple control plane driver which is controlled by ioctls
	  from userspace. It is free from any other media framework like V4l2 or
	  DRM hence, doesn't need to adhere to V4L2 or DRM.

config XLNX_CTRL_VPSS
	tristate "VPSS Control driver"
	help
	  This driver is to support Xilinx VPSS IP. This driver is simple
	  control plane driver which is controlled by ioctls from userspace. It
	  is free from any media framework like V4l2 or DRM hence, doesn't need
	  to adhere to V4L2 or DRM.
```

## drivers/staging/xlnx_ernic/Kconfig
```kconfig
config ERNIC
       tristate "Xilinx ERNIC driver"
       help
         Driver for the XILINX Embedded Remote DMA(RDMA) Enabled NIC.
```

## drivers/staging/xlnx_hdcp1x/Kconfig
```kconfig
config XLNX_HDCP1X_CIPHER
	bool
	help
	  This code is developed for hdcp1x cipher functionality of
	  xilinx hdcp1x IP.

	  This code will be compiled by selection from the interface
	  drivers (DP/HDMI) of xilinx.
```

## drivers/staging/xlnx_tsmux/Kconfig
```kconfig
config XLNX_TSMUX
	tristate "Xilinx MPEG2 Transport Stream Muxer"
	select DMA_SHARED_BUFFER
	help
	  This driver is developed for mpeg2 transport stream muxer,
	  designed to allow passage of multimedia streams from the source
	  kernel sub-system, prepares mpeg2 transport stream and forward
	  to the sink kernel subsystem.

	  To compile this driver as a module, choose M here.
	  If unsure, choose N.
```

## drivers/staging/xlnxsync/Kconfig
```kconfig
config XLNX_SYNC
	tristate "Xilinx Synchronizer"
	depends on ARCH_ZYNQMP
	help
	  This driver is developed for Xilinx Synchronizer IP. It is used to
	  monitor the AXI addresses of the producer and initiate the
	  consumer to start earlier, thereby reducing the latency to process
	  the data.

	  To compile this driver as a module, choose M here.
	  If unsure, choose N
```

## drivers/staging/xroeframer/Kconfig
```kconfig
#
# Xilinx Radio over Ethernet Framer driver
#

config XROE_FRAMER
	tristate "Xilinx Radio over Ethernet Framer driver"
	---help---
	  The "Radio Over Ethernet Framer" IP (roe_framer) ingests/generates
	  Ethernet packet data, (de-)multiplexes packets based on protocol
	  into/from various Radio Antenna data streams.

	  It has 2 main, independent, data paths:

	  - Downlink, from the BaseBand to the Phone, Ethernet to Antenna,
	  we call this the De-Framer path, or defm on all related IP signals.

	  - Uplink, from the Phone to the BaseBand, Antenna to Ethernet,
	  we call this the Framer path, or fram on all related IP signals.
```

## drivers/staging/xroetrafficgen/Kconfig
```kconfig
# SPDX-License-Identifier: GPL-2.0

#
# Xilinx Radio over Ethernet Traffic Generator driver
#

config XROE_TRAFFIC_GEN
	tristate "Xilinx Radio over Ethernet Traffic Generator driver"
	help
	  The Traffic Generator is used for in testing of other RoE IP Blocks
	  (currenty the XRoE Framer) and simulates an radio antenna interface.
	  It generates rolling rampdata for eCPRI antenna paths.
	  Each path is tagged with the antenna number. The sink locks to this
	  ramp data, then checks the next value is as expected.
```

## drivers/video/xylon/xylonfb/Kconfig
```kconfig
menuconfig FB_XYLON
	tristate "Xylon logiCVC frame buffer support"
	depends on FB
	default n
	select FB_CFB_FILLRECT
	select FB_CFB_COPYAREA
	select FB_CFB_IMAGEBLIT
	help
	  Choose this option if you want to use the Xylon logiCVC as frame
	  buffer device. Without the support of PCI & AGP.

choice
	prompt "Xylon frame buffer driver type"
	depends on FB_XYLON
	default FB_XYLON_PLATFORM

config FB_XYLON_PLATFORM
	bool "Xylon logiCVC frame buffer platform driver"
	help
	  Choose this option if you want to use the Xylon frame buffer driver
	  as platform driver type. This is usefull if OpenFirmware support is
	  not compiled in the kernel.
	  This is default selection.

config FB_XYLON_OF
	bool "Xylon logiCVC frame buffer Open Firmware driver"
	help
	  Choose this option if you want to use the Xylon frame buffer driver
	  as Open Firmware driver type. Driver reads hardware configuration
	  from Device Tree Blob binary file which must be loaded to
	  system memory.
endchoice

config FB_XYLON_PIXCLK
	bool "Xylon logiCVC pixel clock"
	depends on FB_XYLON
	default n
	help
	  logiCVC pixel clock generated from:
	  - External generator not controllable by Xylon framebuffer driver
	    This is default selection.
	  - Generators controllable by Xylon framebuffer driver

config FB_XYLON_PIXCLK_ZYNQ_PS
	bool "Zynq PS PLL pixel clock generator"
	depends on FB_XYLON && FB_XYLON_PIXCLK
	default n
	help
	  Support for controlling pixel clock generation from
	  Zynq-PS internal PLL clock generator.

config FB_XYLON_PIXCLK_LOGICLK
	bool "Xylon logiCLK pixel clock generator"
	depends on FB_XYLON && FB_XYLON_PIXCLK
	default n
	help
	  Support for controlling pixel clock generation from
	  Xylon logiCLK FGPA IP core.

config FB_XYLON_PIXCLK_SI570
	bool "SI570 pixel clock generator"
	depends on FB_XYLON && FB_XYLON_PIXCLK
	default n
	select SYSFS
	select I2C
	select MISC_DEVICES
	select SI570
	help
	  Support for controlling pixel clock generation from
	  SI570 clock generator.

menuconfig FB_XYLON_MISC
	bool "Xylon logiCVC frame buffer miscellaneous support"
	depends on FB_XYLON
	default n
	help
	  Choose this option if you want to use the Xylon logiCVC with
	  miscellaneous device functionality for various improvements.
	  Currently supported:
	  - ADV7511 HDMI transmitter

config FB_XYLON_MISC_ADV7511
	bool "Xylon logiCVC frame buffer ADV7511"
	depends on FB_XYLON_MISC && VIDEO_ADV7511
	select FB_MODE_HELPERS
	default n
	---help---
	  Support for ADV7511 HDMI transmitter so that logiCVC can be configured
	  with parameters read from monitor EDID.
```

## drivers/xilinx_common/Kconfig
```kconfig
config XILINX_EDK
	bool
	depends on XILINX_VIRTEX || MICROBLAZE
	default y

config XILINX_LLDMA_USE_DCR
	bool
	depends on NEED_XILINX_LLDMA
	default XILINX_VIRTEX_5_FXT


#
# Xilinx devices and common device driver infrastructure
#

config XILINX_DRIVERS
	bool
	depends on PPC32 || MICROBLAZE
	default y
	---help---
	  This option is used to enable all of the Xilinx drivers on
	  supported architectures.  This is often useful if you have a
	  Xilinx FPGA in a system, either using embedded processors
	  internal to the FPGA or external processors.

config NEED_XILINX_DMAV3
	bool

config NEED_XILINX_LLDMA
	bool

config NEED_XILINX_IPIF
	bool
```

## sound/soc/xilinx/Kconfig
```kconfig
config SND_SOC_XILINX_DP
	tristate "Audio support for the the Xilinx DisplayPort"
	select SND_DMAENGINE_PCM
	select SND_SOC_GENERIC_DMAENGINE_PCM
	help
	  Audio support the for Xilinx DisplayPort.

config SND_SOC_XILINX_AUDIO_FORMATTER
	tristate "Audio support for the the Xilinx audio formatter"
	help
	  Select this option to enable Xilinx audio formatter
	  support. This provides PCM platform device support for
	  audio functionality.

config SND_SOC_XILINX_SDI
	tristate "Audio support for the the Xilinx SDI"
	depends on DRM_XLNX_SDI
	depends on VIDEO_XILINX_SDIRXSS
	help
	  Select this option to enable Xilinx SDI Audio.This enables
	  SDI audio playback and capture using xilinx soft IP

config SND_SOC_XILINX_I2S
	tristate "Audio support for the the Xilinx I2S"
	help
	  Select this option to enable Xilinx I2S Audio. This enables
	  I2S playback and capture using xilinx soft IP. In transmitter
	  mode, IP receives audio in AES format, extracts PCM and sends
	  PCM data. In receiver mode, IP receives PCM audio and
	  encapsulates PCM in AES format and sends AES data.
	  I2S playback and capture using xilinx soft IP

config SND_SOC_XILINX_SPDIF
	tristate "Audio support for the the Xilinx SPDIF"
	help
	  Select this option to enable Xilinx SPDIF Audio.
	  Enabling this provides one of the component required in ASoC
	  audio pipeline.
	  This supports playback and capture usecases.

config SND_SOC_XILINX_PL_SND_CARD
	tristate "Audio support for the the Xilinx PL sound card"
	depends on SND_SOC_XILINX_AUDIO_FORMATTER
	depends on SND_SOC_XILINX_I2S
	depends on SND_SOC_XILINX_SDI
	select SND_SOC_HDMI_CODEC
	help
	  Select this option to enable Xilinx PL sound card
	  support. This enables sound card using xilinx soft IPs
	  in audio pipeline.
```
