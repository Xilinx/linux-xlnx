## drivers/net/ethernet/xilinx/Kconfig
```kconfig
# SPDX-License-Identifier: GPL-2.0-only
#
# Xilinx device configuration
#

config NET_VENDOR_XILINX
	bool "Xilinx devices"
	default y
	help
	  If you have a network (Ethernet) card belonging to this class, say Y.

	  Note that the answer to this question doesn't directly affect the
	  kernel: saying N will just cause the configurator to skip all
	  the questions about Xilinx devices. If you say Y, you will be asked
	  for your specific card in the following questions.

if NET_VENDOR_XILINX

config XILINX_EMACLITE
	tristate "Xilinx 10/100 Ethernet Lite support"
	depends on HAS_IOMEM
	select PHYLIB
	help
	  This driver supports the 10/100 Ethernet Lite from Xilinx.

config XILINX_AXI_EMAC
	tristate "Xilinx 10/100/1000 AXI Ethernet support"
	depends on HAS_IOMEM
	select PHYLIB
	help
	  This driver supports the 10/100/1000 Ethernet from Xilinx for the
	  AXI bus interface used in Xilinx Virtex FPGAs and Soc's.

config XILINX_AXI_EMAC_HWTSTAMP
	bool "Generate hardware packet timestamps"
	depends on XILINX_AXI_EMAC
	select PTP_1588_CLOCK
	help
	  Generate hardware packet timestamps. This is to facilitate IEEE 1588.

config AXIENET_HAS_MCDMA
	bool "AXI Ethernet is configured with MCDMA"
	depends on XILINX_AXI_EMAC
	help
	  When hardware is generated with AXI Ethernet with MCDMA select this option.

config AXIENET_HAS_TADMA
	bool "AxiEthernet is configured with TADMA"
	depends on XILINX_TSN
	help
	  When hardware is generated with Axi Ethernet with TADMA select this option.
	  This driver enables Time Aware DMA to support TSN Qbv clause accurately.
	  It is used to fetch schedule traffic.
	  It contains one queue.

config XILINX_LL_TEMAC
	tristate "Xilinx LL TEMAC (LocalLink Tri-mode Ethernet MAC) driver"
	depends on HAS_IOMEM
	select PHYLIB
	help
	  This driver supports the Xilinx 10/100/1000 LocalLink TEMAC
	  core used in Xilinx Spartan and Virtex FPGAs

config XILINX_TSN
	bool "Enable Xilinx's TSN IP"
	select XILINX_AXI_EMAC
	help
	  Enable Xilinx's TSN IP.

config XILINX_TSN_PTP
	bool "Generate hardware packet timestamps using Xilinx's TSN IP"
	depends on XILINX_TSN
	select PTP_1588_CLOCK
	default y
	help
	  Generate hardware packet timestamps. This is to facilitate IEEE 1588.

config XILINX_TSN_QBV
	bool "Support Qbv protocol in TSN"
	depends on XILINX_TSN_PTP
	select PTP_1588_CLOCK
	default y
	help
	  Enables TSN Qbv protocol.

config XILINX_TSN_SWITCH
	bool "Support TSN switch"
	depends on XILINX_TSN
	default y
	help
	  Enable Xilinx's TSN Switch support.

config XILINX_TSN_QCI
	bool "Support Qci protocol in TSN"
	depends on XILINX_TSN_SWITCH
	default y
	help
	  Enable TSN QCI protocol.

config XILINX_TSN_CB
	bool "Support CB protocol in TSN"
	depends on XILINX_TSN_SWITCH
	default y
	help
	  Enable TSN CB protocol support.

config XILINX_TSN_QBR
       bool "Support QBR protocol in TSN"
       depends on XILINX_TSN_SWITCH
       default y
       help
         Enable TSN QBR protocol support.

endif # NET_VENDOR_XILINX
```

## drivers/phy/xilinx/Kconfig
```kconfig
# SPDX-License-Identifier: GPL-2.0-only

#
# PHY drivers for Xilinx platforms
#

config PHY_XILINX_ZYNQMP
	tristate "Xilinx ZynqMP PHY driver"
	depends on ARCH_ZYNQMP || COMPILE_TEST
	select GENERIC_PHY
	help
	  Enable this to support ZynqMP High Speed Gigabit Transceiver
	  that is part of ZynqMP SoC.

config PHY_XILINX_HDMIPHY
	tristate "Xilinx HDMI PHY driver"
	depends on ARCH_ZYNQMP
	select GENERIC_PHY
	help
	  Enable this to support HDMI PHY Controller core in FPGA.It is designed
	  for enabling plug-and-play connectivity with xilinx HDMI 2.1
	  technology MAC transmit or receive subsystem.

config PHY_XILINX_DPGTQUAD
	tristate "Xilinx GT Quad Base PHY driver for Displayport TX and RX"
	select GENERIC_PHY
	help
	  Enable this to support DP GT QUAD PHY controller core in FPGA.
	  It is designed for enabling gt quad base configuration for Xilinx
	  Displayport Tx and Rx subsystems.

config PHY_AMD_VERSAL2_COMBO_PHY
	tristate "AMD Versal2 USB3.1 SSP+/DP Alt Combo PHY Driver"
	depends on TYPEC && (ARCH_ZYNQMP || COMPILE_TEST)
	select GENERIC_PHY
	help
	  Enable this to support the AMD Versal2 USB3.1 SSP+/DP Alt combo
	  PHY with Synopsys IP block. This PHY provides USB 3.1 SuperSpeed
	  Plus and DisplayPort Alternate Mode on AMD Versal2 platforms.

	  To compile this driver as a module, choose M here: the module
	  will be called phy-amd-versal2-usbdp.
```

## drivers/pmods/Kconfig
```kconfig
menuconfig PMODS
	bool "Pmod Support"
	depends on HAS_IOMEM && OF
	help
		Digilent PMOD Support

if PMODS

config PMODS_DEBUG
	bool "Enable Debug Message"

config PMODOLED
	tristate "PmodOLED1"
	select SPI_BITBANG
	select SPI_GPIO
	help
		The Digilent PmodOLED1, as well as ZED on-board OLED. Uses SPI over GPIO.
		Configuration SPI_BITBANG and SPI_GPIO will be selected automatically.

endif # PMODS
```

## drivers/reset/Kconfig
```kconfig
config ARCH_HAS_RESET_CONTROLLER
	bool

menuconfig RESET_CONTROLLER
	bool "Reset Controller Support"
	default y if ARCH_HAS_RESET_CONTROLLER
	help
	  Generic Reset Controller support.

	  This framework is designed to abstract reset handling of devices
	  via GPIOs or SoC-internal reset controller modules.

	  If unsure, say no.

if RESET_CONTROLLER

config RESET_OXNAS
	bool

if RESET_CONTROLLER

config ZYNQMP_RESET_CONTROLLER
	bool "Xilinx ZYNQMP Reset Controller Support"
        help
	  ZYNQMP Reset Controller support.

	  This framework is designed to abstract reset handling of devices
	  via SoC-internal reset controller modules.

	  If sure, say yes.If unsure, say no.

endif

config TI_SYSCON_RESET
	tristate "TI SYSCON Reset Driver"
	depends on HAS_IOMEM
	select MFD_SYSCON
	help
	  This enables the reset driver support for TI devices with
	  memory-mapped reset registers as part of a syscon device node. If
	  you wish to use the reset framework for such memory-mapped devices,
	  say Y here. Otherwise, say N.

source "drivers/reset/sti/Kconfig"
source "drivers/reset/hisilicon/Kconfig"

endif
```

## drivers/rpmsg/Kconfig
```kconfig
menu "Rpmsg drivers"

# RPMSG always gets selected by whoever wants it
config RPMSG
	tristate

config RPMSG_QCOM_SMD
	tristate "Qualcomm Shared Memory Driver (SMD)"
	depends on QCOM_SMEM
	depends on QCOM_SMD=n
	select RPMSG
	help
	  Say y here to enable support for the Qualcomm Shared Memory Driver
	  providing communication channels to remote processors in Qualcomm
	  platforms.

config RPMSG_VIRTIO
	tristate
	select RPMSG
	select VIRTIO
	select VIRTUALIZATION

config RPMSG_SERVER_SAMPLE
	tristate "An rpmsg server sample"
	depends on RPMSG
	---help---
	  This is just a sample server driver for the rpmsg bus.
	  Say either Y or M. You know you want to.

config RPMSG_FREERTOS_STAT
	tristate "An FreeRTOS statistic"
	depends on RPMSG && NET
	---help---
	  This is just a sample to get statistic from FreeRTOS.
	  Say either Y or M. You know you want to.

endmenu
```

## drivers/rpmsg/host/Kconfig
```kconfig
config OMAP_RPMSG
	tristate "OMAP virtio-based remote processor messaging support"
	depends on ARCH_OMAP4 && OMAP_REMOTE_PROC
	select CONFIG_OMAP_MBOX_FWK
	select RPMSG
	help
	  Say Y if you want to enable OMAP's virtio-based remote-processor
	  messaging, currently only available on OMAP4. This is required
	  for offloading cpu-intensive and/or latency-sensitive tasks to
	  the remote on-chip M3s or C64x+ dsp, usually used by multimedia
	  frameworks.
```

## drivers/soc/xilinx/Kconfig
```kconfig
# SPDX-License-Identifier: GPL-2.0
#
# Xilinx ZYNQ MPSoC configuration
#
menu "Xilinx SoC drivers"

config XILINX_VCU
        tristate "Xilinx VCU logicoreIP Init"
	depends on HAS_IOMEM
        help
          Provides the driver to enable and disable the isolation between the
          processing system and programmable logic part by using the logicoreIP
          register set. This driver also configures the frequency based on the
          clock information from the logicoreIP register set.

          If you say yes here you get support for the logicoreIP.

          If unsure, say N.

          To compile this driver as a module, choose M here: the
          module will be called xlnx_vcu.

endmenu

if ARCH_ZYNQMP

config ZYNQMP_PM_API_DEBUGFS
	bool "Enable Xilinx Zynq MPSoC Power Management API debugfs functionality"
	depends on DEBUG_FS && PM
	help
	  Say yes to enable power domain management API requests through debugfs
	  In doubt, say N

config ZYNQMP_PM_DOMAINS
	bool "Enable Zynq MPSoC generic PM domains"
	default y
	depends on PM
	select PM_GENERIC_DOMAINS
	help
	  Say yes to enable device power management through PM domains
	  In doubt, say N

endif #ARCH_ZYNQMP
```

## drivers/soc/xilinx/zynqmp/Kconfig
```kconfig
# SPDX-License-Identifier: GPL-2.0+
# Kconfig for Xilinx ZynqMP SoC

menu "Zynq MPSoC SoC Drivers"
	depends on ARCH_ZYNQMP

config ZYNQMP_PM_DOMAINS
	bool "Enable Zynq MPSoC generic PM domains"
	default y
	depends on PM
	select PM_GENERIC_DOMAINS
	help
	  Say yes to enable device power management through PM domains
	  In doubt, say N

endmenu
```

## drivers/staging/apf/Kconfig
```kconfig
#
# APF driver configuration
#

menuconfig XILINX_APF
	tristate "Xilinx APF Accelerator driver"
	depends on ARCH_ZYNQ || ARCH_ZYNQMP
	default n
	help
	  Select if you want to include APF accelerator driver

config XILINX_DMA_APF
	bool "Xilinx APF DMA engines support"
	depends on XILINX_APF
	select DMA_ENGINE
	help
	  Enable support for the Xilinx APF DMA controllers.
```

## drivers/staging/fclk/Kconfig
```kconfig
#
# Xilinx PL clk enabler
#

config XILINX_FCLK
	tristate "Xilinx PL clock enabler"
	depends on COMMON_CLK && OF
	---help---
	  Support for the Xilinx fclk clock enabler.
```

## drivers/staging/fpga/Kconfig
```kconfig
#
# FPGA framework configuration
#

menu "FPGA devices"

config FPGA
	tristate "FPGA Framework"
	help
	  Say Y here if you want support for configuring FPGAs from the
	  kernel.  The FPGA framework adds a FPGA manager class and FPGA
	  manager drivers.

if FPGA

config FPGA_MGR_SYSFS
	bool "FPGA Manager SysFS Interface"
	depends on SYSFS
	help
	  FPGA Manager SysFS interface.

config FPGA_MGR_SOCFPGA
	tristate "Altera SOCFPGA"
	help
	  FPGA manager driver support for Altera SOCFPGA.

config FPGA_MGR_ZYNQ_FPGA
	tristate "Xilinx Zynq FPGA"
	help
	  FPGA manager driver support for Xilinx Zynq FPGAs.

endif # FPGA

endmenu
```

## drivers/staging/mali/Kconfig
```kconfig
menuconfig ARM_MALI
	bool "ARM mali"
	help
	  Enable ARM Mali driver

if ARM_MALI
choice
	prompt "MALI Version"
	default ARM_MALI_R5P1_01REL0
	help
	  Select proper Mali version you want to use

config ARM_MALI_R5P1_01REL0
	bool "r5p1-01rel0"

#config ARM_MALI_R5P2_00REL0
#	bool "r5p2-00rel0"

endchoice

# Setup default options
config MALI400
	tristate
	default y

config MALI_DT
	def_bool y

# Source different driver versions
if ARM_MALI_R5P1_01REL0
source "drivers/staging/mali/DX910-SW-99002-r5p1-01rel0/driver/src/devicedrv/mali/Kconfig"
endif

if ARM_MALI_R5P2_00REL0
source "drivers/staging/mali/DX910-SW-99002-r5p2-00rel0/driver/src/devicedrv/mali/Kconfig"
endif

endif
```

## drivers/staging/pmods/Kconfig
```kconfig
menuconfig PMODS
	bool "Pmod Support"
	depends on HAS_IOMEM && OF
	help
		Digilent PMOD Support

if PMODS

config PMODS_DEBUG
	bool "Enable Debug Message"

config PMODOLED
	tristate "PmodOLED1"
	depends on SPI_BITBANG
	depends on SPI_GPIO
	help
		The Digilent PmodOLED1, as well as ZED on-board OLED. Uses SPI over GPIO.

config PMODCLS
	tristate "pmodcls"
	depends on SPI_BITBANG
	help
		This is the Digilent PmodCLS driver. Uses SPI over GPIO.

config PMODCLP
	tristate "pmodclp"
	help
		This is the Digilent PmodCLP driver. Implements parallel access.

config PMODDA1
	tristate "pmodda1"
	depends on SPI_BITBANG
	help
		This is the Digilent PmodDA1 driver. Uses SPI over GPIO.

config PMODAD1
	tristate "pmodad1"
	depends on SPI_BITBANG
	help
		This is the Digilent PmodAD1 driver. Uses SPI over GPIO.

endif # PMODS
```

## drivers/staging/uartlite-rs485/Kconfig
```kconfig
# SPDX-License-Identifier: GPL-2.0
#
# Uartlite RS485 Serial device configuration
#

config SERIAL_UARTLITE_RS485
	tristate "Xilinx uartlite rs485 serial port support"
	depends on HAS_IOMEM
	select SERIAL_CORE
	help
	  Say Y here if you want to use the Xilinx uartlite with rs485 serial controller.

	  To compile this driver as a module, choose M here: the
	  module will be called uartlite_485.
```

## drivers/staging/video/axivdma/Kconfig
```kconfig
menuconfig XILINX_VIDEO_IP
	tristate "Xilinx Video IP components"
	---help---
	  This adds support to include Xilinx Video IP components.
	  Xilinx video IP need few additional drivers which are not currently in Xilinx
	  main-stream kernel are added in this section.
	  Example includes : AXI VDMA client driver.

config XILINX_VDMA_WRAPPER
	tristate "Video DMA Wrapper"
	depends on XILINX_VIDEO_IP && XILINX_DMA_ENGINES
	---help---
	  Enables Video DMA IP component.Uses Slave-DMA API of the DMA engine.
	  Provides user space application an interface to configure/control
	  Xilinx VDMA IP.
	  VDMA wrapper can be extened to supports other features exported by VDMA engine.
```

## drivers/staging/video/imageon/Kconfig
```kconfig
config VIDEO_IMAGEON
	tristate "Imageon card RX support"
	depends on MEDIA_SUPPORT && VIDEO_V4L2 && I2C && VIDEO_V4L2_SUBDEV_API
	select I2C_ALGOBIT
	select VIDEO_ADV7604
	---help---
	  To compile this driver as a module, choose M here: the
	  module will be called imageon-rx.
	  Imageon driver initializes/configures ADV7611 (v4l2 sub device)
	  Configured as a loadable module.
	  It requests EDID using mdev (user-space helper app).
```
