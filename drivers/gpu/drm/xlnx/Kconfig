## drivers/gpu/drm/xlnx/Kconfig
```kconfig
config DRM_ZYNQMP_DPSUB
	tristate "ZynqMP DisplayPort Controller Driver"
	depends on ARCH_ZYNQMP || COMPILE_TEST
	depends on COMMON_CLK && DRM && OF
	depends on DMADEVICES
	depends on PHY_XILINX_ZYNQMP
	depends on XILINX_ZYNQMP_DPDMA
	select DMA_ENGINE
	select DRM_GEM_CMA_HELPER
	select DRM_KMS_CMA_HELPER
	select DRM_KMS_HELPER
	select GENERIC_PHY
	help
	  This is a DRM/KMS driver for ZynqMP DisplayPort controller. Choose
	  this option if you have a Xilinx ZynqMP SoC with DisplayPort
	  subsystem.

config DRM_XLNX
	tristate "Xilinx DRM KMS Driver"
	depends on DRM && OF
	select DRM_KMS_HELPER
	select DRM_KMS_CMA_HELPER
	select DRM_GEM_CMA_HELPER
	help
	  Xilinx DRM KMS driver. Choose this option if you have
	  a Xilinx SoCs with hardened display pipeline or soft
	  display pipeline using Xilinx IPs in FPGA. This module
	  provides the kernel mode setting functionalities
	  for Xilinx display drivers.
```

## drivers/gpu/drm/xylon/Kconfig
```kconfig
config DRM_XYLON
	tristate "Xylon DRM"
	depends on DRM
	select DRM_KMS_HELPER
	select DRM_KMS_CMA_HELPER
	select DRM_GEM_CMA_HELPER
	select DRM_ENCODER_ADV7511
	help
	  DRM display driver for xylon logiCVC IP core.
```

## drivers/gpu/drm/zocl/Kconfig
```kconfig
config DRM_ZOCL
	tristate "Xilinx Zynq OpenCL"
	depends on DRM
	select DRM_KMS_HELPER
	select DRM_KMS_CMA_HELPER
	select DRM_GEM_CMA_HELPER
	help
	  Xilinx Zynq OpenCL Manager
```

## drivers/i2c/algos/Kconfig
```kconfig
#
# I2C algorithm drivers configuration
#

menu "I2C Algorithms"
	visible if !I2C_HELPER_AUTO

config I2C_ALGOBIT
	tristate "I2C bit-banging interfaces"

config I2C_ALGOPCF
	tristate "I2C PCF 8584 interfaces"

config I2C_ALGOPCA
	tristate "I2C PCA 9564 interfaces"

config XILINX_IIC
	tristate "Xilinx IIC interface"
	depends on I2C && XILINX_DRIVERS
	help
	  Supports the Xilinx IIC interface.
endmenu
```

## drivers/media/platform/xilinx/Kconfig
```kconfig
# SPDX-License-Identifier: GPL-2.0

config VIDEO_XILINX
	tristate "Xilinx Video IP (EXPERIMENTAL)"
	depends on VIDEO_V4L2  && OF && HAS_DMA
	depends on DMADEVICES
	select MEDIA_CONTROLLER
	select VIDEO_V4L2_SUBDEV_API
	select VIDEOBUF2_DMA_CONTIG
	select XILINX_FRMBUF
	select V4L2_FWNODE
	help
	  Driver for Xilinx Video IP Pipelines

if VIDEO_XILINX

config VIDEO_XILINX_CSI2RXSS
	tristate "Xilinx CSI-2 Rx Subsystem"
	help
	  Driver for Xilinx MIPI CSI-2 Rx Subsystem. This is a V4L sub-device
	  based driver that takes input from CSI-2 Tx source and converts
	  it into an AXI4-Stream.

config VIDEO_XILINX_AXI4S_SWITCH
	tristate "Xilinx AXI4-Stream Video Switch"
	depends on VIDEO_XILINX
	help
	  Driver for the Xilinx AXI4-Stream Video Switch. This is a
	  V4L sub device based driver. It supports fixed (TDEST based)
	  as well as dynamic (control register based) routing.
	  Say M to modularize. Say N if unsure.

config VIDEO_XILINX_CFA
	tristate "Xilinx Video Color Filter Array"
	depends on VIDEO_XILINX
	help
	  Driver for the Xilinx Color Filter Array

config VIDEO_XILINX_CRESAMPLE
	tristate "Xilinx Video Chroma Resampler"
	depends on VIDEO_XILINX
	help
	  Driver for the Xilinx Chroma Resampler

config VIDEO_XILINX_DEMOSAIC
	tristate "Xilinx Video Demosaic IP"
	depends on VIDEO_XILINX
	help
	  Driver for Xilinx Video Demosaic IP. This is a V4L sub-device
	  based driver for the Demosaic IP that takes input a Bayer video
	  stream format as input and generates an RGB video output.
	  Say M to modularize. Say N if unsure.

config VIDEO_XILINX_GAMMA
	tristate "Xilinx Gamma Correction LUT"
	depends on VIDEO_XILINX
	help
	  Driver for Xilinx Gamma Correction LUT IP. This is a V4L sub-device
	  based driver that exposes V4L controls to adjust Red, Blue and Green
	  Gamma Correction.

	  Say M to modularize. Say N if unsure.

config VIDEO_XILINX_HDCP1X_RX
	bool
	select XLNX_HDCP1X_CIPHER
	help
	  Functionality of HDCP1X Rx for DP and HDMI. It handles the hdcp1x rx
	  authentication. Choose this config in a platform where the DP/HDMI Rx
	  subsystem enabled with HDCP1X.

config VIDEO_XILINX_HDMI21RXSS
	tristate "Xilinx HDMI 2.1 Rx Subsystem"
	depends on VIDEO_XILINX
	help
	  Driver for the Xilinx HDMI 2.1 Rx subsystem to capture HDMI streams.
	  This is a V4L2 subdev driver which used to get the stream properties
	  like timing, color format and depth, frame rate.

	  Say M to modularize. Say N if unsure.

config VIDEO_XILINX_HLS
	tristate "Xilinx Video HLS Core"
	depends on VIDEO_XILINX
	help
	  Driver for the Xilinx Video HLS Cores

config VIDEO_XILINX_REMAPPER
	tristate "Xilinx Video Remapper"
	depends on VIDEO_XILINX
	help
	  Driver for the Xilinx Video Remapper

config VIDEO_XILINX_RGB2YUV
	tristate "Xilinx Video RGB to YUV Converter"
	depends on VIDEO_XILINX
	help
	  Driver for the Xilinx Video RGB to YUV Converter

config VIDEO_XILINX_SCALER
	tristate "Xilinx Video Scaler"
	depends on VIDEO_XILINX
	help
	  Driver for the Xilinx Video Scaler

config VIDEO_XILINX_MULTISCALER
	tristate "Xilinx Video Multiscaler"
	depends on VIDEO_XILINX
	depends on VIDEO_DEV && VIDEO_V4L2
	select V4L2_MEM2MEM_DEV
	select VIDEOBUF2_DMA_CONTIG
	help
	  Driver for the Xilinx Video Multi Scaler. This is a V4L2 memory to
	  memory based driver. Multi-Scaler has max 8 channels which can be
	  programed for different scaling ratio.

config VIDEO_XILINX_SDIRXSS
	tristate "Xilinx SDI Rx Subsystem"
	depends on VIDEO_XILINX
	help
	  Driver for Xilinx SDI Rx Subsystem

config VIDEO_XILINX_SWITCH
	tristate "Xilinx Video Switch"
	depends on VIDEO_XILINX
	help
	  Driver for the Xilinx Video Switch

config VIDEO_XILINX_TPG
	tristate "Xilinx Video Test Pattern Generator"
	depends on VIDEO_XILINX
	select VIDEO_XILINX_VTC
	help
	  Driver for the Xilinx Video Test Pattern Generator

config VIDEO_XILINX_VPSS_CSC
	tristate "Xilinx VPSS CSC"
	depends on VIDEO_XILINX
	help
	  Driver for the Xilinx Video Processing Sub-System (VPSS)
	  Color Space Conversion. The driver provides RGB to YUV444
	  conversion and provides video controls like Brightness,
	  Contrast, Color Gains that can be applied to video.
	  Say N if unsure. Say M to modularize.

config VIDEO_XILINX_VPSS_SCALER
	tristate "Xilinx Video VPSS Scaler"
	depends on VIDEO_XILINX
	help
	  Driver for Xilinx Video Processing Sub-System(VPSS) Scaler.
	  It allows upscaling and downscaling of video. It also supports
	  limited Color Space Conversion.
	  Say N if unsure.

config VIDEO_XILINX_VTC
	tristate "Xilinx Video Timing Controller"
	depends on VIDEO_XILINX
	help
	  Driver for the Xilinx Video Timing Controller

config VIDEO_XILINX_DPRXSS
	tristate "Xilinx DP Rx Subsystem"
	depends on VIDEO_XILINX
	help
	  Driver for Xilinx DisplayPort Rx Subsystem. This is a V4L sub-device
	  based driver for the DisplayPort receiver subsystem IP. It captures
	  AXI-Stream video data and output to video IPs. Choose this driver
	  in a platform where the DisplayPort rx subsystem can be instantiated.

config VIDEO_XILINX_SCD
	tristate "Xilinx Scene Change Detect"
	depends on VIDEO_XILINX
	help
	  Driver for Xilinx Scene Change Detection Controller.
	  The driver allows applications to pass video buffers and
	  provides if scene change detection is present between
	  adjacent frames.

config VIDEO_XILINX_M2M
	tristate "Xilinx Video mem2mem"
	depends on VIDEO_XILINX
	select V4L2_MEM2MEM_DEV
	help
	  Driver for Xilinx V4L2 mem2mem pipeline operation to achieve memory
	  copy between two different physical memories using DMA transfers.

config VIDEO_XILINX_AXI4S_BROADCASTER
	tristate "Xilinx AXI4-Stream Video Broadcaster"
	depends on VIDEO_XILINX
	help
	  Driver for the Xilinx AXI4-Stream Video Broadcaster. This is a
	  V4L sub device based driver. It replicates a single input AXI4-Stream
	  into multiple output AXI4-Stream.
	  Say M to modularize. Say N if unsure.

config VIDEO_XILINX_AXI4S_SUBSETCONV
	tristate "Xilinx AXI4-Stream Subset Converter"
	depends on VIDEO_XILINX
	help
	  This subset converter driver is for configuring the Xilinx
	  subset converter IP which is a non-memory mapped IP used for
	  converting formats. The format conversion of source pad and
	  sink pad in the pipeline done by subset conveter IP will be
	  mapped in this driver.
	  To compile this driver as a module, choose M here.
	  If unsure, choose N

endif #VIDEO_XILINX
```

## drivers/misc/jesd204b/Kconfig
```kconfig
#
# Jesd204b support
#

config XILINX_JESD204B
	tristate "Xilinx JESD204B"
	help
	  This option enables support for the Xilinx JESD204B driver.
	  It is designed to allow user to access JESD204B IP registers
	  with sysfs entries. JESD204B is the protocol used by High-Speed
	  data converters to transfer data to FPGA/ASIC.

	  If unsure, say N.

	  To compile this driver as a module, choose M here: the
	  module will be called jesd204b.

config XILINX_JESD204B_PHY
	tristate "JESD Phy Driver"
	depends on XILINX_JESD204B
	help
	  This is JESD204b Phy Interface. It enables support for xilinx jesd204b phy
	  controller.

	  If unsure, say N.

	  To compile this driver as a module, choose M here: the
	  module will be called jesd204b_phy.
```

## drivers/misc/xilinx/Kconfig
```kconfig
#
# Xilinx devices and common device driver infrastructure
#

config XILINX_DRIVERS
  bool
  help
    Enable visibility of all Xilinx device drivers.
```

## drivers/net/arm/Kconfig
```kconfig
#
# Acorn Network device configuration
#  These are for Acorn's Expansion card network interfaces
#
config ARM_AM79C961A
	bool "ARM EBSA110 AM79C961A support"
	depends on NET_ETHERNET && ARM && ARCH_EBSA110
	select CRC32
	help
	  If you wish to compile a kernel for the EBSA-110, then you should
	  always answer Y to this.

config ARM_ETHER1
	tristate "Acorn Ether1 support"
	depends on NET_ETHERNET && ARM && ARCH_ACORN
	help
	  If you have an Acorn system with one of these (AKA25) network cards,
	  you should say Y to this option if you wish to use it with Linux.

config ARM_ETHER3
	tristate "Acorn/ANT Ether3 support"
	depends on NET_ETHERNET && ARM && ARCH_ACORN
	help
	  If you have an Acorn system with one of these network cards, you
	  should say Y to this option if you wish to use it with Linux.

config ARM_ETHERH
	tristate "I-cubed EtherH/ANT EtherM support"
	depends on NET_ETHERNET && ARM && ARCH_ACORN
	select CRC32
	help
	  If you have an Acorn system with one of these network cards, you
	  should say Y to this option if you wish to use it with Linux.

config ARM_AT91_ETHER
	tristate "AT91RM9200 Ethernet support"
	depends on NET_ETHERNET && ARM && ARCH_AT91RM9200
	select MII
	help
	  If you wish to compile a kernel for the AT91RM9200 and enable
	  ethernet support, then you should always answer Y to this.

config EP93XX_ETH
	tristate "EP93xx Ethernet support"
	depends on NET_ETHERNET && ARM && ARCH_EP93XX
	help
	  This is a driver for the ethernet hardware included in EP93xx CPUs.
	  Say Y if you are building a kernel for EP93xx based devices.

config ARM_ETHER00
	tristate "Altera Ether00 support"
	depends on NET_ETHERNET && ARM && ARCH_CAMELOT
	help
	  This is the driver for Altera's ether00 ethernet mac IP core. Say
	  Y here if you want to build support for this into the kernel. It
	  is also available as a module (say M here) that can be inserted/
	  removed from the kernel at the same time as the PLD is configured.
	  If this driver is running on an epxa10 development board then it
	  will generate a suitable hw address based on the board serial
	  number (MTD support is required for this). Otherwise you will
	  need to set a suitable hw address using ifconfig.

config ETH_S3C4510B
	bool "Samsung S3C4510B Ethernet Support"
	depends on NET_ETHERNET && ARM && CPU_S3C4510B
	help
	  This is the driver for Samsung's S3C4510B SoC MAC IP core. Say
	  Y here if you want to build support for this into the kernel.

config P2001_ETH
	tristate "P2001 ethernet driver"
	depends on NET_ETHERNET && ARM && MII && ARCH_P2001
	default y
	help
	  P2001 ethernet driver
```

## drivers/net/ethernet/cadence/Kconfig
```kconfig
#
# Atmel device configuration
#

config NET_CADENCE
	bool "Cadence devices"
	depends on HAS_IOMEM
	default y
	---help---
	  If you have a network (Ethernet) card belonging to this class, say Y.

	  If unsure, say Y.

	  Note that the answer to this question doesn't directly affect the
	  kernel: saying N will just cause the configurator to skip all
	  the remaining Atmel network card questions. If you say Y, you will be
	  asked for your specific card in the following questions.

if NET_CADENCE

config MACB
	tristate "Cadence MACB/GEM support"
	depends on HAS_DMA
	select PHYLIB
	select PTP_1588_CLOCK
	---help---
	  The Cadence MACB ethernet interface is found on many Atmel AT32 and
	  AT91 parts.  This driver also supports the Cadence GEM (Gigabit
	  Ethernet MAC found in some ARM SoC devices).  Say Y to include
	  support for the MACB/GEM chip.

	  To compile this driver as a module, choose M here: the module
	  will be called macb.

config MACB_EXT_BD
	tristate "Cadence MACB/GEM extended buffer descriptor"
	depends on HAS_DMA && MACB
	---help---
	  The Cadence MACB host supports use of extended buffer descriptor.
	  This option enables additon of two extra words to TX BD and RX BD.
	  These two extra words are currently used to obtain PTP timestamp.

endif # NET_CADENCE
```
