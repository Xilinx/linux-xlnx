## drivers/fpga/Kconfig
```kconfig
#
# FPGA framework configuration
#

menu "FPGA Configuration Support"

config FPGA
	tristate "FPGA Configuration Framework"
	help
	  Say Y here if you want support for configuring FPGAs from the
	  kernel.  The FPGA framework adds a FPGA manager class and FPGA
	  manager drivers.

config FPGA_BRIDGE
	bool "FPGA Bridge Framework"
	depends on OF
	help
	  Say Y here if you want to support bridges connected between host
	  processors and FPGAs or between FPGAs.

if FPGA

config FPGA_MGR_SOCFPGA
	tristate "Altera SOCFPGA FPGA Manager"
	depends on ARCH_SOCFPGA
	help
	  FPGA manager driver support for Altera SOCFPGA.

config FPGA_MGR_ZYNQ_FPGA
	tristate "Xilinx Zynq FPGA"
	help
	  FPGA manager driver support for Xilinx Zynq FPGAs.

config FPGA_AREA
	bool "Device Tree Based FPGA Reprogramming"
	depends on FPGA_BRIDGE
	help
	  Enable FPGA Area which supports programming FPGAs under control of Device Tree.

config SOCFPGA_FPGA_BRIDGE
	bool "Altera SoCFPGA FPGA Bridges"
	depends on ARCH_SOCFPGA && FPGA_BRIDGE
	help
	  Say Y to enable drivers for FPGA bridges for Altera SOCFPGA devices.


endif # FPGA

endmenu
```

## drivers/gpu/drm/xilinx/Kconfig
```kconfig
config DRM_XILINX
	tristate "Xilinx DRM"
	depends on DRM && HAVE_CLK
	select DRM_KMS_HELPER
	select DRM_KMS_CMA_HELPER
	select DRM_GEM_CMA_HELPER
	select DMA_ENGINE
	select DRM_XILINX_DP_SUB
	select XILINX_FRMBUF
	help
	  DRM display driver for Xilinx IP based pipelines.

config DRM_XILINX_DP
	tristate "Xilinx DRM Display Port Driver"
	depends on DRM_XILINX
	help
	  DRM driver for Xilinx Display Port IP.

config DRM_XILINX_DP_DEBUG_FS
	bool "Xilinx DRM DP debugfs"
	depends on DEBUG_FS && DRM_XILINX_DP
	help
	  Enable the debugfs code for DPDMA driver. The debugfs code
	  enables debugging or testing related features. It exposes some
	  low level controls to the user space to help testing automation,
	  as well as can enable additional diagnostic or statistical
	  information.

config DRM_XILINX_DP_SUB
	tristate "Xilinx DRM Display Port Subsystem Driver"
	depends on DRM_XILINX
	select DRM_XILINX_DP
	help
	  DRM driver for Xilinx Display Port Subsystem.

config DRM_XILINX_DP_SUB_DEBUG_FS
	bool "Xilinx DRM DPSUB debugfs"
	depends on DEBUG_FS && DRM_XILINX_DP_SUB
	select DRM_XILINX_DP_DEBUG_FS
	help
	  Enable the debugfs code for DP Sub driver. The debugfs code
	  enables debugging or testing related features. It exposes some
	  low level controls to the user space to help testing automation,
	  as well as can enable additional diagnostic or statistical
	  information.

config DRM_XILINX_MIPI_DSI
	tristate "Xilinx DRM MIPI DSI Driver"
	depends on DRM_XILINX
	select DRM_PANEL
	select DRM_MIPI_DSI
	help
	  DRM driver for Xilinx MIPI DSI IP.
```
