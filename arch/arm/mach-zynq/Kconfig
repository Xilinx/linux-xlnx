## arch/microblaze/Kconfig
```kconfig
# For a description of the syntax of this configuration file,
# see Documentation/kbuild/config-language.txt.

mainmenu "Linux/Microblaze Kernel Configuration"

config MICROBLAZE
	bool
	select XILINX_DRIVERS
	default y

config MMU
	bool
	default n

config SWAP
	bool
	default n

config RWSEM_GENERIC_SPINLOCK
	bool
	default y

config RWSEM_XCHGADD_ALGORITHM
	bool


config ARCH_HAS_ILOG2_U32
	bool
	default n

config ARCH_HAS_ILOG2_U64
	bool
	default n

config GENERIC_FIND_NEXT_BIT
	bool
	default y

config GENERIC_HWEIGHT
	bool
	default y

config GENERIC_HARDIRQS
	bool
	default y

config GENERIC_IRQ_PROBE
	bool
	default y

config GENERIC_CALIBRATE_DELAY
	bool
	default y

config OF
	def_bool n

config PCI
	bool
	default n

config UID16
	bool
	default y

config DEFCONFIG_LIST
	string
	default "arch/$ARCH/defconfig"

config NO_IOPORT
	bool
	default y

# source arch/microblaze/Kconfig.auto

source "init/Kconfig"

menu "Processor type and features"

choice
	prompt "Subarchitecture Type"
	default MICROBLAZE_ML401

config MICROBLAZE_ML401
	bool "ML401"
	help
	  Choose this option if you are using the Xilinx ML401 reference design

config MICROBLAZE_SP3E
	bool "SP3E/1600"
	help
	  Choose this option if you are using the Xilinx Spartan-3E/1600 reference design

config MICROBLAZE_OTHER
	bool "Other"
	help
	  Choose this option if you are using some other design with an automatically generated BSP.

endchoice

config CMDLINE_BOOL
	bool "Default bootloader kernel arguments"

config CMDLINE
	string "Initial kernel command string"
	depends on CMDLINE_BOOL
	default "console=ttyS0,9600"
	help
	  On some platforms, there is currently no way for the boot loader to
	  pass arguments to the kernel. For these platforms, you can supply
	  some command-line options at build time by entering them here.  In
	  most cases you will need to specify the root device here.

config WANT_DEVICE_TREE
	bool "Static device tree configuration"
	select OF
	help
		Enable configuration using a static device tree.  If a static
		device tree is not used, then configuration will default to
		using platform_devices via the xparameters mechanism.

config DEVICE_TREE
	string "Static device tree source file"
	depends on WANT_DEVICE_TREE
	help
	  This specifies the device tree source (.dts) file to be
	  compiled and included when building the bootwrapper.  If a
	  relative filename is given, then it will be relative to
	  arch/microblaze/boot/dts.

	  For example, this is required when building a cuImage target
	  for an older U-Boot, which cannot pass a device tree itself.
	  Such a kernel will not work with a newer U-Boot that tries to
	  pass a device tree (unless you tell it not to).  If your U-Boot
	  does not mention a device tree in "help bootm", then use the
	  cuImage target and specify a device tree here.  Otherwise, use
	  the uImage target and leave this field blank.

config ML401
	bool
	depends on MICROBLAZE_ML401
	default y

config SP3E
	bool
	depends on MICROBLAZE_SP3E
	default y

config XILINX_UNCACHED_SHADOW
    bool "Are you using uncached shadow for RAM ?"
    depends on MICROBLAZE
    default y
    help
      This is needed to be able to allocate uncachable memory regions.
      The feature requires the design to define the RAM memory controller window
      to be twice as large as the actual physical memory.

config LARGE_ALLOCS
	bool "Allow allocating large blocks (> 1MB) of memory"
	help
	     Allow the slab memory allocator to keep chains for very large
	     memory sizes - upto 32MB. You may need this if your system has
	     a lot of RAM, and you need to able to allocate very large
	     contiguous chunks. If unsure, say N.

comment "Boot options"

config CMDLINE
	string "Default kernel command string"
	default ""
	help
	  On some architectures there is currently no way for the boot loader
	  to pass arguments to the kernel. For these architectures, you should
	  supply some command-line options at build time by entering them 
	  here. 

config CMDLINE_FORCE
	bool "Force default kernel command string"
	help
	  Set this to have arguments from the default kernel command string 
	  override those passed by the boot loader

endmenu

config APM_EMULATION
	bool

source "mm/Kconfig"

menu "Exectuable file formats"

source "fs/Kconfig.binfmt"

endmenu

source "net/Kconfig"

source "drivers/Kconfig"

source "fs/Kconfig"

source "arch/microblaze/Kconfig.debug"

source "security/Kconfig"

source "crypto/Kconfig"

source "lib/Kconfig"
```

## arch/microblaze/Kconfig.debug
```kconfig
menu "Kernel hacking"

source "lib/Kconfig.debug"

config EARLY_PRINTK
	bool
	default y

config EARLY_PRINTK_UARTLITE_ADDRESS
	hex "Physical address where UART Lite for early printk is mapped"
	default "0x40600000"
	help
	  Please enter physcal address where your uart lite is mapped

config DEBUG_BOOTMEM
	depends on DEBUG_KERNEL
	bool "Debug BOOTMEM initialization"

endmenu
```

## arch/nios2nommu/Kconfig
```kconfig
#
# For a description of the syntax of this configuration file,
# see the Configure script.
#
mainmenu 'uClinux/Nios2 (w/o MMU) Kernel Configuration'

config MMU
	bool
	default n

config FPU
	bool
	default n

config UID16
	bool
	default y

config RWSEM_GENERIC_SPINLOCK
	bool
	default y

config RWSEM_XCHGADD_ALGORITHM
	bool
	default n

config GENERIC_FIND_NEXT_BIT
	bool
	default y

config GENERIC_HWEIGHT
	bool
	default y

config GENERIC_CALIBRATE_DELAY
	bool
	default y

source "init/Kconfig"

menu "Processor type and features"

comment 'Platform dependant setup'

choice
	prompt "CPU"
	default NIOS2

config NIOS2
	bool "NIOS2"
	help
	  Altera Nios2 softcore processor.

endchoice

choice
	prompt "Platform"
	default ALTERA_STRATIX

config MICROTRONIX_UKIT
	bool "Microtronix uKit board support"
	depends on NIOS2
	help
	  Support for the Microtronix uKit development board. Includes support 
	  for Sodimm SDRAM/FLASH, soft ethernet MAC & PHY.

config MICROTRONIX_STRATIX
	bool "Microtronix Stratix board support"
	depends on NIOS2
	help
	  Support for the Microtronix Stratix board. Includes support 
	  for Sodimm SDRAM/FLASH, soft ethernet MAC & PHY, USB, LVDS
	  & analog/digital converters.

config MICROTRONIX_CYCLONE
	bool "Microtronix Cyclone board support"
	depends on NIOS2
	help
	  Support for the Microtronix Cyclone board. Includes support 
	  for SDRAM, FLASH, soft ethernet MAC & PHY, USB,
	  & analog/digital converters.

config MICROTRONIX_PSK
	bool "Microtronix PSK (Product Starter Kit) support"
	depends on NIOS2
	help
	  Support for the Microtronix PSK (Product Starter Kit), which
	  features firefly module (EP1C4 or EP1C12). Includes support 
	  for SDRAM, FLASH, and a variety of product expansion kits such
	  as USB, Ethernet etc.

config ALTERA_STRATIX
	bool "Altera Stratix Development board support"
	depends on NIOS2
	help
	  Support for the Altera Stratix Development board. Includes
	  support for 10/100 ethernet, FLASH, SDRAM, compact flash.

config ALTERA_STRATIX_PRO
	bool "Altera Stratix Pro Development board support"
	depends on NIOS2
	help
	  Support for the Altera Stratix 1s40 Development board. Includes
	  support for 10/100 ethernet, FLASH, SDRAM, compact flash.

config ALTERA_STRATIX_II
	bool "Altera Stratix II Development board support"
	depends on NIOS2
	help
	  Support for the Altera Stratix II Development board. Includes
	  support for 10/100 ethernet, FLASH, SDRAM, compact flash.

config ALTERA_CYCLONE
	bool "Altera Cyclone Development board support"
	depends on NIOS2
	help
	  Support for the Altera Cyclone Development board. Includes
	  support for 10/100 ethernet, FLASH, SDRAM, compact flash.

config ALTERA_CYCLONE_1C12_EVAL
	bool "Altera Cyclone 1C12 Evaluation board support"
	depends on NIOS2
	help
	  Support for the Altera Cyclone 1C12 Evaluation board (with the
	  embedded processor module).

config ALTERA_DE2
	bool "Altera DE2 Development board support"
	depends on NIOS2
	help
	  Support for the Altera Cyclone Development board. Includes
	  support for 10/100 ethernet, FLASH, SDRAM, VGA, I2C.

endchoice

choice
	prompt "Nios II Hardware Multiply Support"
	default NIOS2_HW_MULX
	help
	  This option enables various assembler instructions based on your
	  selection.  The choice depends on what target hardware you'll be
	  running your applications on.  The default is 
	  "Enable mulx instruction".
	  
	  Here is an explanation of each option:
	  None = -mno-hw-mul -mno-hw-mulx
	   (no mul or mulx instructions used)
	  Enable mul instruction = -mhw-mul -mno-hw-mulx 
	   (use mul instructions)
	  Enable mul and mulx instructions = -mhw-mul -mhw-mulx
	   (use mul and mulx instructions)
	  
	  If you don't know what to choose, select "Enable mulx instruction".
	
config NIOS2_HW_MUL_OFF
	bool "None"

config NIOS2_HW_MUL
	bool "Enable mul instruction"

config NIOS2_HW_MULX
	bool "Enable mul and mulx instructions"
	
endchoice

comment 'Platform drivers Options'

config AVALON_DMA
	bool "Support of DMA controller with Avalon interface"
	default y
	help
	  This enables support of Altera's DMA controller with Avalon
	  interface, so that drivers of DMA-able device can use this 
	  interface.
	
config PIO_DEVICES
	bool "Enable leds, seven segment display"
	default y
	depends on (ALTERA_STRATIX || ALTERA_STRATIX_PRO || ALTERA_CYCLONE)
	help
	  This enables example code to support leds, and seven segment
	  display as PIO devices. Once enabled, the kernel will show a
	  counter (increas once a second) on these devices.

source "arch/nios2nommu/drivers/Kconfig"

comment 'Miscellaneous Options'

config EXCALIBUR
	bool
	default y
	depends on (NIOS2)

config BREAK_ON_START
	bool "Include breakpoint trap on kernel startup"
	help
	  Configures the kernel to trap to the GDB client on startup
	  before the kernel starts initialization. This allows you to
	  debug the kernel startup.

config LARGE_ALLOCS
	bool "Allow allocating large blocks (> 1MB) of memory"
	help
	  Allow the slab memory allocator to keep chains for very large
	  memory sizes - upto 32MB. You may need this if your system has
	  a lot of RAM, and you need to able to allocate very large
	  contiguous chunks. If unsure, say N.

choice
	prompt "Kernel executes from"
	---help---
	  Choose the memory type that the kernel will be running in.

config RAMKERNEL
	bool "RAM"
	help
	  The kernel will be resident in RAM when running.

#config ROMKERNEL
#	bool "ROM"
#	help
#	  The kernel will be resident in FLASH/ROM when running.

#config HIMEMKERNEL
#	bool "HIMEM"
#	help
#	  The kernel will be resident in high memory when running.

endchoice

config PREEMPT
	bool "Preemptible Kernel"
	help
	  This option reduces the latency of the kernel when reacting to
	  real-time or interactive events by allowing a low priority process to
	  be preempted even if it is in kernel mode executing a system call.
	  This allows applications to run more reliably even when the system is
	  under load.

	  Say Y here if you are building a kernel for a desktop, embedded
	  or real-time system.  Say N if you are unsure.

config PREEMPT_TIMES
	bool "Collect preemption latency times"
	depends on PREEMPT
	help
	  Allow collection for preemption latency times.

config CMDLINE
	string "Default kernel command string"
	default "CONSOLE=/dev/ttyS0 root=/dev/rom0 ro"
	help
	  On some architectures, there is currently no way
	  for the boot loader to pass arguments to the kernel. For these
	  architectures, you should supply some command-line options at build
	  time by entering them here. As a minimum, you should specify the
	  memory size and the root device (e.g., mem=64M root=/dev/nfs).

config PASS_CMDLINE
	bool "Passed kernel command line from u-boot"
	default n
	help
	  Use bootargs env variable from u-boot for kernel command line.
	  will override "Default kernel command string".
          Say N if you are unsure.

source "mm/Kconfig"

config BOOT_LINK_OFFSET
	hex "Link address offset for booting"
	default "0x00800000"
	help
	  This option allows you to set the link address offset of the zImage.
	  This can be useful if you are on a board which has a small amount of
	  memory.

endmenu

menu "Bus options (PCI, PCMCIA, EISA, MCA, ISA)"

config PCI
	bool "PCI support"
	help
	  Support for PCI bus.

source "drivers/pci/Kconfig"

config HOTPLUG
	bool "Support for hot-pluggable device"
	  ---help---
	  Say Y here if you want to plug devices into your computer while
	  the system is running, and be able to use them quickly.  In many
	  cases, the devices can likewise be unplugged at any time too.

	  One well known example of this is PCMCIA- or PC-cards, credit-card
	  size devices such as network cards, modems or hard drives which are
	  plugged into slots found on all modern laptop computers.  Another
	  example, used on modern desktops as well as laptops, is USB.

	  Enable HOTPLUG and KMOD, and build a modular kernel.  Get agent
	  software (at <http://linux-hotplug.sourceforge.net/>) and install it.
	  Then your kernel will automatically call out to a user mode "policy
	  agent" (/sbin/hotplug) to load modules and set up software needed
	  to use devices as you hotplug them.

source "drivers/pcmcia/Kconfig"

source "drivers/pci/hotplug/Kconfig"

endmenu

menu "Executable file formats"

config KCORE_AOUT
	bool
	default y

config KCORE_ELF
	bool
	default y

source "fs/Kconfig.binfmt"

endmenu

menu "Power management options"

config PM
	bool "Power Management support"
	help
	  Support processor power management modes

endmenu


source "net/Kconfig"

source "drivers/Kconfig"

source "fs/Kconfig"

menu "Kernel hacking"

config FULLDEBUG
	bool "Full Symbolic/Source Debugging support"
	help
	  Enable debuging symbols on kernel build.

config FRAME_POINTER
	bool "Compile the kernel with frame pointers"
	help
	  If you say Y here the resulting kernel image will be slightly larger
	  and slower, but it will give very useful debugging information.
	  If you don't debug the kernel, you can say N, but we may not be able
	  to solve problems without frame pointers.

config MAGIC_SYSRQ
	bool "Magic SysRq key"
	help
	  Enables console device to interpret special characters as
	  commands to dump state information.

config HIGHPROFILE
	bool "Use fast second timer for profiling"
	depends on COLDFIRE
	help
	  Use a fast secondary clock to produce profiling information.

config NO_KERNEL_MSG
	bool "Suppress Kernel BUG Messages"
	help
	  Do not output any debug BUG messages within the kernel.

config LOG_BUF_SHIFT
	int "Kernel log buffer size (16 => 64KB, 17 => 128KB)" if DEBUG_KERNEL
	range 12 21
	default 17 if ARCH_S390
	default 16 if X86_NUMAQ || IA64
	default 15 if SMP
	default 14
	help
	  Select kernel log buffer size as a power of 2.
	  Defaults and Examples:
	  	     17 => 128 KB for S/390
		     16 => 64 KB for x86 NUMAQ or IA-64
	             15 => 32 KB for SMP
	             14 => 16 KB for uniprocessor
		     13 =>  8 KB
		     12 =>  4 KB

endmenu

source "security/Kconfig"

source "crypto/Kconfig"

source "lib/Kconfig"
```
