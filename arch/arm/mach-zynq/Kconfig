## arch/nios2nommu/Kconfig.debug
```kconfig
menu "Kernel hacking"

source "lib/Kconfig.debug"

config FULLDEBUG
	bool "Full Symbolic/Source Debugging support"
	help
	  Enable debuging symbols on kernel build.

config FRAME_POINTER
	bool "Compile the kernel with frame pointers"
	help
	  If you say Y here the resulting kernel image will be slightly larger
	  and slower, but it will give very useful debugging information.
	  If you don't debug the kernel, you can say N, but we may not be able
	  to solve problems without frame pointers.

config MAGIC_SYSRQ
	bool "Magic SysRq key"
	help
	  Enables console device to interpret special characters as
	  commands to dump state information.

config HIGHPROFILE
	bool "Use fast second timer for profiling"
	depends on COLDFIRE
	help
	  Use a fast secondary clock to produce profiling information.

config NO_KERNEL_MSG
	bool "Suppress Kernel BUG Messages"
	help
	  Do not output any debug BUG messages within the kernel.

endmenu 
```

## arch/nios2nommu/drivers/Kconfig
```kconfig
# Platfrom drivers configuration

source "arch/nios2nommu/drivers/pci/Kconfig"

config FB_ALTERA
	tristate "Avalon VGA controller support"
	select FB
	select FB_CFB_FILLRECT
	select FB_CFB_COPYAREA
	select FB_CFB_IMAGEBLIT
	help
	  This is the frame buffer device driver for the VGA controller 
	  in SOPC Builder.

config SERIO_ALTPS2
	tristate "PS2 controller"
	select SERIO

config I2C_GPIO
	tristate "GPIO-Based I2C Interface"
	select I2C
	select I2C_ALGOBIT
	help
	  Say Y here if you use GPIO lines for an I2C bus.
```

## arch/nios2nommu/drivers/pci/Kconfig
```kconfig
config PCI_ALTPCI
	bool "Altera PCI host bridge"
	select PCI
	select PCI_AUTO
	select PCI_AUTO_UPDATE_RESOURCES
	default n
```

## arch/powerpc/configs/44x/avnet_v5fx30t_defconfig
```kconfig
CONFIG_44x=y
# CONFIG_LOCALVERSION_AUTO is not set
CONFIG_SYSVIPC=y
CONFIG_POSIX_MQUEUE=y
CONFIG_IKCONFIG=y
CONFIG_IKCONFIG_PROC=y
CONFIG_LOG_BUF_SHIFT=14
# CONFIG_UTS_NS is not set
# CONFIG_IPC_NS is not set
# CONFIG_PID_NS is not set
# CONFIG_NET_NS is not set
CONFIG_SYSFS_DEPRECATED=y
CONFIG_SYSFS_DEPRECATED_V2=y
CONFIG_BLK_DEV_INITRD=y
CONFIG_SLAB=y
CONFIG_MODULES=y
CONFIG_MODULE_UNLOAD=y
CONFIG_MODULE_FORCE_UNLOAD=y
CONFIG_MODVERSIONS=y
# CONFIG_BLK_DEV_BSG is not set
# CONFIG_EBONY is not set
CONFIG_XILINX_VIRTEX440_GENERIC_BOARD=y
CONFIG_PREEMPT=y
# CONFIG_CORE_DUMP_DEFAULT_ELF_HEADERS is not set
CONFIG_MATH_EMULATION=y
CONFIG_EXTRA_TARGETS="simpleImage.virtex440-avnet-v5fx30t simpleImage.initrd.virtex440-avnet-v5fx30t"
CONFIG_NET=y
CONFIG_PACKET=y
CONFIG_UNIX=y
CONFIG_INET=y
CONFIG_IP_MULTICAST=y
CONFIG_IP_PNP=y
CONFIG_IP_PNP_DHCP=y
CONFIG_IP_PNP_BOOTP=y
# CONFIG_INET_LRO is not set
CONFIG_NETFILTER=y
CONFIG_IP_NF_IPTABLES=m
CONFIG_IP_NF_FILTER=m
CONFIG_IP_NF_MANGLE=m
CONFIG_UEVENT_HELPER_PATH="/sbin/hotplug"
CONFIG_MTD=y
CONFIG_MTD_CFI=y
CONFIG_MTD_CFI_INTELEXT=y
CONFIG_BLK_DEV_LOOP=y
CONFIG_BLK_DEV_RAM=y
CONFIG_BLK_DEV_RAM_SIZE=8192
CONFIG_NETDEVICES=y
# CONFIG_NET_VENDOR_3COM is not set
CONFIG_SERIAL_8250=y
CONFIG_SERIAL_8250_CONSOLE=y
CONFIG_SERIAL_OF_PLATFORM=y
CONFIG_XILINX_HWICAP=y
CONFIG_I2C=y
CONFIG_I2C_CHARDEV=y
# CONFIG_HWMON is not set
CONFIG_FB=y
CONFIG_FB_XILINX=y
CONFIG_FRAMEBUFFER_CONSOLE=y
CONFIG_LOGO=y
# CONFIG_USB_SUPPORT is not set
CONFIG_EXT2_FS=y
CONFIG_AUTOFS4_FS=y
CONFIG_FUSE_FS=m
CONFIG_MSDOS_FS=y
CONFIG_VFAT_FS=y
CONFIG_TMPFS=y
CONFIG_CRAMFS=y
CONFIG_ROMFS_FS=y
CONFIG_NFS_FS=y
CONFIG_ROOT_NFS=y
CONFIG_NFSD=y
CONFIG_NFSD_V3=y
CONFIG_NLS_CODEPAGE_437=y
CONFIG_NLS_ASCII=m
CONFIG_NLS_ISO8859_1=m
CONFIG_NLS_UTF8=m
CONFIG_CRC_CCITT=y
CONFIG_FONTS=y
CONFIG_FONT_8x8=y
CONFIG_FONT_8x16=y
# CONFIG_CRYPTO_ANSI_CPRNG is not set
```

## arch/powerpc/platforms/44x/Kconfig
```kconfig
config BAMBOO
	bool "Bamboo"
	depends on 44x
	default n
	select 440EP
	help
	  This option enables support for the IBM PPC440EP evaluation board.

config EBONY
	bool "Ebony"
	depends on 44x
	default y
	select 440GP
	help
	  This option enables support for the IBM PPC440GP evaluation board.

config SEQUOIA
	bool "Sequoia"
	depends on 44x
	default n
	select 440EPX
	help
	  This option enables support for the AMCC PPC440EPX evaluation board.

#config LUAN
#	bool "Luan"
#	depends on 44x
#	default n
#	select 440SP
#	help
#	  This option enables support for the IBM PPC440SP evaluation board.

#config OCOTEA
#	bool "Ocotea"
#	depends on 44x
#	default n
#	select 440GX
#	help
#	  This option enables support for the IBM PPC440GX evaluation board.

config XILINX_ML507
	bool "Xilinx ML507 Reference System"
	depends on 44x
	default n
	select XILINX_ML5XX
	help
	  This option enables support for the Xilinx ML507 board.

config XILINX_DISABLE_44x_CACHE
	bool "Disable PPC440 caches"
	depends on XILINX_ML507
	help
	  This option allows to disable the caches on the PPC440. Some early
	  PPC440 soft-cores do not work with caches enabled. Also, some early
	  ML507 boards do have a non-functioning cache. If you have any
	  problems running the ML5, try using this option.

# 44x specific CPU modules, selected based on the board above.
config 440EP
	bool
	select PPC_FPU
	select IBM440EP_ERR42
	select IBM_NEW_EMAC_ZMII

config 440EPX
	bool
	select PPC_FPU
	select IBM_NEW_EMAC_EMAC4
	select IBM_NEW_EMAC_RGMII
	select IBM_NEW_EMAC_ZMII

config 440GP
	bool
	select IBM_NEW_EMAC_ZMII

config 440GX
	bool

config 440SP
	bool

config 440A
	bool
	depends on 440GX || 440EPX
	default y

# 44x errata/workaround config symbols, selected by the CPU models above
config IBM440EP_ERR42
	bool


# Xilinx specific config options.
config XILINX_ML5XX
	bool
	select XILINX_VIRTEX

config XILINX_VIRTEX_5_FX
	bool
	depends on XILINX_ML507
	default y
```

## arch/ppc/platforms/4xx/Kconfig
```kconfig
config 4xx
	bool
	depends on 40x || 44x
	default y

config WANT_EARLY_SERIAL
	bool
	select SERIAL_8250
	default n

config XILINX_ML5XX
	bool
	select XILINX_VIRTEX
	default n

menu "IBM 4xx options"
	depends on 4xx

choice
	prompt "Machine Type"
	depends on 40x
	default WALNUT

config BUBINGA
	bool "Bubinga"
	select WANT_EARLY_SERIAL
	help
	  This option enables support for the IBM 405EP evaluation board.

config CPCI405
	bool "CPCI405"
	help
	  This option enables support for the CPCI405 board.

config EP405
	bool "EP405/EP405PC"
	select EMBEDDEDBOOT
	help
	  This option enables support for the EP405/EP405PC boards.

config REDWOOD_5
	bool "Redwood-5"
	help
	  This option enables support for the IBM STB04 evaluation board.

config REDWOOD_6
	bool "Redwood-6"
	help
	  This option enables support for the IBM STBx25xx evaluation board.

config SYCAMORE
	bool "Sycamore"
	help
	  This option enables support for the IBM PPC405GPr evaluation board.

config WALNUT
	bool "Walnut"
	help
	  This option enables support for the IBM PPC405GP evaluation board.

config XILINX_ML300
	bool "Xilinx-ML300"
	select XILINX_VIRTEX_II_PRO
	select EMBEDDEDBOOT
	select XILINX_EMBED_CONFIG
	help
	  This option enables support for the Xilinx ML300 evaluation board.

config XILINX_XUPV2P
	bool "Xilinx-XUPV2P"
	select XILINX_VIRTEX_II_PRO
	select EMBEDDEDBOOT
	select XILINX_EMBED_CONFIG
	help
	  This option enables support for the Xilinx University Program (XUP) Virtex 2 Pro board.

config XILINX_ML403
	bool "Xilinx-ML403"
	select XILINX_VIRTEX_4_FX
	select EMBEDDEDBOOT
	select XILINX_EMBED_CONFIG
	help
	  This option enables support for the Xilinx ML403 evaluation board.

config XILINX_ML405
        bool "Xilinx-ML405"
        select XILINX_VIRTEX_4_FX
        select EMBEDDEDBOOT
        select XILINX_EMBED_CONFIG
        help
          This option enables support for the Xilinx ML405 evaluation board.

config XILINX_ML41x
	bool "Xilinx-ML41x"
	select XILINX_VIRTEX_4_FX
	select EMBEDDEDBOOT
	select XILINX_EMBED_CONFIG
	help
	  This option enables support for the Xilinx ML410/411 evaluation boards.

endchoice

choice
	prompt "Machine Type"
	depends on 44x
	default EBONY

config BAMBOO
	bool "Bamboo"
	select WANT_EARLY_SERIAL
	help
	  This option enables support for the IBM PPC440EP evaluation board.

config EBONY
	bool "Ebony"
	select WANT_EARLY_SERIAL
	help
	  This option enables support for the IBM PPC440GP evaluation board.

config LUAN
	bool "Luan"
	select WANT_EARLY_SERIAL
	help
	  This option enables support for the IBM PPC440SP evaluation board.

config YUCCA
	bool "Yucca"
	select WANT_EARLY_SERIAL
	help
	  This option enables support for the AMCC PPC440SPe evaluation board.

config OCOTEA
	bool "Ocotea"
	select WANT_EARLY_SERIAL
	help
	  This option enables support for the IBM PPC440GX evaluation board.

config TAISHAN
	bool "Taishan"
	select WANT_EARLY_SERIAL
	help
	  This option enables support for the AMCC PPC440GX evaluation board.

config XILINX_ML507
	bool "Xilinx-ML507 (Virtex-5 FX70T) Board"
	select XILINX_ML5XX
	select EMBEDDEDBOOT
	select XILINX_EMBED_CONFIG
	help
	  This option enables support for the Xilinx ML507 board.


endchoice

config XILINX_DISABLE_44x_CACHE
	bool "Disable PPC440 caches"
	depends on XILINX_ML507
	help
	  This option allows to disable the caches on the PPC440. Some early
	  PPC440 soft-cores do not work with caches enabled. Also, some early
	  ML507 boards do have a non-functioning cache. If you have any
	  problems running the ML5, try using this option.

config PPC_FPU
	depends on XILINX_VIRTEX_5_FX
	bool "Enable Xilinx Soft FPU"
	help
	  This option enables the Xilinx Soft FPU attached to the APU
	  interface of the PPC440 (requires DP_FULL FPU pcore).

config XILINX_INTC_IVR_WORKAROUND
	bool "Enable Xilinx INTC IVR workaround"
	depends on XILINX_ML507
	help
	  On some versions of the INTC core the IVR register is not working
	  properly. Selecting this option will enable a workaround using the
	  IPR register instead of the IVR register. Enabling this option is
	  save even if the IVR register is working properly but will result in
	  slightly lower performance.

config EP405PC
	bool "EP405PC Support"
	depends on EP405


# It's often necessary to know the specific 4xx processor type.
# Fortunately, it is implied (so far) from the board type, so we
# don't need to ask more redundant questions.
config NP405H
	bool
	depends on ASH
	default y

config 440EP
	bool
	depends on BAMBOO
	select PPC_FPU
	default y

config 440GP
	bool
	depends on EBONY
	default y

config 440GX
	bool
	depends on OCOTEA || TAISHAN
	default y

config 440SP
	bool
	depends on LUAN
	default y

config 440SPE
	bool
	depends on YUCCA
	default y

config 440
	bool
	depends on 440GP || 440SP || 440SPE || 440EP
	default y

config 440A
	bool
	depends on 440GX
	default y

config IBM440EP_ERR42
	bool
	depends on 440EP
	default y

# All 405-based cores up until the 405GPR and 405EP have this errata.
config IBM405_ERR77
	bool
	depends on 40x && !403GCX && !405GPR && !405EP
	default y

# All 40x-based cores, up until the 405GPR and 405EP have this errata.
config IBM405_ERR51
	bool
	depends on 40x && !405GPR && !405EP
	default y

config BOOKE
	bool
	depends on 44x
	default y

config IBM_OCP
	bool
	depends on ASH || BAMBOO || BUBINGA || CPCI405 || EBONY || EP405 || LUAN || YUCCA || OCOTEA || REDWOOD_5 || REDWOOD_6 || SYCAMORE || TAISHAN || WALNUT
	default y

config IBM_EMAC4
	bool
	depends on 440GX || 440SP || 440SPE
	default y

config BIOS_FIXUP
	bool
	depends on BUBINGA || EP405 || SYCAMORE || WALNUT || CPCI405
	default y

# OAK doesn't exist but wanted to keep this around for any future 403GCX boards
config 403GCX
	bool
	depends on OAK
	default y

config 405EP
	bool
	depends on BUBINGA
	default y

config 405GP
	bool
	depends on CPCI405 || EP405 || WALNUT
	default y

config 405GPR
	bool
	depends on SYCAMORE
	default y

config XILINX_VIRTEX_II_PRO
	bool
	select XILINX_VIRTEX

config XILINX_VIRTEX_5_FX
	bool
	depends on XILINX_ML507
	default y

config XILINX_VIRTEX_4_FX
	bool
	select XILINX_VIRTEX

config XILINX_VIRTEX
	bool
	select XILINX_DRIVERS

config XILINX_EMBED_CONFIG
	bool

config STB03xxx
	bool
	depends on REDWOOD_5 || REDWOOD_6
	default y

config EMBEDDEDBOOT
	bool
	depends on EP405 || XILINX_ML300 || XILINX_ML403 || XILINX_ML507
	default y

config IBM_OPENBIOS
	bool
	depends on ASH || REDWOOD_5 || REDWOOD_6
	default y

config PPC4xx_DMA
	bool "PPC4xx DMA controller support"
	depends on 4xx

config PPC4xx_EDMA
	bool
	depends on !STB03xxx && PPC4xx_DMA
	default y

config PPC_GEN550
	bool
	depends on 4xx
	default y

choice
	prompt "TTYS0 device and default console"
	depends on 40x || 44x
	default UART0_TTYS0

config UART0_TTYS0
	bool "UART0"

config UART0_TTYS1
	bool "UART1"

endchoice

config SERIAL_SICC
	bool "SICC Serial port support"
	depends on STB03xxx

config UART1_DFLT_CONSOLE
	bool
	depends on SERIAL_SICC && UART0_TTYS1
	default y

config SERIAL_SICC_CONSOLE
	bool
	depends on SERIAL_SICC && UART0_TTYS1
	default y
endmenu
```

## drivers/clk/zynqmp/Kconfig
```kconfig
config COMMON_CLK_ZYNQMP
	bool "Support for Xilinx ZynqMP Ultrascale+ clock controllers"
	depends on OF
	depends on ARCH_ZYNQMP || COMPILE_TEST
	help
	  Support for the Zynqmp Ultrascale clock controller.
	  It has a dependency on the PMU firmware.
	  Say Y if you want to support clock support
```

## drivers/dma/xilinx/Kconfig
```kconfig
#
# XILINX DMA Engines configuration
#

menuconfig XILINX_DMA_ENGINES
	bool "Xilinx DMA Engines"
	help
	  Enable support for the Xilinx DMA controllers. It supports three DMA
	  engines: Axi Central DMA (memory to memory transfer), Axi DMA (memory and
	  device transfer), and Axi VDMA (memory and video device transfer).

if XILINX_DMA_ENGINES

config XILINX_DPDMA
	tristate "Xilinx DPDMA Engine"
	select DMA_ENGINE
	help
	  Enable support for Xilinx DisplayPort DMA.

config XILINX_DPDMA_DEBUG_FS
	bool "Xilinx DPDMA debugfs"
	depends on DEBUG_FS && XILINX_DPDMA
	help
	  Enable the debugfs code for DPDMA driver. The debugfs code
	  enables debugging or testing related features. It exposes some
	  low level controls to the user space to help testing automation,
	  as well as can enable additional diagnostic or statistical
	  information.

endif # XILINX_DMA_ENGINES

config XILINX_FRMBUF
	tristate "Xilinx Framebuffer"
	select DMA_ENGINE
	help
	 Enable support for Xilinx Framebuffer DMA.
```

## drivers/firmware/xilinx/Kconfig
```kconfig
# SPDX-License-Identifier: GPL-2.0+
# Kconfig for Xilinx firmwares

source "drivers/firmware/xilinx/zynqmp/Kconfig"
```

## drivers/firmware/xilinx/zynqmp/Kconfig
```kconfig
# SPDX-License-Identifier: GPL-2.0+
# Kconfig for Xilinx ZynqMP firmware

menu "Zynq MPSoC Firmware Drivers"
	depends on ARCH_ZYNQMP

config ZYNQMP_FIRMWARE
	bool "Enable Xilinx Zynq MPSoC firmware interface"
	help
	  Firmware interface driver is used by different to
	  communicate with the firmware for various platform
	  management services.
	  Say yes to enable ZynqMP firmware interface driver.
	  In doubt, say N

config ZYNQMP_FIRMWARE_DEBUG
	bool "Enable Xilinx Zynq MPSoC firmware debug APIs"
	depends on ZYNQMP_FIRMWARE && DEBUG_FS
	help
	  Say yes to enable ZynqMP firmware interface debug APIs.
	  In doubt, say N

endmenu
```
