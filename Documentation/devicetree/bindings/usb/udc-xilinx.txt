## Documentation/devicetree/bindings/usb/udc-xilinx.txt
```
Xilinx USB2 device controller

Required properties:
- compatible		: Should be "xlnx,usb2-device-4.00.a"
- reg			: Physical base address and size of the USB2
			  device registers map.
- interrupts		: Should contain single irq line of USB2 device
			  controller
- xlnx,has-builtin-dma	: If DMA is included

Optional properties:
- clock-names		: Should be  "s_axi_aclk"
- clocks		: Input clock specifier. Refer to common clock bindings.

Example:
		axi-usb2-device@42e00000 {
			compatible = "xlnx,usb2-device-4.00.a";
			interrupts = <0x0 0x39 0x1>;
			reg = <0x42e00000 0x10000>;
			xlnx,has-builtin-dma;
		};
```

## Documentation/devicetree/bindings/usb/ulpi-phy.yaml
```yaml
# SPDX-License-Identifier: (GPL-2.0-only OR BSD-2-Clause)
%YAML 1.2
---
$id: http://devicetree.org/schemas/usb/ulpi-phy.yaml#
$schema: http://devicetree.org/meta-schemas/core.yaml#

title: ULPI PHY- Generic platform

maintainers:
  - Piyush Mehta <piyush.mehta@amd.com>

properties:
  compatible:
    const: ulpi-phy

  reg:
    maxItems: 1

  '#phy-cells':
    const: 0

  external-drv-vbus:
    description:
      If present, configure ulpi-phy external supply to drive 5V on VBus.
    type: boolean

  view-port:
    $ref: /schemas/types.yaml#/definitions/uint32
    description:
      Address to read and write PHY registers with explicit control of
      the address and data using the usb.VIEWPORT register.

required:
  - compatible
  - reg
  - view-port

additionalProperties: false

examples:
  - |
    phy0@e0002000 {
        compatible = "ulpi-phy";
        #phy-cells = <0x00>;
        reg = <0xe0002000 0x1000>;
        view-port = <0x170>;
        external-drv-vbus;
    };
```

## Documentation/devicetree/bindings/video/xilinx-fb.txt
```
Xilinx Axi TFT controller Device Tree Bindings
---------------------------------------------------------

Required properties:
- compatible		: Can be any of the following
			  "xlnx,xps-tft-1.00.a","xlnx,xps-tft-2.00.a",
			  "xlnx,xps-tft-2.01.a","xlnx,plb-tft-cntlr-ref-1.00.a",
			  "xlnx,plb-dvi-cntlr-ref-1.00.c"
- reg			: Physical base address and size of the Axi Tft
			  registers map
- interrupts		: Property with a value describing the interrupt
			  number
- interrupt-parent	: Must be core interrupt controller
- xlnx,dcr-splb-slave-if :	Accessing TFT Controller through Bus or DCR interface.
				for BUS its value is 1 and for DCR it is 0.
				default is BUS i.e. 1
- resolution :	<xres yres> pixel resolution of framebuffer.Some
		implementations use a different resolution
- virtual-resolution :	<xvirt yvirt> Size of framebuffer in memory.
- rotate-display :	(empty) rotate display 180 degrees
- phys-size :	<screen_width_mm screen_height_mm> width and heigth of
		screen

Example:
axi_tft_0: axi_tft@44a00000 {
	compatible = "xlnx,xps-tft-1.00.a";
	interrupt-parent = <&axi_intc>;
	interrupts = <1 0>;
	reg = <0x44a00000 0x10000>;
	xlnx,dcr-splb-slave-if = <0x1>;
	resolution = <640 480>;
	virtual-resolution = <1024 480>;
	phys-size = <1024 512>;
	rotate-display;
};
```

## Documentation/devicetree/bindings/watchdog/cadence-wdt.txt
```
Zynq Watchdog Device Tree Bindings
-------------------------------------------

Required properties:
- compatible		: Should be "xlnx,zynq-wdt-r1p2" or "cdns,wdt-r1p2".
- clocks		: Clock phandles (see clock bindings for details).
- reg			: Physical base address and size of WDT registers map.
- interrupts		: Property with a value describing the interrupt
			  number.
- interrupt-parent	: Must be core interrupt controller.

Optional properties
- reset			: Reset interrupt.
- timeout-sec		: Watchdog timeout value (in seconds).

Example:

		wdt@f8005000 {
			compatible = "xlnx,zynq-wdt-r1p2";
			clocks = <&clkc 45>;
			interrupt-parent = <&intc>;
			interrupts = <0 9 1>;
			reg = <0xf8005000 0x1000>;
			reset = <0>;
			timeout-sec = <10>;
		} ;
```

## Documentation/devicetree/bindings/watchdog/of-xilinx-wdt.txt
```
Xilinx AXI/PLB soft-core watchdog and window watchdog Device Tree Bindings
--------------------------------------------------------------------------

Required properties:
- compatible		: Should be "xlnx,xps-timebase-wdt-1.00.a" or
			  "xlnx,xps-timebase-wdt-1.01.a" or
			  "xlnx,versal-wwdt-1.0".
- reg			: Physical base address and size

Optional properties:
- clocks		: Input clock specifier. Refer to common clock
			  bindings.
- clock-frequency	: Frequency of clock in Hz

Optional properties for AXI/PLB soft-core watchdog:
- xlnx,wdt-enable-once	: 0 - Watchdog can be restarted
			  1 - Watchdog can be enabled just once
- xlnx,wdt-interval	: Watchdog timeout interval in 2^<val> clock cycles,
			  <val> is integer from 8 to 31.

Optional properties for window watchdog:
- timeout-sec          : Watchdog timeout value (in seconds).
			 if unset, the default timeout is 10 seconds.
- pretimeout-sec	: Watchdog pretimeout value in seconds.
- interrupts		: IRQ line for the WWDT.
- interrupt-names	: Interrupt line names "wdt" or "wwdt_reset_pending".
			  wdt - will assert high after first (closed) window
			  timer expires. wwdt_reset_pending - will assert high
			  after second (open) window timer expires if WRP
			  (Watchdog Reset pending) is configured with third
			  (SST) timer.

Example:
Xilinx AXI/PLB soft-core watchdog:
axi-timebase-wdt@40100000 {
	clock-frequency = <50000000>;
	compatible = "xlnx,xps-timebase-wdt-1.00.a";
	clocks = <&clkc 15>;
	reg = <0x40100000 0x10000>;
	xlnx,wdt-enable-once = <0x0>;
	xlnx,wdt-interval = <0x1b>;
} ;

Xilinx Versal window watchdog:
watchdog@fd4d0000 {
	compatible = "xlnx,versal-wwdt-1.0";
	reg = <0x0 0xfd4d0000 0x0 0x10000>;
	clocks = <&clk25>;
	timeout-sec = <10>;
	interrupt-names = "wdt", "wwdt_reset_pending";
	interrupts = <0x0 0x64 0x1>, <0x0 0x6D 0x1>;
	pretimeout-sec = <5>;
} ;
```

## Documentation/devicetree/bindings/watchdog/xlnx,xps-timebase.yaml
```yaml
# SPDX-License-Identifier: GPL-2.0-or-later OR BSD-2-Clause
%YAML 1.2
---
$id: http://devicetree.org/schemas/watchdog/xlnx,timebase.yaml#
$schema: http://devicetree.org/meta-schemas/core.yaml#

title: Xilinx AXI/PLB softcore and window Watchdog Timer

allOf:
  - $ref: "watchdog.yaml#"

maintainers:
  - Shubhrajyoti Datta <shubhrajyoti.datta@xilinx.com>

properties:
  compatible:
    oneOf:
      - items:
          - enum:
              - xlnx,xps-timebase-wdt-1.01.a
              - xlnx,xps-timebase-wdt-1.00.a
              - xlnx,versal-wwdt-1.0

  reg:
    maxItems: 1

  clocks:
    minItems: 1

  clock-frequency:
    $ref: /schemas/types.yaml#/definitions/uint32-array
    description: |
        Frequency of clock in Hz

  xlnx,wdt-interval:
    $ref: /schemas/types.yaml#/definitions/uint32-array
    description: |
        Watchdog interval

  xlnx,wdt-enable-once:
    allOf:
      - $ref: /schemas/types.yaml#/definitions/uint32-array
      - enum: [0, 1]
    description: |
        Watchdog enable once


required:
  - compatible
  - reg

additionalProperties: false

examples:
  - |
    watchdog@40100000 {
      clock-frequency = <50000000>;
      compatible = "xlnx,xps-timebase-wdt-1.00.a";
      clocks = <&clkc 15>;
      reg = <0x40100000 0x1000>;
      xlnx,wdt-enable-once = <0x0>;
      xlnx,wdt-interval = <0x1b>;
    } ;
...
```

## Documentation/devicetree/bindings/xlnx,ctrl-fb.txt
```
The Xilinx framebuffer DMA engine supports two soft IP blocks: one IP
block is used for reading video frame data from memory (FB Read) to the device
and the other IP block is used for writing video frame data from the device
to memory (FB Write).  Both the FB Read/Write IP blocks are aware of the
format of the data being written to or read from memory including RGB and
YUV in packed, planar, and semi-planar formats.  Because the FB Read/Write
is format aware, only one buffer pointer is needed by the IP blocks even
when planar or semi-planar format are used.

Required properties:
 - compatible: Should be "xlnx,ctrl-fbwr-1.0" for framebuffer Write OR
	       "xlnx,ctrl-fbrd-1.0" for framebuffer Read.
 - reg: Base address and size of the IP core.
 - reset-gpios: gpio to reset the framebuffer IP

Example:

        fbwr@0xa0000000 {
                compatible = "xlnx,ctrl-fbwr-1.0";
                reg = <0x0 0xa0000000 0x0 0x10000>;
                reset-gpios = <&gpio 82 1>;
        };
```

## Documentation/devicetree/bindings/xlnx,ctrl-vpss.txt
```
The Xilinx VPSS Scaler is a Video IP that supports up scaling, down scaling and
no scaling functionailty along with color space conversion. This supports custom
resolution values between 0 to 4096.

Required properties:

- compatible: Must be "xlnx,ctrl-xvpss-1.0".
- reg: Base address and size of the IP core.
- reset-gpios: gpio to reset the framebuffer IP
- xlnx,vpss-taps: number of taps
- xlnx,vpss-ppc: pixels per clock

Example:

        ctrlvpss: vpss@0xa0200000 {
                compatible = "xlnx,ctrl-xvpss-1.0";
                reg = <0x0 0xa0200000 0x0 0x30000>;
                reset-gpios = <&gpio 80 1>;
                xlnx,vpss-taps = <6>;
                xlnx,vpss-ppc = <2>;
        };
```

## arch/arm/configs/xilinx_zynq_apf_defconfig
```kconfig
CONFIG_CROSS_COMPILE="arm-xilinx-linux-gnueabi-"
CONFIG_LOCALVERSION="-xilinx-trd"
CONFIG_SYSVIPC=y
CONFIG_IRQ_DOMAIN_DEBUG=y
CONFIG_NO_HZ=y
CONFIG_HIGH_RES_TIMERS=y
CONFIG_IKCONFIG=y
CONFIG_IKCONFIG_PROC=y
CONFIG_LOG_BUF_SHIFT=14
CONFIG_SYSFS_DEPRECATED=y
CONFIG_SYSFS_DEPRECATED_V2=y
CONFIG_BLK_DEV_INITRD=y
CONFIG_CC_OPTIMIZE_FOR_SIZE=y
CONFIG_SYSCTL_SYSCALL=y
CONFIG_EMBEDDED=y
CONFIG_PERF_EVENTS=y
CONFIG_SLAB=y
CONFIG_MODULES=y
CONFIG_MODULE_UNLOAD=y
CONFIG_MODULE_FORCE_UNLOAD=y
CONFIG_MODVERSIONS=y
# CONFIG_BLK_DEV_BSG is not set
CONFIG_GPIO_PCA953X=y
CONFIG_ARCH_VEXPRESS=y
CONFIG_ARCH_ZYNQ=y
CONFIG_XILINX_AXIPCIE=y
CONFIG_PL310_ERRATA_588369=y
CONFIG_PL310_ERRATA_727915=y
CONFIG_ARM_ERRATA_754322=y
CONFIG_ARM_ERRATA_754327=y
CONFIG_ARM_ERRATA_764369=y
CONFIG_PL310_ERRATA_769419=y
CONFIG_ARM_ERRATA_775420=y
CONFIG_PCI_MSI=y
CONFIG_SMP=y
CONFIG_SCHED_MC=y
CONFIG_SCHED_SMT=y
CONFIG_PREEMPT=y
CONFIG_AEABI=y
CONFIG_HIGHMEM=y
# CONFIG_COMPACTION is not set
CONFIG_CMA=y
CONFIG_ZBOOT_ROM_TEXT=0x0
CONFIG_ZBOOT_ROM_BSS=0x0
CONFIG_CMDLINE="console=ttyPS0,115200n8 root=/dev/ram rw initrd=0x00800000,16M earlyprintk mtdparts=physmap-flash.0:512K(nor-fsbl),512K(nor-u-boot),5M(nor-linux),9M(nor-user),1M(nor-scratch),-(nor-rootfs)"
CONFIG_CPU_FREQ=y
CONFIG_CPU_FREQ_STAT_DETAILS=y
CONFIG_CPU_FREQ_DEFAULT_GOV_USERSPACE=y
CONFIG_CPU_FREQ_GOV_PERFORMANCE=y
CONFIG_CPU_FREQ_GOV_POWERSAVE=y
CONFIG_CPU_FREQ_GOV_ONDEMAND=y
CONFIG_CPU_FREQ_GOV_CONSERVATIVE=y
CONFIG_VFP=y
CONFIG_NEON=y
# CONFIG_CORE_DUMP_DEFAULT_ELF_HEADERS is not set
# CONFIG_SUSPEND is not set
CONFIG_PM_RUNTIME=y
CONFIG_NET=y
CONFIG_PACKET=y
CONFIG_UNIX=y
CONFIG_INET=y
CONFIG_IP_MULTICAST=y
CONFIG_IP_PNP=y
CONFIG_IP_PNP_DHCP=y
CONFIG_IP_PNP_BOOTP=y
CONFIG_IP_PNP_RARP=y
CONFIG_NET_IPIP=m
CONFIG_VLAN_8021Q=m
CONFIG_UEVENT_HELPER_PATH="/sbin/hotplug"
CONFIG_DEVTMPFS=y
CONFIG_DEVTMPFS_MOUNT=y
CONFIG_DMA_CMA=y
CONFIG_CMA_SIZE_MBYTES=256
CONFIG_CONNECTOR=y
CONFIG_MTD=y
CONFIG_MTD_CMDLINE_PARTS=y
CONFIG_MTD_BLOCK=y
CONFIG_MTD_CFI=y
CONFIG_MTD_CFI_AMDSTD=y
CONFIG_MTD_PHYSMAP=y
CONFIG_MTD_PHYSMAP_OF=y
CONFIG_MTD_M25P80=y
CONFIG_MTD_NAND=y
CONFIG_MTD_NAND_PL353=y
CONFIG_PROC_DEVICETREE=y
CONFIG_BLK_DEV_LOOP=y
CONFIG_BLK_DEV_RAM=y
CONFIG_BLK_DEV_RAM_SIZE=16384
CONFIG_EEPROM_AT24=y
CONFIG_EEPROM_AT25=y
CONFIG_SCSI=y
CONFIG_BLK_DEV_SD=y
CONFIG_CHR_DEV_SG=y
CONFIG_SCSI_MULTI_LUN=y
CONFIG_NETDEVICES=y
# CONFIG_NET_VENDOR_3COM is not set
# CONFIG_NET_VENDOR_ADAPTEC is not set
# CONFIG_NET_VENDOR_ALTEON is not set
# CONFIG_NET_VENDOR_AMD is not set
# CONFIG_NET_VENDOR_ATHEROS is not set
CONFIG_TIGON3=y
# CONFIG_NET_VENDOR_BROCADE is not set
# CONFIG_NET_VENDOR_CHELSIO is not set
# CONFIG_NET_VENDOR_CIRRUS is not set
# CONFIG_NET_VENDOR_CISCO is not set
# CONFIG_NET_VENDOR_DEC is not set
# CONFIG_NET_VENDOR_DLINK is not set
# CONFIG_NET_VENDOR_EMULEX is not set
# CONFIG_NET_VENDOR_EXAR is not set
# CONFIG_NET_VENDOR_FARADAY is not set
# CONFIG_NET_VENDOR_HP is not set
CONFIG_E1000E=y
# CONFIG_NET_VENDOR_MARVELL is not set
# CONFIG_NET_VENDOR_MELLANOX is not set
# CONFIG_NET_VENDOR_MICREL is not set
# CONFIG_NET_VENDOR_MICROCHIP is not set
# CONFIG_NET_VENDOR_MYRI is not set
# CONFIG_NET_VENDOR_NATSEMI is not set
# CONFIG_NET_VENDOR_NVIDIA is not set
# CONFIG_NET_VENDOR_OKI is not set
# CONFIG_NET_PACKET_ENGINE is not set
# CONFIG_NET_VENDOR_QLOGIC is not set
CONFIG_R8169=y
# CONFIG_NET_VENDOR_RDC is not set
# CONFIG_NET_VENDOR_SEEQ is not set
# CONFIG_NET_VENDOR_SILAN is not set
# CONFIG_NET_VENDOR_SIS is not set
# CONFIG_NET_VENDOR_SMSC is not set
# CONFIG_NET_VENDOR_STMICRO is not set
# CONFIG_NET_VENDOR_SUN is not set
# CONFIG_NET_VENDOR_TEHUTI is not set
# CONFIG_NET_VENDOR_TI is not set
# CONFIG_NET_VENDOR_VIA is not set
# CONFIG_NET_VENDOR_WIZNET is not set
CONFIG_XILINX_EMACLITE=y
CONFIG_XILINX_AXI_EMAC=y
CONFIG_XILINX_PS_EMAC=y
CONFIG_MARVELL_PHY=y
CONFIG_VITESSE_PHY=y
CONFIG_MDIO_BITBANG=y
CONFIG_INPUT_SPARSEKMAP=y
CONFIG_INPUT_EVDEV=y
# CONFIG_LEGACY_PTYS is not set
# CONFIG_DEVKMEM is not set
CONFIG_SERIAL_XILINX_PS_UART=y
CONFIG_SERIAL_XILINX_PS_UART_CONSOLE=y
# CONFIG_HW_RANDOM is not set
CONFIG_XILINX_DEVCFG=y
CONFIG_I2C_CHARDEV=y
CONFIG_I2C_MUX=y
CONFIG_I2C_MUX_PCA954x=y
CONFIG_I2C_CADENCE=y
CONFIG_SPI=y
CONFIG_SPI_CADENCE=y
CONFIG_SPI_ZYNQ_QSPI=y
CONFIG_GPIO_SYSFS=y
CONFIG_GPIO_ZYNQ=y
CONFIG_SENSORS_XADCPS=y
CONFIG_WATCHDOG=y
CONFIG_CADENCE_WATCHDOG=y
CONFIG_MEDIA_SUPPORT=y
CONFIG_MEDIA_CAMERA_SUPPORT=y
CONFIG_MEDIA_CONTROLLER=y
CONFIG_VIDEO_V4L2_SUBDEV_API=y
CONFIG_V4L_PLATFORM_DRIVERS=y
# CONFIG_MEDIA_SUBDRV_AUTOSELECT is not set
CONFIG_VIDEO_ADV7604=y
CONFIG_VIDEO_ADV7511=y
# CONFIG_DVB_AU8522_V4L is not set
# CONFIG_DVB_TUNER_DIB0070 is not set
# CONFIG_DVB_TUNER_DIB0090 is not set
CONFIG_FB=y
CONFIG_FB_XYLON=y
CONFIG_FB_XYLON_OF=y
CONFIG_FB_XYLON_PIXCLK=y
CONFIG_FB_XYLON_PIXCLK_SI570=y
CONFIG_FB_XYLON_MISC=y
CONFIG_FB_XYLON_MISC_ADV7511=y
CONFIG_FRAMEBUFFER_CONSOLE=y
CONFIG_HID_MICROSOFT=y
CONFIG_USB=y
CONFIG_USB_OTG=y
# CONFIG_USB_OTG_WHITELIST is not set
CONFIG_USB_EHCI_HCD=y
# CONFIG_USB_EHCI_TT_NEWSCHED is not set
CONFIG_USB_EHCI_ZYNQ=y
CONFIG_USB_STORAGE=y
CONFIG_USB_GADGET=y
CONFIG_USB_ZYNQ_ERRATA_DT654401=y
CONFIG_USB_ZERO=m
CONFIG_MMC=y
CONFIG_MMC_SDHCI=y
CONFIG_MMC_SDHCI_PLTFM=y
CONFIG_MMC_SDHCI_OF_ARASAN=y
CONFIG_EDAC=y
CONFIG_EDAC_MM_EDAC=y
CONFIG_EDAC_ZYNQ=y
CONFIG_RTC_CLASS=y
CONFIG_RTC_DRV_PCF8563=y
CONFIG_DMADEVICES=y
CONFIG_XILINX_DMA_ENGINES=y
CONFIG_XILINX_AXIDMA=y
CONFIG_XILINX_AXIVDMA=y
CONFIG_XILINX_AXICDMA=y
CONFIG_PL330_DMA=y
CONFIG_UIO=y
CONFIG_UIO_PDRV_GENIRQ=y
CONFIG_STAGING=y
CONFIG_XILINX_VIDEO_IP=y
CONFIG_XILINX_VDMA_WRAPPER=y
CONFIG_XILINX_APF=y
CONFIG_XILINX_DMA_APF=y
CONFIG_COMMON_CLK_DEBUG=y
CONFIG_MEMORY=y
CONFIG_EXT2_FS=y
CONFIG_EXT3_FS=y
# CONFIG_EXT3_DEFAULTS_TO_ORDERED is not set
CONFIG_EXT4_FS=y
# CONFIG_DNOTIFY is not set
CONFIG_MSDOS_FS=y
CONFIG_VFAT_FS=y
CONFIG_TMPFS=y
CONFIG_JFFS2_FS=y
CONFIG_JFFS2_SUMMARY=y
CONFIG_NFS_FS=y
CONFIG_ROOT_NFS=y
CONFIG_NLS_CODEPAGE_437=y
CONFIG_NLS_ASCII=y
CONFIG_NLS_ISO8859_1=y
CONFIG_DYNAMIC_DEBUG=y
# CONFIG_ENABLE_WARN_DEPRECATED is not set
# CONFIG_ENABLE_MUST_CHECK is not set
# CONFIG_SCHED_DEBUG is not set
CONFIG_TIMER_STATS=y
# CONFIG_DEBUG_PREEMPT is not set
# CONFIG_DEBUG_BUGVERBOSE is not set
CONFIG_RCU_CPU_STALL_TIMEOUT=60
# CONFIG_RCU_CPU_STALL_VERBOSE is not set
# CONFIG_FTRACE is not set
CONFIG_DEBUG_LL=y
CONFIG_DEBUG_ZYNQ_UART1=y
CONFIG_EARLY_PRINTK=y
CONFIG_FONTS=y
CONFIG_FONT_8x8=y
CONFIG_FONT_8x16=y
```
