## arch/arm/mach-ks8695/Kconfig
```kconfig
menu "Kendin-Micrel KS8695 Implementation Options"
	depends on ARCH_KS8695

comment "KS8695 Platforms"

config MACH_KS8695
	bool "KS8695 development board"
	help
	  Say 'Y' here if you want your kernel to run on the original
	  Kendin-Micrel KS8695 development board.

config MACH_DSM320
	bool "DLink DSM320 Media Player"
	help
	  Say 'Y' here if you want your kernel to run on the DLink DSM320
	  Media Player.

config MACH_CM4002
	bool "OpenGear CM4002"
	help
	  Say 'Y' here if you want your kernel to support the OpenGear
	  CM4002 Secure Access Server. See http://www.opengear.com for
	  more details.

config MACH_CM4008
	bool "OpenGear CM4008"
	help
	  Say 'Y' here if you want your kernel to support the OpenGear
	  CM4008 Console Server. See http://www.opengear.com for more
	  details.

config MACH_CM40xx
	bool "OpenGear CM40xx"
	help
	  Say 'Y' here if you want your kernel to support the OpenGear
	  CM4016 or CM4048 Console Servers. See http://www.opengear.com for
	  more details.

config MACH_LITE300
	bool "Secure Computing / CyberGuard SG300"
	help
	  Say 'Y' here if you want your kernel to support the Secure
	  Computing / CyberGuard / SnapGear SG300 VPN Internet Router.
	  See http://www.securecomputing.com for more details.

config MACH_SE4200
	bool "Secure Computing / CyberGuard SE4200"
	help
	  Say 'Y' here if you want your kernel to support the Secure
	  Computing / CyberGuard / SnapGear SE4200 Secure Wireless VPN
	  Internet Router. See http://www.securecomputing.com for more
	  details.

endmenu
```

## arch/arm/mach-lpc22xx/Kconfig
```kconfig
#	linux/arch/arm/mach-lpc22xx/Kconfig	
#	Copyright (C) 2004 Philips Semiconductors
#


menu "LPC22xx Options"
	depends on ARCH_LPC22XX

config MACH_LPC22XX
	bool
	default y
	help
		Phillips LPC22XX Family

config ARCH_SUPPORTS_BIG_ENDIAN
    bool "Default Big Endian mode"
    default n
	help
	LPC22xx core supports LITTLE-ENDIAN only,
	both for CPU core and the external memory access.

config LPC22xx_Fosc
    int	"Oscillator Frequency"
    default 10000000
    help
	Oscillator frequency. The defualt is 10MHz. 
	Change it according to your board.
	(PhyCORE HD200 Dev board(LPC22xx) use 10MHZ Oscillator)
	
config ARM_CLK
	int 'Arm Core Clock'
	default 40000000
	help
	CPU core clock frequency. The default is 40MHz.
	Change it according to your application needs.

config SKIP_DUMP_CPU_INFO
	bool
	default	y 
	help
	LPC22xx(ARM7TDMI) core has no cache and does not support cache size
	recognition instructions which uses MMU features.

config REMAP_VECTORS_TO_RAM
	bool "Remap Vectors to external RAM"
	default n
	help
	LPC22xx suppports ROM and RAM remap function. 

endmenu
```

## arch/arm/mach-p2001/Kconfig
```kconfig
if ARCH_P2001

menu "P2001 Options"
	depends on ARCH_P2001

config SYSCLK
	int 'SysClk'
	default 73728000
	help
	  The default sysclk is 73.728 MHz. For the ethernet unit to
	  work more than 25 MHz are needed. Overclocking starts at
	  75 MHz. The following system clock frequencies are allowed:
	   12288000:  12.288 MHz
	   24576000:  24.576 MHz
	   36864000:  36.864 MHz
	   49152000:  49.152 MHz
	   61440000:  61.440 MHz
	   73728000:  73.728 MHz
	   86016000:  86.016 MHz
	   98304000:  98.304 MHz
	  110592000: 110.592 MHz

config P2001_AUTO_DETECT_SDRAM
	bool 'Automatic SDRAM detection'
	default y
	help
	  The automatic SDRAM detection is done by writing at each
	  memory bank. The memory is over, when a read/write error
	  occured or a wrap to the first memory bank is detected.

	  The search area is specified by CONFIG_DRAM_BASE and
	  CONFIG_DRAM_SIZE !

	  The P2001 can have up to 64 MB SDRAM. So just keep the
	  default values:
	  CONFIG_DRAM_BASE = 0x40000000
	  CONFIG_DRAM_SIZE = 0x04000000 = SZ_64M

config SKIP_DUMP_CPU_INFO
	bool
	default y
	help
	  ARM9TDMI cores do not support cache size
	  recognition instructions which use MMU features.

config P2001_WATCHDOG
	bool 'P2001 watchdog timer support'
	default y
	help
	  Activate P2001 watchdog timer with reset in idle function.

config P2001_TIMER2_LED_FREQ_INDICATOR
	bool 'P2001 timer2 led frequency indicator'
	default y
	help
	  Use timer2 interrupt to blink leds with 10 Hz at 73.728 MHz.
	  Lower SYSCLK scales down blinking as well.

endmenu

endif
```

## arch/arm/mach-s3c24a0/Kconfig
```kconfig
if ARCH_S3C24A0

menu "S3C24A0 Implementations" 

config ARCH_SMDK24A0 
        bool "Meritek SMDK24A0" 
     
config ARCH_SPJ
        depends on ARCH_SMDK24A0 
        bool "Bluetek SPJ Daughter Board for SMDK24A0" 
endmenu 

endif 
```

## arch/arm/mach-s3c3410/Kconfig
```kconfig
menu "S3C3410 Options"
	depends on ARCH_S3C3410

config ARCH_SUPPORTS_BIG_ENDIAN
        bool
        default y
	help
	S3C3410 core supports BIG-ENDIAN only,
	both for CPU core and the external memory access.

config ARM_CLK
	int 'Arm Core Clock'
	default 40000000
	help
	the default host clock of SMDK40100 is 40MHz.
	otherwise, change the value in clock.

config SKIP_DUMP_CPU_INFO
	bool
	default y
	help
	S3C3410(ARM7TDMI) core does not support cache size
	recognition instructions which uses MMU features.

config REMAP_VECTORS_TO_RAM
	bool
	default y
	help
	S3C3410 core does not support ROM and RAM remap
	function. we set the trap_init to be initialized
	at the begining of DRAM_BASE.

endmenu
```

## arch/arm/mach-s3c44b0x/Kconfig
```kconfig
menu "S3C44B0X Board Options" 
	depends on ARCH_S3C44B0

config DEBUG_NICKMIT
	bool 'DEBUG_NICKMIT'
	default n

config SKIP_DUMP_CPU_INFO
	bool 'Skip Dump CPU Info'
	default y
	help
	S3C44B0X(ARM7TDMI) core does not support cache size
	recognition instructions which uses MMU features.

config REMAP_VECTORS_TO_RAM
	bool 'Remap Vectors To Ram'
	default y
	help
	S3C44B0X core does not support ROM and RAM remap
	function. we set the trap_init to be initialized
	at the begining of DRAM_BASE.

config ARM_CLK
	int 'Arm Core Clock'
	default 60000000
	help
	the default host clock of 51EDA-S3C44B0X Board is 60MHz.
	otherwise, change the value in clock.
	
config ARM_CLK_ADJUST
	bool "Arm Core Clock Adjust(EXPERIMENTAL)"
	default n && EXPERIMENTAL
	help
	use this option to adjust the CPU frequence

config ARM_CLK_FIN
	int 'External OSC Clock Frequence' 
	default 8000000
	depends on ARM_CLK_ADJUST && EXPERIMENTAL
	help
	this is the input frequence of system clock

source "arch/arm/mach-s3c44b0x/driver/Kconfig"

endmenu
```

## arch/arm/mach-s3c44b0x/driver/Kconfig
```kconfig
menu "S3C44B0X Board Driver Options" 

config SERIAL_S3C44B0X
	bool 'S3C44B0X Serial Support'
	default y
	help
	Samsung S3C44B0X Chips has built-in serial controler

config SERIAL_S3C44B0X_CONSOLE
	bool 'S3C44B0X Serial Console Support'
	depends on SERIAL_S3C44B0X
	help
	use serial port 0 as console
	
config ETH_RTL8019AS
	bool 'Realtek 8019AS NIC support'
	default n

config S3C44B0X_GPIO_LED
	bool 'Use onboard led'
	default n

endmenu
```

## arch/arm/mach-xilinx/Kconfig
```kconfig
if ARCH_XILINX

menu "Xilinx Specific Options"
config XILINX_FIXED_DEVTREE_ADDR
	tristate "Device Tree At Fixed Address"
	default y
	depends on OF
	help
	  Select if you want the kernel to assume a device tree is located at a
	  fixed address of 0x1000000 on kernel boot.  This allows the go command
	  in u-boot to be used since the bootm command is slow in the EP107.

config XILINX_TEST
	bool "Testing On Kernel Boot"
	default n
	help
	  Select if you want kernel tests to run on boot.  The tests may take
	  several minutes on kernel boot.

choice
        prompt "Xilinx CPU AMP Kernels"
	default XILINX_DEFAULT_KERNEL

config XILINX_DEFAULT_KERNEL
	bool "Run the kernel as normal"
	help
	  Select if you want a normal kernel.

config XILINX_AMP_CPU0_MASTER
	bool "Run the Kernel For AMP on CPU0"
	help
	  Select if you want to run the kernel on CPU0 while also running 
	  another kernel on CPU1 as a slave with respect to interrupt management.
	  This causes the kernel to push the 2nd set of device interrupts
	  to CPU1 so that it has it's own system.

config XILINX_AMP_CPU1_SLAVE
	bool "Run the Kernel For AMP on CPU1" 
	help
	  Select if you want to run the kernel on CPU1 while also running
	  another kernel on CPU0 as a master with respect to interrupt management.
	  This causes the kernel to not touch the GIC distributor when it initializes
	  as CPU0 takes care of it.

config XILINX_CPU1_TEST
	bool "Run the Kernel On CPU1 For Testing"
	help
	  Select if you want to run the kernel on CPU1 without running a kernel on
	  CPU0 which is really only useful for testing purposes.  The really only
	  causes interrupts in the GIC to be on CPU1 rather than CPU0.

endchoice
endmenu

endif
```
