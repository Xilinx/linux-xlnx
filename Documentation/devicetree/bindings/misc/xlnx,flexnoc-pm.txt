## Documentation/devicetree/bindings/nvmem/zynqmp_nvmem.txt
```
=  Zynq UltraScale+ MPSoC nvmem firmware driver binding =

Required properties:
- compatible: should be "xlnx,zynqmp-nvmem-fw"

= Data cells =
Are child nodes of silicon id, bindings of which as described in
bindings/nvmem/nvmem.txt

Example:

	nvmem_firmware {
		compatible = "xlnx,zynqmp-nvmem-fw";
		#address-cells = <1>;
		#size-cells = <1>;

		 /* Data cells */
		soc_revision: soc_revision@0 {
			reg = <0x0 0x4>;
		};
	};

= Data consumers =
Are device nodes which consume nvmem data cells.

For example:

	pcap {
		...
		nvmem-cells = <&soc_revision>;
		nvmem-cell-names = "soc_revision";
	};
```

## Documentation/devicetree/bindings/pci/xilinx-axipcie.txt
```
* Xilinx AXI PCIe Root Port Bridge

Required properties:
- #address-cells: Address representation for root ports, set to <3>
- #size-cells: Size representation for root ports, set to <2>
- compatible: Should be "xlnx,axi-pcie-1.05.a"
- interrupts: Should contain AXI PCIe interrupts.
- reg: Should contain AXI PCIe registers location and length.
- ranges: ranges for the PCI memory regions (I/O space region is noti
	supported by hardware)
	Please refer to the standard PCI bus binding document for a more
	detailed explanation
- xlnx,include-rc: Tells whether configured for Root Port (=1) or
	End Point(=0)
- xlnx,pciebar-num: Number of PCIe to AXI BARs configured in HW.
- xlnx,pciebar2axibar-0: Translates address from PCIe to AXI, BAR 0.
- xlnx,pciebar2axibar-1: Translates address from PCIe to AXI, BAR 1. If
	not configured in hardware it should be set to all FF's.

Optional properties:
- xlnx,device-num: Tells the instance of AXI PCIe IP.

Example:
++++++++

	pci_express: axi-pcie@50000000 {
		#address-cells = <3>;
		#size-cells = <2>;
		compatible = "xlnx,axi-pcie-1.05.a";
		interrupts = < 0 52 4 >;
		reg = < 0x50000000 0x10000000 >;
		ranges = < 0x02000000 0 0x60000000 0x60000000 0 0x10000000 >;
		xlnx,include-rc = <0x1>;
		xlnx,pciebar-num = <0x1>;
		xlnx,pciebar2axibar-0 = <0x0>;
		xlnx,pciebar2axibar-1 = <0xFFFFFFFF>;
	};
```

## Documentation/devicetree/bindings/pci/xilinx-nwl-pcie.txt
```
* Xilinx NWL PCIe Root Port Bridge DT description

Required properties:
- compatible: Should contain "xlnx,nwl-pcie-2.11"
- #address-cells: Address representation for root ports, set to <3>
- #size-cells: Size representation for root ports, set to <2>
- #interrupt-cells: specifies the number of cells needed to encode an
	interrupt source. The value must be 1.
- reg: Should contain Bridge, PCIe Controller registers location and length
- device_type: must be "pci"
- interrupts: Should contain NWL PCIe interrupt
- ranges: ranges for the PCI memory regions (I/O space region is not
	supported by hardware)
	Please refer to the standard PCI bus binding document for a more
	detailed explanation
- interrupt-map-mask and interrupt-map: standard PCI properties to define the
	mapping of the PCI interface to interrupt numbers.
- legacy-interrupt-controller: Interrupt controller device node for Legacy interrupts
	- interrupt-controller: identifies the node as an interrupt controller
	- #interrupt-cells: should be set to 1
	- #address-cells: specifies the number of cells needed to encode an
		address. The value must be 0.

Optional properties:
- xlnx,msi-fifo: To enable MSI FIFO mode

Example:
++++++++
nwl_pcie: pcie@fd0e0000 {
	compatible = "xlnx,nwl-pcie-2.11";
	#address-cells = <3>;
	#size-cells = <2>;
	#interrupt-cells = <1>;
	device_type = "pci";
	interrupt-parent = <&gic>;
	interrupts = < 0 118 4>,
		     < 0 116 4>,
		     < 0 115 4>,	/* MSI_1 [63...32] */
		     < 0 114 4 >;	/* MSI_0 [31...0] */
	interrupt-names = "misc", "intx", "msi_1", "msi_0";
	reg = <0x0 0xfd0e0000 0x1000>,
	      <0x0 0xfd480000 0x1000>,
	      <0x0 0xe0000000 0x1000000>;
	reg-names = "breg", "pcireg", "cfg";
	ranges = <0x02000000 0x00000000 0xe1000000 0x00000000 0xe1000000 0 0x0f000000>;
	interrupt-map-mask = <0x0 0x0 0x0 0x7>;
	interrupt-map = <0x0 0x0 0x0 0x1 &pcie_intc 0x1>,
			<0x0 0x0 0x0 0x2 &pcie_intc 0x2>,
			<0x0 0x0 0x0 0x3 &pcie_intc 0x3>,
			<0x0 0x0 0x0 0x4 &pcie_intc 0x4>;
	pcie_intc: legacy-interrupt-controller {
		interrupt-controller;
		#address-cells = <0>;
		#interrupt-cells = <1>;
	};
};
```

## Documentation/devicetree/bindings/pci/xilinx-xdma-pl-pcie.txt
```
* Xilinx XDMA PL PCIe Root Port Bridge DT description

Required properties:
- #address-cells: Address representation for root ports, set to <3>
- #size-cells: Size representation for root ports, set to <2>
- #interrupt-cells: specifies the number of cells needed to encode an
	interrupt source. The value must be 1.
- compatible: Should contain "xlnx,xdma-host-3.00"
- reg: Should contain XDMA PCIe registers location and length
- device_type: must be "pci"
- interrupts: Should contain AXI PCIe interrupt
- interrupt-map-mask,
  interrupt-map: standard PCI properties to define the mapping of the
	PCI interface to interrupt numbers.
- ranges: ranges for the PCI memory regions (I/O space region is not
	supported by hardware)
	Please refer to the standard PCI bus binding document for a more
	detailed explanation

For MSI DECODE mode:
- interrupt-names: Must include the following entries:
	"misc": interrupt asserted when legacy or error interrupt is received
	"msi1, msi0": interrupt asserted when an MSI is received

Interrupt controller child node
+++++++++++++++++++++++++++++++
Required properties:
- interrupt-controller: identifies the node as an interrupt controller
- #address-cells: specifies the number of cells needed to encode an
	address. The value must be 0.
- #interrupt-cells: specifies the number of cells needed to encode an
	interrupt source. The value must be 1.

NOTE:
The core provides a single interrupt for both INTx/MSI messages. So,
created a interrupt controller node to support 'interrupt-map' DT
functionality.  The driver will create an IRQ domain for this map, decode
the four INTx interrupts in ISR and route them to this domain.


Example:
++++++++
MSI FIFO mode:
	xdma_0: axi-pcie@a0000000 {
		#address-cells = <3>;
		#interrupt-cells = <1>;
		#size-cells = <2>;
		compatible = "xlnx,xdma-host-3.00";
		device_type = "pci";
		interrupt-map = <0 0 0 1 &pcie_intc_0 1>,
				<0 0 0 2 &pcie_intc_0 2>,
				<0 0 0 3 &pcie_intc_0 3>,
				<0 0 0 4 &pcie_intc_0 4>;
		interrupt-map-mask = <0 0 0 7>;
		interrupt-parent = <&gic>;
		interrupts = <0 89 4>;
		ranges = <0x02000000 0x00000000 0xB0000000 0x0 0xB0000000 0x00000000 0x01000000>,
			<0x43000000 0x00000005 0x00000000 0x00000005 0x00000000 0x00000000 0x01000000>;
		reg = <0x0 0xA0000000 0x0 0x10000000>;
		pcie_intc_0: interrupt-controller {
			#address-cells = <0>;
			#interrupt-cells = <1>;
			interrupt-controller ;
		};
	};

MSI DECODE mode:
	xdma_0: axi-pcie@a0000000 {
		#address-cells = <3>;
		#interrupt-cells = <1>;
		#size-cells = <2>;
		compatible = "xlnx,xdma-host-3.00";
		device_type = "pci";
		interrupt-map = <0 0 0 1 &pcie_intc_0 1>, <0 0 0 2 &pcie_intc_0 2>, <0 0 0 3 &pcie_intc_0 3>, <0 0 0 4 &pcie_intc_0 4>;
		interrupt-map-mask = <0 0 0 7>;
		interrupt-parent = <&gic>;
		interrupt-names = "misc", "msi0", "msi1";
		interrupts = <0 89 4>, <0 90 4>, <0 91 4>;
		ranges = <0x02000000 0x00000000 0xB0000000 0x0 0xB0000000 0x00000000 0x01000000>,
			<0x43000000 0x00000005 0x00000000 0x00000005 0x00000000 0x00000000 0x01000000>;
		reg = <0x0 0xA0000000 0x0 0x10000000>;
		pcie_intc_0: interrupt-controller {
			#address-cells = <0>;
			#interrupt-cells = <1>;
			interrupt-controller ;
		};
	};

Versal CPM host Bridge DT description.

The properties and their meanings are identical to those described in
above Xilinx XDMA PL PCIe Root Port Bridge description.

Properties that differ are:
- compatible: Should contain "xlnx,versal-cpm-host-1.00"
- reg: Should contain configuration space and CPM system level control and
	status registers, and length
- reg-names: Must include the following entries:
	"cfg": configuration space region
	"cpm_slcr": CPM system level control and status registers
- msi-map: Maps a Requester ID to an MSI controller and associated MSI
	sideband data

Refer to the following binding document for more detailed description on
the use of 'msi-map':
	 Documentation/devicetree/bindings/pci/pci-msi.txt

Example:
	pci@fca10000 {
		#address-cells = <3>;
		#interrupt-cells = <1>;
		#size-cells = <2>;
		compatible = "xlnx,versal-cpm-host-1.00";
		interrupt-map = <0 0 0 1 &pcie_intc_0 1>,
				<0 0 0 2 &pcie_intc_0 2>,
				<0 0 0 3 &pcie_intc_0 3>,
				<0 0 0 4 &pcie_intc_0 4>;
		interrupt-map-mask = <0 0 0 7>;
		interrupt-parent = <&gic>;
		interrupt-names = "misc";
		interrupts = <0 72 4>;
		ranges = <0x02000000 0x00000000 0xE0000000 0x0 0xE0000000 0x00000000 0x10000000>,
			 <0x43000000 0x00000080 0x00000000 0x00000080 0x00000000 0x00000000 0x80000000>;
		msi-map = <0x0 &its_gic 0x0 0x10000>;
		reg = <0x0 0xfca10000 0x0 0x1000>,
		      <0x6 0x00000000 0x0 0x1000000>;
		reg-names = "cpm_slcr", "cfg";
		pcie_intc_0: pci-interrupt-controller {
			#address-cells = <0>;
			#interrupt-cells = <1>;
			interrupt-controller ;
		};
	};

Versal PL PCIe host Bridge DT description.

The properties and their meanings are identical to those described in
above Xilinx XDMA PL PCIe Root Port Bridge description.
The IP supports only MSI DECODE mode.

Properties that differ are:
- compatible: Should contain "xlnx,pcie-dma-versal-2.0"

Example:
	pcie_dma_versal_0: axi-pcie@80000000 {
		#address-cells = <3>;
		#interrupt-cells = <1>;
		#size-cells = <2>;
		compatible = "xlnx,pcie-dma-versal-2.0";
		device_type = "pci";
		interrupt-map = <0 0 0 1 &psv_pcie_intc_0 1>,
				<0 0 0 2 &psv_pcie_intc_0 2>,
				<0 0 0 3 &psv_pcie_intc_0 3>,
				<0 0 0 4 &psv_pcie_intc_0 4>;
		interrupt-map-mask = <0 0 0 7>;
		interrupt-names = "misc", "msi0", "msi1";
		interrupt-parent = <&gic>;
		interrupts = <0 84 4 0 85 4 0 86 4>;
		ranges = <0x02000000 0x00000000 0xB0000000 0x0 0xB0000000 0x00000000 0x10000000>,
			 <0x43000000 0x00000005 0x00000000 0x00000005 0x00000000 0x00000000 0x01000000>;
		reg = <0x0 0x80000000 0x0 0x10000000>;
		psv_pcie_intc_0: interrupt-controller {
			#address-cells = <0>;
			#interrupt-cells = <1>;
			interrupt-controller ;
		};
	};
```

## Documentation/devicetree/bindings/perf/amd,noc-pmu.yaml
```yaml
# SPDX-License-Identifier: (GPL-2.0-only OR BSD-2-Clause)
%YAML 1.2
---
$id: http://devicetree.org/schemas/perf/amd,noc-pmu.yaml#
$schema: http://devicetree.org/meta-schemas/core.yaml#

title: AMD Network-on-Chip (NoC) Performance Monitor Unit

maintainers:
  - Sai Krishna Potthuri <sai.krishna.potthuri@amd.com>

description:
  The AMD NoC PMU provides performance monitoring capabilities for
  Network-on-Chip traffic on AMD Versal ACAP devices. It monitors
  NMU (Network Master Unit) and DDRMC-NSU (DDR Memory Controller
  Network Slave Unit) components.

properties:
  compatible:
    const: amd,noc-pmu

  '#address-cells':
    enum: [ 1, 2 ]

  '#size-cells':
    enum: [ 1, 2 ]

  ranges: true

patternProperties:
  '^nmu@[0-9a-f]+$':
    type: object
    description: Network Master Unit component
    properties:
      reg:
        maxItems: 1
        description: Base address and size of the NMU register space

      amd,nmu-id:
        $ref: /schemas/types.yaml#/definitions/uint32
        description: Unique identifier for this NMU component

      label:
        description: Human-readable label for the NMU component

    required:
      - reg
      - amd,nmu-id

    additionalProperties: false

  '^ddrmc-nsu@[0-9a-f]+$':
    type: object
    description: DDR Memory Controller Network Slave Unit component
    properties:
      reg:
        maxItems: 1
        description: Base address and size of the DDRMC register space

      amd,ddrmc-id:
        $ref: /schemas/types.yaml#/definitions/uint32
        description: Unique identifier for this DDRMC component

      amd,nsu-ports:
        $ref: /schemas/types.yaml#/definitions/uint32-array
        minItems: 1
        maxItems: 4
        description: List of NSU port numbers available on this DDRMC
        items:
          minimum: 0
          maximum: 3

      label:
        description: Human-readable label for the DDRMC component

    required:
      - reg
      - amd,ddrmc-id
      - amd,nsu-ports

    additionalProperties: false

required:
  - compatible
  - '#address-cells'
  - '#size-cells'
  - ranges

additionalProperties: false

examples:
  - |
    pmu {
      compatible = "amd,noc-pmu";
      #address-cells = <1>;
      #size-cells = <1>;
      ranges;

      nmu@f6012000 {
        reg = <0xf6012000 0x1000>;
        amd,nmu-id = <1>;
        label = "nmu";
      };

      nmu@f6016000 {
        reg = <0xf6016000 0x1000>;
        amd,nmu-id = <3>;
        label = "pmc_nmu";
      };

      ddrmc-nsu@f6070000 {
        reg = <0xf6070000 0x1000>;
        amd,ddrmc-id = <0>;
        amd,nsu-ports = <0 1 2 3>;
        label = "ddrmc";
      };

      ddrmc-nsu@f6210000 {
        reg = <0xf6210000 0x1000>;
        amd,ddrmc-id = <1>;
        amd,nsu-ports = <0>;
      };
    };
```
