## Documentation/devicetree/bindings/misc/xlnx,flexnoc-pm.txt
```
* Xilinx Flexnoc Performance Monitor driver

The FlexNoc Performance Monitor has counters for monitoring
the read and the write transaction counter.

Required properties:
- compatible: "xlnx,flexnoc-pm-2.7"
- reg : Address and length of register sets for each device in
	"reg-names"
- reg-names : The names of the register addresses corresponding to the
		registers filled in "reg"
		- funnel: base address of the funnel registers
		- baselpd: base address of the LPD PM registers
		- basefpd: base address FPD PM registers

Example:
++++++++
performance-monitor@f0920000 {
	compatible = "xlnx,flexnoc-pm-2.7";
	reg-names = "funnel", "baselpd", "basefpd";
	reg = <0x0 0xf0920000 0x0 0x1000>,
		<0x0 0xf0980000 0x0 0x9000>,
		<0x0 0xf0b80000 0x0 0x9000>;
};
```

## Documentation/devicetree/bindings/misc/xlnx,sd-fec.txt
```
* Xilinx SDFEC(16nm) IP *

The Soft Decision Forward Error Correction (SDFEC) Engine is a Hard IP block
which provides high-throughput LDPC and Turbo Code implementations.
The LDPC decode & encode functionality is capable of covering a range of
customer specified Quasi-cyclic (QC) codes. The Turbo decode functionality
principally covers codes used by LTE. The FEC Engine offers significant
power and area savings versus implementations done in the FPGA fabric.


Required properties:
- compatible: Must be "xlnx,sd-fec-1.1”
- reg: Should contain Xilinx SDFEC 16nm Hardened IP block registers
  location and length.
- xlnx,sdfec-code : Should contain "ldpc" or "turbo" to describe the codes
  being used.
- xlnx,sdfec-din-words : A value 0 indicates that the DIN_WORDS interface is
  driven with a fixed value and is not present on the device, a value of 1
  configures the DIN_WORDS to be block based, while a value of 2 configures the
  DIN_WORDS input to be supplied for each AXI transaction.
- xlnx,sdfec-din-width : Configures the DIN AXI stream where a value of 1
  configures a width of "1x128b", 2 a width of "2x128b" and 4 configures a width
  of "4x128b".
- xlnx,sdfec-dout-words : A value 0 indicates that the DOUT_WORDS interface is
  driven with a fixed value and is not present on the device, a value of 1
  configures the DOUT_WORDS to be block based, while a value of 2 configures the
  DOUT_WORDS input to be supplied for each AXI transaction.
- xlnx,sdfec-dout-width : Configures the DOUT AXI stream where a value of 1
  configures a width of "1x128b", 2 a width of "2x128b" and 4 configures a width
  of "4x128b".
Optional properties:
- interrupts: should contain SDFEC interrupt number

Example
---------------------------------------
	sd_fec_0: sd-fec@a0040000 {
		compatible = "xlnx,sd-fec-1.1";
		reg = <0x0 0xa0040000 0x0 0x40000>;
		interrupt-parent = <&gic>;
		interrupts = <0 89 4>;
		xlnx,sdfec-code = "ldpc";
		xlnx,sdfec-din-words = <0>;
		xlnx,sdfec-din-width = <2>;
		xlnx,sdfec-dout-words = <0>;
		xlnx,sdfec-dout-width = <1>;
	};
```

## Documentation/devicetree/bindings/misc/xlnx,tmr-inject.yaml
```yaml
# SPDX-License-Identifier: (GPL-2.0 OR BSD-2-Clause)
%YAML 1.2
---
$id: http://devicetree.org/schemas/misc/xlnx,tmr-inject.yaml#
$schema: http://devicetree.org/meta-schemas/core.yaml#

title: Xilinx TMR Inject Device Tree Bindings

maintainers:
  - Appana Durga Kedareswara rao <appana.durga.rao@xilinx.com>

description: |
  The Triple Modular Redundancy(TMR) Inject core provides functional
  fault injection by changing selected MicroBlaze instructions,
  which provides the possibility to verify that the TMR
  subsystem error detection and fault recovery logic
  is working properly.

properties:
  compatible:
    enum:
      - xlnx,tmr-inject-1.0

  reg:
    maxItems: 1

  xlnx,magic:
    description: |
      Magic number used when injecting faults. The fault inject write
      data least significant byte (bits 7:0) must match this number
      to have any effect. The value shall be in the range 0-255.
    $ref: /schemas/types.yaml#/definitions/uint32

required:
  - compatible
  - reg
  - xlnx,magic

additionalProperties: false

examples:
  - |
    tmr-inject@44a30000 {
            compatible = "xlnx,tmr-inject-1.0";
            reg = <0x44a10000 0x10000>;
            xlnx,magic = <0x46>;
    };
```

## Documentation/devicetree/bindings/misc/xlnx,tmr-manager.yaml
```yaml
# SPDX-License-Identifier: (GPL-2.0 OR BSD-2-Clause)
%YAML 1.2
---
$id: http://devicetree.org/schemas/misc/xlnx,tmr-manager.yaml#
$schema: http://devicetree.org/meta-schemas/core.yaml#

title: Xilinx TMR Microblaze Device Tree Bindings

maintainers:
  - Appana Durga Kedareswara rao <appana.durga.rao@xilinx.com>

description: |
  The Triple Modular Redundancy(TMR) Manager is responsible
  for handling the TMR subsystem state, including fault detection
  and error recovery. The core is triplicated in each of the
  sub-blocks in the TMR subsystem, and provides majority
  voting of its internal state.

properties:
  compatible:
    enum:
      - xlnx,tmr-manager-1.0

  reg:
    maxItems: 1

  xlnx,magic1:
    description:
      Magic number 1, When writing to the control register the first
      write data byte (bits 7:0) must match this value in order to
      have any effect on the nominal recovery function. the value
      shall be in the range 0-255.
    $ref: /schemas/types.yaml#/definitions/uint32

required:
  - compatible
  - reg
  - xlnx,magic1

additionalProperties: false

examples:
  - |
    tmr-manager@44a10000 {
            compatible = "xlnx,tmr-manager-1.0";
            reg = <0x44a10000 0x10000>;
            xlnx,magic1 = <0x46>;
    };
```

## Documentation/devicetree/bindings/misc/xlnx,vcu.txt
```
Xilinx VCU init Driver
-----------------------------

General concept
---------------

Xilinx VCU init driver is developed to handle the LogiCore related
new implementation. In this directory, The DT node of the Xilinx
VCU init driver represents as a top level node.

Required properties:
- compatible: Must be "xlnx,vcu".
- reg, reg-names: There are two sets of registers need to provide.
	1. vcu slcr
	2. Logicore
	reg-names should contain name for the each register sequence.
- clocks: phandle for aclk and pll_ref clocksource
- clock-names: The identification string, "aclk", is always required for
   the axi clock. "pll_ref" is required for pll.
- ranges
- VCU Init driver node define the following child nodes:
	* Allegro encoder driver node
		- compatible: Must be "al,al5e"
		- reg: There is a one set of register.
		- interrupts: interrupt number to the cpu.
		- interrupt-parent: the phandle for the interrupt controller
		  that services interrupts for this device.
	* Allegro decoder driver node
		- compatible: Must be "al,al5d"
		- reg: There is a one set of register.
		- interrupts: interrupt number to the cpu.
		- interrupt-parent: the phandle for the interrupt controller
		  that services interrupts for this device.
Example:

	xlnx_vcu: vcu@a0040000 {
		compatible = "xlnx,vcu";
		#address-cells = <2>;
		#size-cells = <2>;
		reg = <0x0 0xa0040000 0x0 0x1000>,
			 <0x0 0xa0041000 0x0 0x1000>;
		reg-names = "vcu_slcr", "logicore";
		clocks = <&si570_1>, <&clkc 71>;
		clock-names = "pll_ref", "aclk";
		ranges;
		encoder: al5e@a0000000 {
			compatible = "al,al5e";
			reg = <0x0 0xa0000000 0x0 0x10000>;
			interrupts = <0 89 4>;
			interrupt-parent = <&gic>;
		};

		decoder: al5d@a0020000 {
			compatible = "al,al5d";
			reg = <0x0 0xa0020000 0x0 0x10000>;
			interrupts = <0 89 4>;
			interrupt-parent = <&gic>;
		};
	};
```

## Documentation/devicetree/bindings/mmc/arasan,sdhci.txt
```
Device Tree Bindings for the Arasan SDHCI Controller

  The bindings follow the mmc[1], clock[2], interrupt[3] and phy[4] bindings.
  Only deviations are documented here.

  [1] Documentation/devicetree/bindings/mmc/mmc.txt
  [2] Documentation/devicetree/bindings/clock/clock-bindings.txt
  [3] Documentation/devicetree/bindings/interrupt-controller/interrupts.txt
  [4] Documentation/devicetree/bindings/phy/phy-bindings.txt

Required Properties:
  - compatible: Compatibility string.  One of:
    - "arasan,sdhci-8.9a": generic Arasan SDHCI 8.9a PHY
    - "arasan,sdhci-4.9a": generic Arasan SDHCI 4.9a PHY
    - "arasan,sdhci-5.1": generic Arasan SDHCI 5.1 PHY
    - "rockchip,rk3399-sdhci-5.1", "arasan,sdhci-5.1": rk3399 eMMC PHY
    - "xlnx,zynqmp-8.9a": Xilinx ZynqMP Arasan SDHCI 8.9a PHY
    - "xlnx,versal-8.9a": Xilinx Versal Arasan SDHCI 8.9a PHY
      For this device it is strongly suggested to include arasan,soc-ctl-syscon.
  - reg: From mmc bindings: Register location and length.
  - clocks: From clock bindings: Handles to clock inputs.
  - clock-names: From clock bindings: Tuple including "clk_xin" and "clk_ahb"
  - interrupts: Interrupt specifier

Required Properties for "arasan,sdhci-5.1":
  - phys: From PHY bindings: Phandle for the Generic PHY for arasan.
  - phy-names:  MUST be "phy_arasan".

Required Properties for "xlnx,zynqmp-8.9a" and "xlnx,versal-8.9a":
  - xlnx,mio_bank: The value will be 0/1/2 depending on MIO bank selection.
  - xlnx,device_id: Unique Id of the device, value will be 0/1.

Optional Properties:
  - broken-mmc-highspeed: Indicates to force
				the controller to use in standard speed.
  - arasan,soc-ctl-syscon: A phandle to a syscon device (see ../mfd/syscon.txt)
    used to access core corecfg registers.  Offsets of registers in this
    syscon are determined based on the main compatible string for the device.
  - clock-output-names: If specified, this will be the name of the card clock
    which will be exposed by this device.  Required if #clock-cells is
    specified.
  - #clock-cells: If specified this should be the value <0>.  With this property
    in place we will export a clock representing the Card Clock.  This clock
    is expected to be consumed by our PHY.  You must also specify
  - xlnx,fails-without-test-cd: when present, the controller doesn't work when
    the CD line is not connected properly, and the line is not connected
    properly. Test mode can be used to force the controller to function.
  - xlnx,int-clock-stable-broken: when present, the controller always reports
    that the internal clock is stable even when it is not.
 - pinctrl-0: pin control group to be used for this controller.
 - pinctrl-names: must contain a "default" entry.

Optional Properties for "xlnx,zynqmp-8.9a":
 - nvmem-cells: list of phandle to the nvmem data cells.
 - nvmem-cell-names: Names for the each nvmem-cells specified.
 - xlnx,itap-delay-sd-hsd: Input Tap Delay for SD HS.
 - xlnx,itap-delay-sdr25: Input Tap Delay for SDR25.
 - xlnx,itap-delay-sdr50: Input Tap Delay for SDR50.
 - xlnx,itap-delay-sdr104: Input Tap Delay for SDR104.
 - xlnx,itap-delay-sd-ddr50: Input Tap Delay for SD DDR50.
 - xlnx,itap-delay-mmc-hsd: Input Tap Delay for MMC HS.
 - xlnx,itap-delay-mmc-ddr52: Input Tap Delay for MMC DDR52.
 - xlnx,itap-delay-mmc-hs200: Input Tap Delay for MMC HS200.
 - xlnx,otap-delay-sd-hsd: Output Tap Delay for SD HS.
 - xlnx,otap-delay-sdr25: Output Tap Delay for SDR25.
 - xlnx,otap-delay-sdr50: Output Tap Delay for SDR50.
 - xlnx,otap-delay-sdr104: Output Tap Delay for SDR104.
 - xlnx,otap-delay-sd-ddr50: Output Tap Delay for DDR50.
 - xlnx,otap-delay-mmc-hsd: Output Tap Delay for MMC HS.
 - xlnx,otap-delay-mmc-ddr52: Output Tap Delay for MMC DDR52.
 - xlnx,otap-delay-mmc-hs200: Output Tap Delay for MMC HS200.

Example:
	sdhci@e0100000 {
		compatible = "arasan,sdhci-8.9a";
		reg = <0xe0100000 0x1000>;
		clock-names = "clk_xin", "clk_ahb";
		clocks = <&clkc 21>, <&clkc 32>;
		interrupt-parent = <&gic>;
		interrupts = <0 24 4>;
	} ;

	sdhci@e2800000 {
		compatible = "arasan,sdhci-5.1";
		reg = <0xe2800000 0x1000>;
		clock-names = "clk_xin", "clk_ahb";
		clocks = <&cru 8>, <&cru 18>;
		interrupt-parent = <&gic>;
		interrupts = <0 24 4>;
		phys = <&emmc_phy>;
		phy-names = "phy_arasan";
	} ;

	sdhci: sdhci@fe330000 {
		compatible = "rockchip,rk3399-sdhci-5.1", "arasan,sdhci-5.1";
		reg = <0x0 0xfe330000 0x0 0x10000>;
		interrupts = <GIC_SPI 11 IRQ_TYPE_LEVEL_HIGH>;
		clocks = <&cru SCLK_EMMC>, <&cru ACLK_EMMC>;
		clock-names = "clk_xin", "clk_ahb";
		arasan,soc-ctl-syscon = <&grf>;
		assigned-clocks = <&cru SCLK_EMMC>;
		assigned-clock-rates = <200000000>;
		clock-output-names = "emmc_cardclock";
		phys = <&emmc_phy>;
		phy-names = "phy_arasan";
		#clock-cells = <0>;
	};
```

## Documentation/devicetree/bindings/mtd/arasan_nand.txt
```
Arasan NAND Flash Controller with ONFI 3.1 support

Required properties:
- compatible:		Should be "xlnx,zynqmp-nand", "arasan,nfc-v3p10"
- reg:			Memory map for module access
- interrupt-parent:	Interrupt controller the interrupt is routed through
- interrupts:		Should contain the interrupt for the device
- clock-name:		List of input clocks - "sys", "flash"
			(See clock bindings for details)
- clocks:		Clock phandles (see clock bindings for details)

Required properties for child node:
- nand-ecc-mode: see nand.txt

For NAND partition information please refer the below file
Documentation/devicetree/bindings/mtd/partition.txt

Example:
	nfc: nand@ff100000 {
		compatible = "xlnx,zynqmp-nand", "arasan,nfc-v3p10"
		reg = <0x0 0xff100000 0x1000>;
		clock-name = "sys", "flash"
		clocks = <&misc_clk &misc_clk>;
		interrupt-parent = <&gic>;
		interrupts = <0 14 4>;
		#address-cells = <1>;
		#size-cells = <0>

		nand@0 {
			reg = <0>
			nand-ecc-mode = "hw";
		};
	};
```

## Documentation/devicetree/bindings/mtd/arasan_nfc.txt
```
Arasan Nand Flash Controller with ONFI 3.1 support

Required properties:
- compatible: Should be "arasan,nfc-v3p10"
- reg: Memory map for module access
- interrupt-parent: Interrupt controller the interrupt is routed through
- interrupts: Should contain the interrupt for the device
- clock-name: List of input clocks - "clk_sys", "clk_flash"
	      (See clock bindings for details)
- clocks: Clock phandles (see clock bindings for details)

Optional properties:
- arasan,has-mdma: Enables Dma support
- num-cs: Number of chip selects used

for nand partition information please refer the below file
Documentation/devicetree/bindings/mtd/partition.txt

Example:
	nand0: nand@ff100000 {
		compatible = "arasan,nfc-v3p10"
		reg = <0x0 0xff100000 0x1000>;
		clock-name = "clk_sys", "clk_flash"
		clocks = <&misc_clk &misc_clk>;
		interrupt-parent = <&gic>;
		interrupts = <0 14 4>;
		arasan,has-mdma;
		#address-cells = <1>;
		#size-cells = <0>

		nand@0 {
			reg = <0>;
			partition@0 {
				label = "filesystem";
				reg = <0x0 0x0 0x400000>;
                        };
			(...)
		};

	};
```
