## Documentation/devicetree/bindings/perf/xilinx-apm.yaml
```yaml
# SPDX-License-Identifier: GPL-2.0-or-later OR BSD-2-Clause
%YAML 1.2
---
$id: http://devicetree.org/schemas/perf/xilinx-apm.yaml#
$schema: http://devicetree.org/meta-schemas/core.yaml#

title: Xilinx Axi Performance Monitor device tree bindings

maintainers:
  - Shubhrajyoti Datta <shubhrajyoti.datta@xilinx.com>

properties:
  compatible:
    items:
      - enum:
          - xlnx,axi-perf-monitor

  reg:
    maxItems: 1

  clocks:
    maxItems: 1

  interrupts:
    maxItems: 1

  xlnx,enable-profile:
    allOf:
      - $ref: /schemas/types.yaml#/definitions/uint32
      - enum: [0, 1]
    description:
      Enables the profile mode.
    maxItems: 1

  xlnx,enable-trace:
    allOf:
      - $ref: /schemas/types.yaml#/definitions/uint32
      - enum: [0, 1]
    description:
      Enables trace mode.
    maxItems: 1

  xlnx,num-monitor-slots:
    allOf:
      - $ref: /schemas/types.yaml#/definitions/uint32
      - minimum: 1
      - maximum: 8
    description:
      Number of monitor slots.

  xlnx,enable-event-count:
    allOf:
      - $ref: /schemas/types.yaml#/definitions/uint32
      - enum: [0, 1]
    description:
      Enable event count.

  xlnx,enable-event-log:
    allOf:
      - $ref: /schemas/types.yaml#/definitions/uint32
      - enum: [0, 1]
    description:
      Enable event log.

  xlnx,have-sampled-metric-cnt:
    allOf:
      - $ref: /schemas/types.yaml#/definitions/uint32
    description:
      Sampled metric counters enabled in APM.

  xlnx,metric-count-width:
    allOf:
      - $ref: /schemas/types.yaml#/definitions/uint32
      - enum: [32, 64]
    description:
      Metric Counter width.

  xlnx,num-of-counters:
    allOf:
      - $ref: /schemas/types.yaml#/definitions/uint32
    description:
      Number of counters in APM.

  xlnx,metrics-sample-count-width:
    allOf:
      - $ref: /schemas/types.yaml#/definitions/uint32
      - enum: [32, 64]
    description:
      Sampled metric counter width.

  xlnx,global-count-width:
    allOf:
      - $ref: /schemas/types.yaml#/definitions/uint32
      - enum: [32, 64]
    description:
      Global Clock counter width.

  xlnx,id-filter-32bit:
    description: APM is in 32-bit mode.
    type: boolean

required:
  - compatible
  - reg
  - clocks
  - interrupts

examples:
  - |
    apm@44a00000 {
        compatible = "xlnx,axi-perf-monitor";
        interrupt-parent = <&axi_intc_1>;
        interrupts = <1 2>;
        reg = <0x44a00000 0x1000>;
        clocks = <&clkc 15>;
        xlnx,enable-profile = <0>;
        xlnx,enable-trace = <0>;
        xlnx,num-monitor-slots = <4>;
        xlnx,enable-event-count = <1>;
        xlnx,enable-event-log = <1>;
        xlnx,have-sampled-metric-cnt = <1>;
        xlnx,num-of-counters = <8>;
        xlnx,metric-count-width = <32>;
        xlnx,metrics-sample-count-width = <32>;
        xlnx,global-count-width = <32>;
        xlnx,metric-count-scale = <1>;
        xlnx,id-filter-32bit;
    };
```

## Documentation/devicetree/bindings/perf/xlnx-flexnoc-pm.yaml
```yaml
# SPDX-License-Identifier: (GPL-2.0 OR BSD-2-Clause)
%YAML 1.2
---
$id: http://devicetree.org/schemas/perf/xlnx-flexnoc-pm.yaml#
$schema: http://devicetree.org/meta-schemas/core.yaml#

title: Xilinx flexnoc Performance Monitor device tree bindings

maintainers:
  - Shubhrajyoti Datta <shubhrajyoti.datta@xilinx.com>

properties:
  compatible:
    # Versal SoC based boards
    items:
      - enum:
          - xlnx,flexnoc-pm-2.7

  reg:
    items:
      - description: funnel registers
      - description: baselpd registers
      - description: basefpd registers

  reg-names:
    # The core schema enforces this is a string array
    items:
      - const: funnel
      - const: baselpd
      - const: basefpd

required:
  - compatible
  - reg

additionalProperties: false

examples:
  - |
    performance-monitor@f0920000 {
        compatible = "xlnx,flexnoc-pm-2.7";
        reg-names = "funnel", "baselpd", "basefpd";
        reg = <0x0 0xf0920000 0x0 0x1000>,
              <0x0 0xf0980000 0x0 0x9000>,
              <0x0 0xf0b80000 0x0 0x9000>;
    };
```
