## Documentation/devicetree/bindings/net/xlnx,axi-ethernet.yaml
```yaml
# SPDX-License-Identifier: (GPL-2.0-only OR BSD-2-Clause)
%YAML 1.2
---
$id: http://devicetree.org/schemas/net/xlnx,axi-ethernet.yaml#
$schema: http://devicetree.org/meta-schemas/core.yaml#

title: XILINX AXI Ethernet Subsystem

description: |
  Following MAC configurations are supported-
  a) AXI 1G/2.5G Ethernet Subsystem.
  b) 10G/25G High Speed Ethernet Subsystem.
  c) 10 Gigabit Ethernet Subsystem.
  d) USXGMII Ethernet Subsystem.
  e) MRMAC Ethernet Subsystem.
  f) 1G/10G/25G Switching Ethernet Subsystem.

  AXI 1G/2.5G Ethernet Subsystem- also called  AXI 1G/2.5G Ethernet Subsystem,
  the xilinx axi ethernet IP core provides connectivity to an external ethernet
  PHY supporting different interfaces: MII, GMII, RGMII, SGMII, 1000BaseX.
  It also includes two segments of memory for buffering TX and RX, as well as
  the capability of offloading TX/RX checksum calculation off the processor.

  Management configuration is done through the AXI interface, while payload is
  sent and received through means of an AXI DMA controller. This driver
  includes the DMA driver code, so this driver is incompatible with AXI DMA
  driver.

  10G/25G High Speed Ethernet Subsystem implements the 25G Ethernet Media
  Access Controller (MAC) with a Physical Coding Sublayer (PCS) as specified
  by the 25G Ethernet Consortium. Legacy operation at 10 Gb/s is supported.

  The 10G Ethernet subsystem provides 10 Gb/s Ethernet MAC, Physical Coding
  Sublayer (PCS) and Physical Medium Attachment (PMA) transmit and receive
  functionality over an AXI4-Stream interface.

  The Universal Serial 10GE Media Independent Interface (USXGMII) ethernet
  subsystem implements an Ethernet Media Access Controller (MAC) with a
  mechanism to carry a single port of 10M, 100M, 1G, 2.5G, 5G or 10GE over an
  IEEE 802.3 Clause 49 BASE-R physical coding sublayer/physical layer (PCS/PHY).

  MRMAC is a hardened Ethernet IP on Versal supporting multiple rates from
  10G to 100G which can be used with a soft DMA controller.

  The Xilinx 1G/10G/25G Switching Ethernet Subsystem contains integrated MAC
  and PCS and it supports runtime switchable speeds among 1G,10G & 25G

maintainers:
  - Radhey Shyam Pandey <radhey.shyam.pandey@xilinx.com>

properties:
  compatible:
    enum:
      - xlnx,axi-ethernet-1.00.a # AXI 1G Ethernet Subsystem.
      - xlnx,axi-ethernet-1.01.a # AXI 1G Ethernet Subsystem.
      - xlnx,axi-ethernet-2.01.a # AXI 1G Ethernet Subsystem.
      - xlnx,axi-2_5-gig-ethernet-1.0 # AXI 2.5G Ethernet Subsystem.
      - xlnx,ten-gig-eth-mac # 10 Gigabit Ethernet Subsystem.
      - xlnx,xxv-ethernet-1.0 # 10G/25G High Speed Ethernet Subsystem.
      - xlnx,xxv-usxgmii-ethernet-1.0 # USXGMII Ethernet Subsystem.
      - xlnx,mrmac-ethernet-1.0 # MRMAC Ethernet Subsystem.
      - xlnx,ethernet-1-10-25g-2.7 # 1G/10G/25G Switching Ethernet Subsystem.

  reg:
    description:
      Address and length of the IO space, as well as the address
      and length of the AXI DMA controller IO space, unless
      axistream-connected is specified, in which case the reg
      attribute of the node referenced by it is used.
    minItems: 1
    maxItems: 2

  interrupts:
    items:
      - description: Ethernet core interrupt
      - description: Tx DMA interrupt
      - description: Rx DMA interrupt
    description:
      Ethernet core interrupt is optional. If axistream-connected property is
      present DMA node should contains TX/RX DMA interrupts else DMA interrupt
      resources are mentioned on ethernet node.
    minItems: 1

  phy-handle: true

  xlnx,rxmem:
    description:
      Set to allocated memory buffer for Rx/Tx in the hardware.
    $ref: /schemas/types.yaml#/definitions/uint32

  phy-mode:
    enum:
      - mii
      - gmii
      - rgmii
      - sgmii
      - 1000BaseX

  xlnx,phy-type:
    description:
      Do not use, but still accepted in preference to phy-mode.
    deprecated: true
    $ref: /schemas/types.yaml#/definitions/uint32

  xlnx,txcsum:
    description:
      TX checksum offload. 0 or empty for disabling TX checksum offload,
      1 to enable partial TX checksum offload and 2 to enable full TX
      checksum offload.
    $ref: /schemas/types.yaml#/definitions/uint32
    enum: [0, 1, 2]

  xlnx,rxcsum:
    description:
      RX checksum offload. 0 or empty for disabling RX checksum offload,
      1 to enable partial RX checksum offload and 2 to enable full RX
      checksum offload.
    $ref: /schemas/types.yaml#/definitions/uint32
    enum: [0, 1, 2]

  xlnx,switch-x-sgmii:
    type: boolean
    description:
      Indicate the Ethernet core is configured to support both 1000BaseX and
      SGMII modes. If set, the phy-mode should be set to match the mode
      selected on core reset (i.e. by the basex_or_sgmii core input line).

  clocks:
    items:
      - description: Clock for AXI register slave interface.
      - description: AXI4-Stream clock for TXD RXD TXC and RXS interfaces.
      - description: Ethernet reference clock, used by signal delay primitives
                     and transceivers.
      - description: MGT reference clock (used by optional internal PCS/PMA PHY)

  clock-names:
    items:
      - const: s_axi_lite_clk
      - const: axis_clk
      - const: ref_clk
      - const: mgt_clk

  axistream-connected:
    $ref: /schemas/types.yaml#/definitions/phandle
    description: Phandle of AXI DMA controller which contains the resources
      used by this device. If this is specified, the DMA-related resources
      from that device (DMA registers and DMA TX/RX interrupts) rather than
      this one will be used.

  mdio:
    type: object

  pcs-handle:
    description: Phandle to the internal PCS/PMA PHY in SGMII or 1000Base-X
      modes, where "pcs-handle" should be used to point to the PCS/PMA PHY,
      and "phy-handle" should point to an external PHY if exists.
    maxItems: 1

  dma-coherent: true

  xlnx,eth-hasnobuf:
    type: boolean
    description: Used when 1G MAC is configured in non-processor mode.

  xlnx,usxgmii-rate:
    $ref: /schemas/types.yaml#/definitions/uint32
    description: USXGMII PHY speed

  xlnx,rxtsfifo:
    $ref: /schemas/types.yaml#/definitions/phandle
    description: Configures the axi fifo for receive timestamping.

  axififo-connected:
    $ref: /schemas/types.yaml#/definitions/phandle
    description: Configures the axi fifo for transmit timestamping.

  ptp-hardware-clock:
    $ref: /schemas/types.yaml#/definitions/phandle
    description: Indicate the xilinx PTP device node to read PTP clock
      index(/dev/ptp0 etc). This property is for MRMAC and 10G/25G.

  xlnx,mrmac-rate:
    $ref: /schemas/types.yaml#/definitions/uint32
    description: MRMAC rate in Mbps.

  xlnx,gtlane:
    $ref: /schemas/types.yaml#/definitions/uint32
    description: Indicate the GT reset and speed control lane for the
      the current MRMAC lane.

  xlnx,gtpll:
    $ref: /schemas/types.yaml#/definitions/phandle
    description: Handle to AXI GPIO instance for GT PLL mask control.
      This is required to control the common PLL mask bits.

  xlnx,gtctrl:
    $ref: /schemas/types.yaml#/definitions/phandle
    description: Handle to AXI GPIO instance for GT speed and reset
      control for each MRMAC lane.

  xlnx,phcindex:
    $ref: /schemas/types.yaml#/definitions/uint32
    description: Indicate the index of the physical hardware clock
      to be used as per PTP clock connected to the given
      MRMAC lane.
    deprecated: true

required:
  - compatible
  - interrupts
  - reg
  - xlnx,rxmem

allOf:
  - $ref: /schemas/net/ethernet-controller.yaml#

  - if:
      properties:
        compatible:
          contains:
            enum:
              - xlnx,xxv-usxgmii-ethernet-1.0

    then:
      properties:
        xlnx,usxgmii-rate:
          enum: [10, 100, 1000, 2500, 5000, 10000]

  - if:
      properties:
        compatible:
          contains:
            enum:
              - xlnx,mrmac-ethernet-1.0

    then:
      properties:
        xlnx,mrmac-rate:
          enum: [10000, 25000]

        xlnx,gtlane:
          enum: [0, 1, 2, 3]

        xlnx,phcindex:
          enum: [0, 1, 2, 3]

      required:
        - xlnx,mrmac-rate
        - xlnx,gtlane
        - xlnx,gtpll
        - xlnx,gtctrl

  - if:
      properties:
        compatible:
          contains:
            enum:
              - xlnx,axi-ethernet-1.00.a
              - xlnx,axi-ethernet-1.01.a
              - xlnx,axi-ethernet-2.01.a
              - xlnx,axi-2_5-gig-ethernet-1.0
    then:
      required:
        - phy-handle

additionalProperties: false

examples:
# 1) AXI 1G/2.5G Ethernet Subsystem + AXIDMA without "axistream-connected" property
  - |
    axi_ethernet_eth: ethernet@40c00000 {
        compatible = "xlnx,axi-ethernet-1.00.a";
        interrupts = <2 0 1>;
        clock-names = "s_axi_lite_clk", "axis_clk", "ref_clk", "mgt_clk";
        clocks = <&axi_clk>, <&axi_clk>, <&pl_enet_ref_clk>, <&mgt_clk>;
        phy-mode = "mii";
        reg = <0x40c00000 0x40000>,<0x50c00000 0x40000>;
        xlnx,rxcsum = <0x2>;
        xlnx,rxmem = <0x800>;
        xlnx,txcsum = <0x2>;
        phy-handle = <&phy0>;

        mdio {
            #address-cells = <1>;
            #size-cells = <0>;
            phy0: ethernet-phy@1 {
                device_type = "ethernet-phy";
                reg = <1>;
            };
        };
    };

# 2) AXI 1G/2.5G Ethernet Subsystem + AXIDMA with "axistream-connected" property
  - |
    axi_ethernet_eth1: ethernet@40000000 {
        compatible = "xlnx,axi-ethernet-1.00.a";
        interrupts = <0>;
        clock-names = "s_axi_lite_clk", "axis_clk", "ref_clk", "mgt_clk";
        clocks = <&axi_clk>, <&axi_clk>, <&pl_enet_ref_clk>, <&mgt_clk>;
        phy-mode = "mii";
        reg = <0x40000000 0x40000>;
        xlnx,rxcsum = <0x2>;
        xlnx,rxmem = <0x800>;
        xlnx,txcsum = <0x2>;
        phy-handle = <&phy1>;
        axistream-connected = <&dma>;

        mdio {
            #address-cells = <1>;
            #size-cells = <0>;
            phy1: ethernet-phy@1 {
                device_type = "ethernet-phy";
                reg = <1>;
            };
        };
    };

# 3) #Example for MRMAC Ethernet subsystem
  - |
    gt_pll: gpio@a4000000 {
        reg = <0x0 0xa4000000 0x0 0x10000>;

      };

    gt_ctrl: gpio@a4010000 {
        reg = <0x0 0xa4010000 0x0 0x40000>;

    };

    mrmac: ethernet@80000000 {
        axistream-connected = <&dma>;
        compatible = "xlnx,mrmac-ethernet-1.0";
        reg = <0x0 0xa4090000 0x0 0x1000>;
        interrupt-parent = <&gic>;
        interrupts = <0 91 4>;
        xlnx,mrmac-rate = <10000>;
        xlnx,gtpll = <&gt_pll>;
        xlnx,gtctrl = <&gt_ctrl>;
        xlnx,gtlane = <0x0>;
        xlnx,rxmem = <0x8000>;
        ptp-hardware-clock = <&ptp_device>;

    };
```

## Documentation/devicetree/bindings/nvmem/xlnx,versal-sec-cfg.yaml
```yaml
# SPDX-License-Identifier: (GPL-2.0-only OR BSD-2-Clause)
%YAML 1.2
---
$id: http://devicetree.org/schemas/nvmem/xlnx,versal-sec-cfg.yaml#
$schema: http://devicetree.org/meta-schemas/core.yaml#

title: Xilinx Secure Configuration driver

description: |
  The versal_sec_cfg node provides access to the BBRAM keys,
  BBRAM user data and volatile user keys by using the firmware interface.

maintainers:
  - Harsha <harsha.harsha@amd.com>

allOf:
  - $ref: nvmem.yaml#

properties:
  compatible:
    const: xlnx,versal-sec-cfg


unevaluatedProperties: false

examples:
  - |
    versal-sec-cfg {
      compatible = "xlnx,versal-sec-cfg";
      nvmem-layout {
        compatible = "fixed-layout";
        #address-cells = <1>;
        #size-cells = <1>;

        bbram_zeroize: bbram-zeroize@4 {
          reg = <0x4 0x4>;
        };

        bbram_key: bbram-key@10 {
          reg = <0x10 0x20>;
        };

        bbram_usr: bbram-usr@30 {
          reg = <0x30 0x4>;
        };

        bbram_lock: bbram-lock@48 {
          reg = <0x48 0x4>;
        };

        user_key0: user-key@110 {
          reg = <0x110 0x20>;
        };

        user_key1: user-key@130 {
          reg = <0x130 0x20>;
        };

        user_key2: user-key@150 {
          reg = <0x150 0x20>;
        };

        user_key3: user-key@170 {
          reg = <0x170 0x20>;
        };

        user_key4: user-key@190 {
          reg = <0x190 0x20>;
        };

        user_key5: user-key@1b0 {
          reg = <0x1b0 0x20>;
        };

        user_key6: user-key@1d0 {
          reg = <0x1d0 0x20>;
        };

        user_key7: user-key@1f0 {
          reg = <0x1f0 0x20>;
        };
      };
    };
```

## Documentation/devicetree/bindings/nvmem/xlnx,zynqmp-nvmem.txt
```
--------------------------------------------------------------------------
=  Zynq UltraScale+ MPSoC nvmem firmware driver binding =
--------------------------------------------------------------------------
The nvmem_firmware node provides access to the hardware related data
like soc revision, IDCODE... etc, By using the firmware interface.

Required properties:
- compatible: should be "xlnx,zynqmp-nvmem-fw"

= Data cells =
Are child nodes of silicon id, bindings of which as described in
bindings/nvmem/nvmem.txt

-------
 Example
-------
firmware {
	zynqmp_firmware: zynqmp-firmware {
		compatible = "xlnx,zynqmp-firmware";
		method = "smc";

		nvmem_firmware {
			compatible = "xlnx,zynqmp-nvmem-fw";
			#address-cells = <1>;
			#size-cells = <1>;

			/* Data cells */
			soc_revision: soc_revision@0 {
				reg = <0x0 0x4>;
			};
			/*
			* efuse memory access:
			* all the efuse feilds need to be read
			* with the exact size specified in the node
			*/
			/* DNA */
			efuse_dna: efuse_dna@c {
				reg = <0xc 0xc>;
			};
			/* User 0 */
			efuse_usr0: efuse_usr0@20 {
				reg = <0x20 0x4>;
			};
			/* User 1 */
			efuse_usr1: efuse_usr1@24 {
				reg = <0x24 0x4>;
			};
			/* User 2 */
			efuse_usr2: efuse_usr2@28 {
				reg = <0x28 0x4>;
			};
			/* User 3 */
			efuse_usr3: efuse_usr3@2c {
				reg = <0x2c 0x4>;
			};
			/* User 4 */
			efuse_usr4: efuse_usr4@30 {
				reg = <0x30 0x4>;
			};
			/* User 5 */
			efuse_usr5: efuse_usr5@34 {
				reg = <0x34 0x4>;
			};
			/* User 6 */
			efuse_usr6: efuse_usr6@38 {
				reg = <0x38 0x4>;
			};
			/* User 7 */
			efuse_usr7: efuse_usr7@3c {
				reg = <0x3c 0x4>;
			};
			/* Misc user control bits */
			efuse_miscusr: efuse_miscusr@40 {
				reg = <0x40 0x4>;
			};
			/* PUF chash */
			efuse_chash: efuse_chash@50 {
				reg = <0x50 0x4>;
			};
			/* PUF misc */
			efuse_pufmisc: efuse_pufmisc@54 {
				reg = <0x54 0x4>;
			};
			/* SEC_CTRL */
			efuse_sec: efuse_sec@58 {
				reg = <0x58 0x4>;
			};
			/* SPK ID */
			efuse_spkid: efuse_spkid@5c {
				reg = <0x5c 0x4>;
			};
			/* PPK0 hash */
			efuse_ppk0hash: efuse_ppk0hash@a0 {
				reg = <0xa0 0x30>;
			};
			/* PPK1 hash */
			efuse_ppk1hash: efuse_ppk1hash@d0 {
				reg = <0xd0 0x30>;
			};
		};
	};
};

= Data consumers =
Are device nodes which consume nvmem data cells.

For example:
	pcap {
		...

		nvmem-cells = <&soc_revision>;
		nvmem-cell-names = "soc_revision";

		...
	};

To program efuse memory, one should request specified bytes of size as below,
NOTE: Efuse bits once programmed cannot be reverted.

	- | TYPE	| OFFSET | SIZE(bytes)	|
	- |User-0	| 0x20	 | 0x4		|
	- |User-1	| 0x24	 | 0x4		|
	- |User-2	| 0x28	 | 0x4		|
	- |User-3	| 0x2C	 | 0x4		|
	- |User-4	| 0x30	 | 0x4		|
	- |User-5	| 0x34	 | 0x4		|
	- |User-6	| 0x38	 | 0x4		|
	- |User-7	| 0x3c	 | 0x4		|
	- |Misc User	| 0x40	 | 0x4		|
	- |SEC_CTRL	| 0x58	 | 0x4		|
	- |SPK ID 	| 0x5C	 | 0x4		|
	- |AES KEY 	| 0x60	 | 0x20		|
	- |PPK0 hash	| 0xA0	 | 0x30		|
	- |PPK1 hash	| 0xD0	 | 0x30		|
```
