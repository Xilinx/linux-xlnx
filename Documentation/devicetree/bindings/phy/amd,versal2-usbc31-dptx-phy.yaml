## Documentation/devicetree/bindings/phy/amd,versal2-usbc31-dptx-phy.yaml
```yaml
# SPDX-License-Identifier: (GPL-2.0-only OR BSD-2-Clause)
%YAML 1.2
---
$id: http://devicetree.org/schemas/phy/amd,versal2-usbc31-dptx-phy.yaml#
$schema: http://devicetree.org/meta-schemas/core.yaml#

title: AMD Versal Gen 2 USB3.1 SSP+/DP Alt Combo PHY

maintainers:
  - Radhey Shyam Pandey <radhey.shyam.pandey@amd.com>

description:
  The AMD Versal Gen 2 USB3.1 SuperSpeedPlus / DisplayPort Alternate Mode
  combo PHY provides the physical layer for USB Type-C operation. It supports
  USB 3.1 Gen 2 (10 Gb/s) and DisplayPort Alt-Mode over a shared Type-C
  connector, including lane muxing and orientation handling in conjunction
  with an external Type-C/PD controller.

properties:
  compatible:
    const: amd,versal2-usbc31-dptx-phy

  reg:
    items:
      - description: CRPARA register block
      - description: TCA (Type-C Adapter) register block

  reg-names:
    items:
      - const: crpara
      - const: tca

  "#phy-cells":
    description:
      Cell allows setting the type of the PHY. Possible values are PHY_TYPE_USB3
      and PHY_TYPE_DP.
    const: 1

  clocks:
    description:
      USB 3.1 PHY requires a reference clock with jitter < 10ps. The internal
      reference clock has ~100ps jitter which does not satisfy this requirement.
      A 24MHz external reference clock on the ref_pad_clk_p/m IO pads is
      required for USB 3.1 PHY operation.
    maxItems: 1

  resets:
    items:
      - description: USB3 PHY reset

  orientation-switch:
    description: Flag the port as possible handler of orientation switching
    type: boolean

  port:
    $ref: /schemas/graph.yaml#/properties/port
    description:
      A port node to link the PHY to a Type-C controller for the purpose
      of handling orientation switching.

required:
  - compatible
  - reg
  - reg-names
  - "#phy-cells"
  - clocks
  - resets

additionalProperties: false

examples:
  - |
    #include <dt-bindings/phy/phy.h>

    phy@ede40000 {
        compatible = "amd,versal2-usbc31-dptx-phy";
        reg = <0xede40000 0x10000>, <0xede50000 0x1000>;
        reg-names = "crpara", "tca";
        #phy-cells = <1>;
        clocks = <&clk_ref>;
        resets = <&reset_usb3>;
        orientation-switch;

        port {
            usb3_dp_phy_ep: endpoint {
                remote-endpoint = <&typec_ep>;
            };
        };
    };
```

## Documentation/devicetree/bindings/phy/phy-zynqmp.txt
```
Xilinx ZynqMP PHY binding

This binding describes a ZynqMP PHY device that is used to control ZynqMP
High Speed Gigabit Transceiver(GT). ZynqMP PS GTR provides four lanes
and are used by USB, SATA, PCIE, Display port and Ethernet SGMMI controllers.

Required properties (controller (parent) node):
- compatible	: Can be "xlnx,zynqmp-psgtr-v1.1" or "xlnx,zynqmp-psgtr"
		  "xlnx,zynqmp-psgtr-v1.1" has the lpd address mapping removed

- reg           : Address and length of register sets for each device in
                  "reg-names"
- reg-names     : The names of the register addresses corresponding to the
		  registers filled in "reg":
			- serdes: SERDES block register set
			- siou: SIOU block register set
			- lpd: Low power domain peripherals reset control

Required nodes	:  A sub-node is required for each lane the controller
		   provides.

Required properties (port (child) nodes):
lane0:
- #phy-cells	: Should be 4
		  Cell after port phandle is device type from:
			- <PHY_TYPE_PCIE 0 LANE_NUM FREQUENCY>
			- <PHY_TYPE_SATA 0 LANE_NUM FREQUENCY>
			- <PHY_TYPE_USB3 0 LANE_NUM FREQUENCY>
			- <PHY_TYPE_DP 1 LANE_NUM FREQUENCY>
			- <PHY_TYPE_SGMII 0 LANE_NUM FREQUENCY>
lane1:
- #phy-cells	: Should be 4
		  Cell after port phandle is device type from:
			- <PHY_TYPE_PCIE 1 LANE_NUM FREQUENCY>
			- <PHY_TYPE_SATA 1 LANE_NUM FREQUENCY>
			- <PHY_TYPE_USB3 0 LANE_NUM FREQUENCY>
			- <PHY_TYPE_DP 0 LANE_NUM FREQUENCY>
			- <PHY_TYPE_SGMII 1 LANE_NUM FREQUENCY>
lane2:
- #phy-cells	: Should be 4
		  Cell after port phandle is device type from:
			- <PHY_TYPE_PCIE 2 LANE_NUM FREQUENCY>
			- <PHY_TYPE_SATA 0 LANE_NUM FREQUENCY>
			- <PHY_TYPE_USB3 0 LANE_NUM FREQUENCY>
			- <PHY_TYPE_DP 1 LANE_NUM FREQUENC>
			- <PHY_TYPE_SGMII 2 LANE_NUM FREQUENCY>
lane3:
- #phy-cells	: Should be 4
		  Cell after port phandle is device type from:
			- <PHY_TYPE_PCIE 3 LANE_NUM FREQUENCY>
			- <PHY_TYPE_SATA 1 LANE_NUM FREQUENCY>
			- <PHY_TYPE_USB3 1 LANE_NUM FREQUENCY >
			- <PHY_TYPE_DP 0 LANE_NUM FREQUENCY>
			- <PHY_TYPE_SGMII 3 LANE_NUM FREQUENCY>

Note:	LANE_NUM : This determines which lane's reference clock is shared by controller.
	FREQUENCY: This the clock frequency at which controller wants to operate.


Example:
	serdes: zynqmp_phy@fd400000 {
		compatible = "xlnx,zynqmp-psgtr";
		status = "okay";
		reg = <0x0 0xfd400000 0x0 0x40000>, <0x0 0xfd3d0000 0x0 0x1000>,
			<0x0 0xff5e0000 0x0 0x1000>;
		reg-names = "serdes", "siou", "lpd";

		lane0: lane@0 {
			#phy-cells = <4>;
		};
		lane1: lane@1 {
			#phy-cells = <4>;
		};
		lane2: lane@2 {
			#phy-cells = <4>;
		};
		lane3: lane@3 {
			#phy-cells = <4>;
		};
	};

Specifying phy control of devices
=================================

Device nodes should specify the configuration required in their "phys"
property, containing a phandle to the phy port node and a device type.

phys = <PHANDLE CONTROLLER_TYPE CONTROLLER_INSTANCE LANE_NUM LANE_FREQ>;

PHANDLE                 = &lane0 or &lane1 or &lane2 or &lane3
CONTROLLER_TYPE         = PHY_TYPE_PCIE or PHY_TYPE_SATA or PHY_TYPE_USB
			  or PHY_TYPE_DP or PHY_TYPE_SGMII
CONTROLLER_INSTANCE     = Depends on controller type used, can be any of
				PHY_TYPE_PCIE : 0 or 1 or 2 or 3
				PHY_TYPE_SATA : 0 or 1
				PHY_TYPE_USB  : 0 or 1
				PHY_TYPE_DP   : 0 or 1
				PHY_TYPE_SGMII: 0 or 1 or 2 or 3
LANE_NUM                = Depends on which lane clock is used as ref clk, can be
			  0 or 1 or 2 or 3
LANE_FREQ               = Frequency that controller can operate, can be any of
			  19.2Mhz,20Mhz,24Mhz,26Mhz,27Mhz,28.4Mhz,40Mhz,52Mhz,
			  100Mhz,108Mhz,125Mhz,135Mhz,150Mhz

Example:

#include <dt-bindings/phy/phy.h>

	usb@fe200000 {
		...
		phys	  = <&lane2 PHY_TYPE_USB3 0 2 2600000>;
		...
	};

	ahci@fd0c0000 {
		...
		phys	  = <&lane3 PHY_TYPE_SATA 1 1 125000000>;
		...
	};
```

## Documentation/devicetree/bindings/phy/xlnx,gt-quad-base.yaml
```yaml
# SPDX-License-Identifier: (GPL-2.0-only OR BSD-2-Clause)
%YAML 1.2
---
$id: http://devicetree.org/schemas/phy/xlnx,gt-quad-base.yaml#
$schema: http://devicetree.org/meta-schemas/core.yaml#

title: Xilinx DP GTQUAD PHY

maintainers:
  - Jagadeesh Banisetti <jagadeesh.banisetti@xilinx.com>

description: |
  The Xilinx DP GTQUAD PHY Controller core is designed for enabling
  connectivity with Xilinx DP RX and TX with xilinx versal devices.

properties:
  compatible:
    items:
      - enum:
          - xlnx,gt-quad-base-1.1

  reg:
    maxItems: 1

  clocks:
    description: List of clock specifiers
    items:
      - description: AXI Lite clock

  "#phy-cells":
    const: 0

required:
  - clocks
  - compatible
  - reg
  - '#phy-cells'

additionalProperties: false

examples:
  - |
   gt_quad_base: gt_qb@a4080000 {
           clocks = <&misc_clk_0>;
           compatible = "xlnx,gt-quad-base-1.1";
           reg = <0xa4080000 0x10000>;
           #phy-cells = <0>;
   };
...
```

## Documentation/devicetree/bindings/phy/xlnx,v-hmdi-phy1.yaml
```yaml
# SPDX-License-Identifier: (GPL-2.0-only OR BSD-2-Clause) %YAML 1.2
%YAML 1.2
---
$id: http://devicetree.org/schemas/phy/xlnx,v-hmdi-phy1.yaml#
$schema: http://devicetree.org/meta-schemas/core.yaml#

title: Xilinx HDMI PHY

maintainers:
  - Rajesh Gugulothu <gugulothu.rajesh@xilinx.com>

description: |
  The Xilinx HDMI PHY Controller core is designed for enabling plug-and-play
  connectivity with Xilinx HDMI 2.1 technology MAC transmit or receive
  subsystems. The interface between the video MAC and PHY layers are
  standardized to enable ease of use in accessing shared transceiver resource.

properties:
  compatible:
    items:
      - enum:
          - xlnx,v-hdmi-phy1-1.0

  reg:
    maxItems: 1

  interrupts:
    maxItems: 1

  clocks:
    description: List of clock specifiers
    items:
      - description: AXI Lite clock
      - description: DRP clock

  clock-names:
    items:
      - const: axi4lite_aclk
      - const: drpclk

  xlnx,transceiver-type:
    description: |
      Gigabit transceiver type that IP configured with.Possible values are as
      below -
      5  - GTHE4
      6  - GTYE4
      7  - GTYE5
    allOf:
      - $ref: /schemas/types.yaml#/definitions/uint32
      - enum: [5, 6, 7]

  xlnx,tx-no-of-channels:
    description: Max number of channels that Tx configured with.
    allOf:
      - $ref: /schemas/types.yaml#/definitions/uint32
      - enum: [1, 2, 4]

  xlnx,rx-no-of-channels:
    description: Max number of channels that Rx configured with.
    allOf:
      - $ref: /schemas/types.yaml#/definitions/uint32
      - enum: [1, 2, 4]

  xlnx,rx-protocol:
    description: Protocol type that Tx is configured with.
    $ref: /schemas/types.yaml#/definitions/uint32
    minimum: 1
    maximum: 3

  xlnx,tx-protocol:
    description: Protocol type that Rx is configured with.
    $ref: /schemas/types.yaml#/definitions/uint32
    minimum: 1
    maximum: 3

  xlnx,nidru:
    description: nidru present in the IP or not.
    allOf:
      - $ref: /schemas/types.yaml#/definitions/uint32
      - enum: [0, 1]

  xlnx,tx-refclk-sel:
    description: Available reference clocks for Tx PLL clock selection
                 multiplexer.
    $ref: /schemas/types.yaml#/definitions/uint32
    minimum: 0
    maximum: 6

  xlnx,rx-refclk-sel:
    description: Available reference clocks for Rx PLL clock selection
                 multiplexer.
    $ref: /schemas/types.yaml#/definitions/uint32
    minimum: 0
    maximum: 6

  xlnx,tx-frl-refclk-sel:
    description: Available reference clocks for Tx PLL FRL(fixed rate link)
                 clock selection multiplexer.
    $ref: /schemas/types.yaml#/definitions/uint32
    minimum: 1
    maximum: 7

  xlnx,rx-frl-refclk-sel:
    description: Available reference clocks for Rx PLL FRL(fixed rate link)
                 clock selection multiplexer.
    $ref: /schemas/types.yaml#/definitions/uint32
    minimum: 0
    maximum: 6

  xlnx,tx-pll-selection:
    description: Available reference clocks used to driver Tx datapath.
    $ref: /schemas/types.yaml#/definitions/uint32
    minimum: 0
    maximum: 6

  xlnx,rx-pll-selection:
    description: Available reference clocks used to driver Rx datapath.
    $ref: /schemas/types.yaml#/definitions/uint32
    minimum: 0
    maximum: 6

  xlnx,nidru-refclk-sel:
    description: Available reference clocks for NI-DRU(non-integer data rate
                 unit) clock selection multiplexer.
    $ref: /schemas/types.yaml#/definitions/uint32
    minimum: 1
    maximum: 7

  xlnx,transceiver-width:
    description: Transceiver width that IP is configured with.
    allOf:
      - $ref: /schemas/types.yaml#/definitions/uint32
      - enum: [2, 4]

  xlnx,input-pixels-per-clock:
    description: |
      Input number of pixel per clock that IP configured with.
    allOf:
      - $ref: /schemas/types.yaml#/definitions/uint32
      - enum: [1, 2, 4, 8]

  xlnx,use-gt-ch4-hdmi:
    description: |
      use 4th GT channel as tx TMDS clock.
    allOf:
      - $ref: /schemas/types.yaml#/definitions/uint32
      - enum: [0, 1]

  "#phy-cells":
    const: 0

required:
  - clock-names
  - clocks
  - compatible
  - interrupts
  - reg
  - xlnx,transceiver-type
  - xlnx,tx-no-of-channels
  - xlnx,rx-no-of-channels
  - xlnx,tx-refclk-sel
  - xlnx,rx-refclk-sel
  - xlnx,tx-frl-refclk-sel
  - xlnx,rx-frl-refclk-sel
  - xlnx,tx-pll-selection
  - xlnx,rx-pll-selection
  - xlnx,nidru-refclk-sel
  - xlnx,transceiver-width
  - xlnx,input-pixels-per-clock
  - xlnx,use-gt-ch4-hdmi
  - '#phy-cells'

additionalProperties: false

examples:
  - |
   v_hdmi_phy1@80040000 {
           clock-names = "axi4lite_aclk", "drpclk";
           clocks =  <&zynqmp_clk 71>, <&zynqmp_clk 71>;
           compatible = "xlnx,v-hdmi-phy1-1.0";
           interrupt-parent = <&gic>;
           interrupts = <0 89 4>;
           reg = <0x80040000 0x10000>;
           xlnx,transceiver-type = <5>;
           xlnx,tx-no-of-channels = <4>;
           xlnx,rx-no-of-channels = <4>;
           xlnx,rx-protocol = <2>;
           xlnx,tx-protocol = <2>;
           xlnx,tx-refclk-sel = <2>;
           xlnx,rx-refclk-sel = <0>;
           xlnx,tx-frl-refclk-sel = <2>;
           xlnx,rx-frl-refclk-sel = <0>;
           xlnx,tx-pll-selection = <6>;
           xlnx,rx-pll-selection = <0>;
           xlnx,nidru = <1>;
           xlnx,nidru-refclk-sel = <4>;
           xlnx,transceiver-width = <4>;
           xlnx,input-pixels-per-clock = <4>;
           xlnx,use-gt-ch4-hdmi = <1>;
           #phy-cells = <0>;
   };
...
```
