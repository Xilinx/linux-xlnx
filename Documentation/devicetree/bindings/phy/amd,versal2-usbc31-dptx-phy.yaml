## Documentation/devicetree/bindings/regulator/da9121.txt
```
* Dialog Semiconductor DA9121 Single-channel 10A double-phase buck converter
* Dialog Semiconductor DA9122 Double-channel  5A single-phase buck converter
* Dialog Semiconductor DA9220 Double-channel  3A single-phase buck converter
* Dialog Semiconductor DA9217 Single-channel  6A double-phase buck converter
* Dialog Semiconductor DA9130 Single-channel 10A double-phase buck converter
* Dialog Semiconductor DA9131 Double-channel  5A single-phase buck converter
* Dialog Semiconductor DA9132 Double-channel  3A single-phase buck converter

Required properties:

- compatible : Should be "dlg,da9121" for DA9121
- compatible : Should be "dlg,da9122" for DA9122
- compatible : Should be "dlg,da9220" for DA9220
- compatible : Should be "dlg,da9217" for DA9217
- compatible : Should be "dlg,da9130" for DA9130
- compatible : Should be "dlg,da9131" for DA9131
- compatible : Should be "dlg,da9132" for DA9132
- reg : Specifies the I2C slave address.
- interrupt-parent : Specifies the reference to the interrupt controller.
- interrupts : IRQ line information.

Current limits

  This is PER PHASE, and the current limit setting in the devices reflect
  that with a maximum 10A limit. Allowing for transients as high as 100%
  of the rated current, this translates across the device range to per
  channel figures as so:

                               | DA9121   DA9122     DA9220     DA9217   DA9140
                               | /DA9130  /DA9131    /DA9132
    -----------------------------------------------------------------------------
    Output current / channel   | 10000000   5000000   3000000   6000000  40000000
    Output current / phase     |  5000000   5000000   3000000   3000000  10000000
    Min regulator-min-microamp |  7000000   3500000   3500000   7000000  15000000
    Max regulator-max-microamp | 20000000  10000000   6000000  12000000  80000000
    Device hardware default    | 15000000   7500000   5500000  11000000  TBD

Optional properties:

- dlg,irq-polling-delay-passive : Specify the polling period, measured in
  milliseconds, between interrupt status update checks.

Sub-nodes:

- regulators : This node defines the settings for the BUCK. The content of the
  sub-node is defined by the standard binding for regulators; see regulator.txt.
  The DA9121 regulator is bound using their names listed below:

    buck1 : BUCK1
    buck2 : BUCK2	//DA9122, DA9220, DA9131, DA9132 only

Optional properties for regulators:

- regulator-mode         : defined in include/dt-bindings/regulator/dlg,da9121-regulator.h
- regulator-initial-mode : Same as regulator-mode
- dlg,enable-gpio        : Specify a valid GPIO for platform control of the regulator.
- dlg,ripple-cancel      : defined in include/dt-bindings/regulator/dlg,da9121-regulator.h
                           Only present on multi-channel devices

Example:
	pmic: da9121@68 {
		compatible = "dlg,da9121";
		reg = <0x68>;

		interrupt-parent = <&gpio6>;
		interrupts = <11 IRQ_TYPE_LEVEL_LOW>;

		dlg,irq-polling-delay-passive = <2000>;

		regulators {
			DA9121_BUCK1: buck1 {
				regulator-name = "BUCK1";
				regulator-min-microvolt = <300000>;
				regulator-max-microvolt = <1900000>;
				regulator-min-microamp = <7000000>;
				regulator-max-microamp = <20000000>;
				regulator-boot-on;
				regulator-initial-mode = <DA9121_BUCK_MODE_AUTO>;
				dlg,enable-gpio = <&gpio 1 GPIO_ACTIVE_HIGH>;
			};
		};
	};


Example:
	pmic: da9122@68 {
		compatible = "dlg,da9122";
		reg = <0x68>;

		interrupt-parent = <&gpio6>;
		interrupts = <11 IRQ_TYPE_LEVEL_LOW>;

		dlg,irq-polling-delay-passive = <2000>;

		regulators {
			DA9122_BUCK1: buck1 {
				regulator-name = "BUCK1";
				regulator-min-microvolt = <300000>;
				regulator-max-microvolt = <1900000>;
				regulator-min-microamp = <3500000>;
				regulator-max-microamp = <10000000>;
				regulator-boot-on;
				regulator-initial-mode = <DA9121_BUCK_MODE_AUTO>;
				dlg,enable-gpio = <&gpio6 1 GPIO_ACTIVE_HIGH>;
				dlg,ripple-cancel = <DA9121_BUCK_RIPPLE_CANCEL_NONE>;
			};
			DA9122_BUCK2: buck2 {
				regulator-name = "BUCK2";
				regulator-min-microvolt = <300000>;
				regulator-max-microvolt = <1900000>;
				regulator-min-microamp = <3500000>;
				regulator-max-microamp = <10000000>;
				regulator-boot-on;
				regulator-initial-mode = <DA9121_BUCK_MODE_AUTO>;
				dlg,enable-gpio = <&gpio6 2 GPIO_ACTIVE_HIGH>;
				dlg,ripple-cancel = <DA9121_BUCK_RIPPLE_CANCEL_NONE>;
			};
		};
	};
```

## Documentation/devicetree/bindings/remoteproc/mb_remoteproc.txt
```
Xilinx ARM-Microblaze remoteproc driver

This driver requires specific Zynq hardware design where Microblaze is added
to the programmable logic.
Microblaze is connected with PS block via axi bus connected to PS HP port
to ensure access to PS DDR.
Communication channels are done via soft GPIO IP connected to PS block
and to Microblaze. There are also 2 gpio control signals reset and debug
which are used for reseting Microblaze.

Required properties:
- compatible : Should be "xlnx,mb_remoteproc"
- reg : Address and length of the ddr address space
- bram: Phandle to bram controller which can access Microblaze BRAM
- bram-firmware : Microblaze BRAM bootloader name
- firmware : Default firmware name which can be override by
	     "firmware" module parameter
- reset : Gpio phandle which reset Microblaze remoteproc
- debug : Gpio phandle which setup Microblaze to debug state
- ipino : Gpio phandle for Microblaze to ARM communication
- vring0 : Gpio phandle for ARM to Microblaze communication vring 0
- vring1 : Gpio phandle for ARM to Microblaze communication vring 1

Microblaze SoC can be also connected to the PS block via a axi bus.
That's why there is the option to allocate interrupts for Microblaze use only.
The driver will allocate interrupts to itself and Microblaze sw has to ensure
that interrupts are properly enabled and handled by Microblaze interrupt
controller.

Optional properties:
 - interrupts : Interrupt mapping for remoteproc
 - interrupt-parent : Phandle for the interrupt controller

Example:
test_mb: mb_remoteproc-test@800000 {
	compatible = "xlnx,mb_remoteproc";
	reg = < 0x8000000 0x8000000 >;
	bram = <&axi_bram_ctrl_0>;
	bram-firmware = "mb.bin";
	firmware = "image.elf";
	reset = <&zynq_gpio_reset 1 0>;
	debug = <&zynq_gpio_reset 0 0>;
	ipino = <&zynq_gpio_vring 0 0>;
	vring0 = <&zynq_gpio_vring 1 0>;
	vring1 = <&zynq_gpio_vring 2 0>;
} ;
```

## Documentation/devicetree/bindings/remoteproc/r5_remoteproc.txt
```
Xilinx ARM Cortex A53-R5 remoteproc driver
==========================================

ZynqMP family of devices use two Cortex R5 processors to help with various
low power / real time tasks.

This driver requires specific ZynqMP hardware design.

ZynqMP R5 RemoteProc Device Node:
=================================
A zynqmp_r5_remoteproc device node is used to represent a R5 IP instance
within ZynqMP SoC.

Required properties:
--------------------
 - compatible : Should be "xlnx,zynqmp-r5-remoteproc-1.0"
 - reg : Address and length of the register set for the device. It
        contains in the same order as described reg-names
 - reg-names: Contain the register set names.
              "rpu_base" for RPU config register and "rpu_glbl_base" for RPU
               global control register must be provided. If the user uses the
               remoteproc driver with the RPMsg kernel driver, "ipi" for the IPI
               register used to communicate with RPU is also required.
               Otherwise, if user only uses the remoteproc driver to boot RPU
               firmware, "ipi" is not required.
 - srams : firmware memories
 - pd-handle : power domain handle, as remoteproc is not hooked into
               Linux runtime power management, we will not use
               "power-domains" for the power domain handler. We use
               the power domain handler only to get the power domain
               id which is required to power on RPU.

Optional properties:
--------------------
 - core_conf : R5 core configuration (valid string - split0 or split1 or
               lock-step), default is lock-step.
 - interrupts : Interrupt mapping for remoteproc IPI. It is required if the
                user uses the remoteproc driver with the RPMsg kernel driver.
 - interrupt-parent : Phandle for the interrupt controller. It is required if
                      the user uses the remoteproc driver with the RPMsg kernel
                      kernel driver.

Example:
--------
	power-domains {
		pd_r5_0: pd_r5_0 {
			#power-domain-cells = <0x0>;
			pd-id = <0x7>;
		};
		pd_tcm_0_a: pd_tcm_0_a {
			#power-domain-cells = <0x0>;
			pd-id = <0xf>;
		};
		pd_tcm_0_b: pd_tcm_0_b {
			#power-domain-cells = <0x0>;
			pd-id = <0x10>;
		};
	};

	r5_0_tcm_a: tcm@ffe00000 {
		compatible = "mmio-sram";
		reg = <0x0 0xFFE00000 0x0 0x20000>;
		pd-handle = <&pd_tcm_0_a>;
	};
	r5_0_tcm_b: tcm@ffe20000 {
		compatible = "mmio-sram";
		reg = <0x0 0xFFE20000 0x0 0x20000>;
		pd-handle = <&pd_tcm_0_b>;
	};
	elf_ddr_0: ddr@3ed00000 {
		compatible = "mmio-sram";
		reg = <0x0 0x3ed00000 0x0 0x40000>;
	};

	zynqmp-r5-remoteproc@0 {
		compatible = "xlnx,zynqmp-r5-remoteproc-1.0";
		reg = <0x0 0xff9a0100 0x0 100>,
			<0x0 0xff340000 0x0 0x100>,
			<0x0 0xff9a0000 0x0 0x100>,
		reg-names = "rpu_base", "ipi", "rpu_glbl_base";
		core_conf = "split0";
		srams = <&r5_0_tcm_a &r5_0_tcm_b &elf_ddr_0>;
		interrupt-parent = <&gic>;
		interrupts = <0 29 4>;
		pd-handle = <&pd_r5_0>;
	} ;
```

## Documentation/devicetree/bindings/remoteproc/xilinx,zynqmp-r5-remoteproc.txt
```
Xilinx ARM Cortex A53-R5 remoteproc driver
==========================================

ZynqMP family of devices use two Cortex R5 processors to help with various
low power / real time tasks.

This driver requires specific ZynqMP hardware design.

ZynqMP R5 Device Node:
=================================
A ZynqMP R5 device node is used to represent RPU domain
within ZynqMP SoC. This device node contains RPU processor
subnodes.

Required Properties:
--------------------
 - compatible : Should be "xlnx,zynqmp-r5-remoteproc-1.0"
 - core_conf : R5 core configuration (valid string - split or lock-step)
 - interrupts : Interrupt mapping for remoteproc IPI. It is required if the
                user uses the remoteproc driver with the RPMsg kernel driver.
 - interrupt-parent : Phandle for the interrupt controller. It is required if
                      the user uses the remoteproc driver with the RPMsg kernel
                      kernel driver.

ZynqMP R5 Remoteproc Device Node:
=================================
A ZynqMP R5 Remoteproc device node is used to represent a RPU processor.
It is a subnode to the ZynqMP R5 device node. It also contains tightly
coupled memory subnodes.

Required Properties:
--------------------
 - pnode-id:	ZynqMP R5 processor power domain ID which will be used by
		ZynqMP power management unit to idetify the processor.

Optional Properties:
--------------------
 - memory-region: reversed memory which will be used by R5 processor


ZynqMP R5 Remoteproc Device Node:
=================================
A ZynqMP R5 Remoteproc device node is used to represent a RPU processor.
It is a subnode to the ZynqMP R5 device node.

Required Properties:
--------------------
 - pnode-id:	ZynqMP R5 processor power domain ID which will be used by
		ZynqMP power management unit to idetify the processor.

Optional Properties:
--------------------
 - memory-region:	reversed memory which will be used by R5 processor
 - mboxes:		Specify tx and rx mailboxes
 - mbox-names:		List of identifier strings for tx/rx mailbox channel.

ZynqMP R5 TCM Device Node:
=================================
The ZynqMP R5 TCM device node is used to represent the TCM memory.
It is a subnode to the ZynqMP R5 processor.

Required Properties:
--------------------
 - reg:		TCM address range
 - pnode-id:	TCM power domain ID


Example:
--------
	reserved-memory {
		#address-cells = <2>;
		#size-cells = <2>;
		ranges;
		/* R5 0 firmware memory in DDR */
		rproc_0_fw_reserved: rproc@3ed000000 {
			no-map;
			reg = <0x0 0x3ed00000 0x0 0x40000>;
		};
		/* DMA shared memory between APU and RPU */
		rproc_0_dma_reserved: rproc@3ed400000 {
			compatible = "shared-dma-pool";
			no-map;
			reg = <0x0 0x3ed40000 0x0 0x100000>;
		};
	};

	zynqmp-r5-remoteproc@0 {
		compatible = "xlnx,zynqmp-r5-remoteproc-1.0";
		core_conf = "split";
		#address-cells = <2>;
		#size-cells = <2>;
		ranges;
		r5-0: r5@0 {
			#address-cells = <2>;
			#size-cells = <2>;
			ranges;
			memory-region = <&rproc_0_fw_reserved>,
					<&rproc_0_dma_reserved>;
			pnode-id = <0x7>;
			mboxes = <&ipi_mailbox_rpu0 0>, <&ipi_mailbox_rpu0 1>;
			mbox-names = "tx", "rx";
			tcm-a: tcm@0 {
				reg = <0x0 0xFFE00000 0x0 0x10000>,
				pnode-id = <0xf>;
			};
			tcm-b: tcm@1 {
				reg = <0x0 0xFFE20000 0x0 0x10000>,
				pnode-id = <0x10>;
			};
		};
	} ;

	zynqmp_ipi {
		compatible = "xlnx,zynqmp-ipi-mailbox";
		interrupt-parent = <&gic>;
		interrupts = <0 29 4>;
		xlnx,ipi-id = <7>;
		#address-cells = <1>;
		#size-cells = <1>;
		ranges;

		/* APU<->RPU0 IPI mailbox controller */
		ipi_mailbox_rpu0: mailbox@ff90600 {
			reg = <0xff990600 0x20>,
			      <0xff990620 0x20>,
			      <0xff9900c0 0x20>,
			      <0xff9900e0 0x20>;
			reg-names = "local_request_region",
				    "local_response_region",
				    "remote_request_region",
				    "remote_response_region";
			#mbox-cells = <1>;
			xlnx,ipi-id = <1>;
		};
	};
```
