## Documentation/devicetree/bindings/phy/xlnx,vphy.txt
```
Xilinx VPHY (Staging)

The Xilinx Video PHY is a high-level video-specific wrapper around
different versions of the GT PHY. Its driver is phy/phy-xilinx-vphy.c

It offers the PHY driver interface as well as higher-level video
specific support functions.

Its current users are Xilinx HDMI RX/TX SS.
(See xlnx,v-hdmi-rx-ss.txt and xlnx,v-hdmi-tx-ss.txt)


Required Properties:
 - compatible: Should be "xlnx,vid-phy-controller-2.0".
 - reg: Base address and size of the IP core.
 - interrupts: Interrupt number.
 - interrupts-parent: phandle for interrupt controller.
 
 - clocks: phandle for axi-lite clock and dru clock
 - clock-names: The identification string, "axi-lite", is always required
          and "dru-clk" is required for NI DRU clock for phy
		  
 - phys: phandle for phy lanes registered for hdmi protocol. HDMI always 
         require 3 lanes
 - phy-names: The identification string, "hdmi-phy0" and so on

 - xlnx,input-pixels-per-clock: IP configuration for samples/clk (1, 2, 4)
         Note: Only 2 is supported at this time

 - xlnx,nidru: flag to indicate if DRU is present
 - xlnx,nidru-refclk-sel: DRU clock selector
 - xlnx,rx-no-of-channels: Required Rx channels for registered protocol
 - xlnx,rx-pll-selection: Rx pll selector
 - xlnx,rx-protocol: 1=HDMI, 0=DP (Note: Only HDMI is supported at this time)
 - xlnx,rx-refclk-sel: Reference Rx clock selector
 - xlnx,tx-no-of-channels: Required Rx channels for registered protocol
 - xlnx,tx-pll-selection = Tx pll selector
 - xlnx,tx-protocol: 1=HDMI, 0=DP (Note: Only HDMI is supported at this time)
 - xlnx,tx-refclk-sel: Reference Rx clock selector
 - xlnx,hdmi-fast-switch: Flag to indicate fast switching logic availability
 - xlnx,transceiver-type: GT type. Must be set per GT device used
 - xlnx,tx-buffer-bypass: Flag to indicate buffer bypass logic availability
 - xlnx,transceiver-width: Defines 4 Byte or 2 Byte mode
                      (Note: Only 4 byte is supported at this time) 

 - lane<n>: (port (child) nodes)
	lane0:
		- #phy-cells	: Should be 4
			Cell after port phandle is device type from:
			- <controller_type controller_instance is_shared direction_tx>

			controller_type = 0 for HDMI
            controller_instance = [0, ...] indexes the instance of the protocol
                                  controller	
            is_shared = 1 if the RX and TX can be shared across the same 
			            protocol/controller
            direction_tx = 0 for RX and 1 for TX

(These properties are intended for future steering of multiple protocols 
sharing VPHYs, and are therefore subject to change.)

An example is, with comments for work-in-progress (TODO):

	vid_phy_controller_0: vid_phy_controller@a0090000 {
		compatible = "xlnx,vid-phy-controller-2.0";
		reg = <0x0 0xa0090000 0x0 0x10000>;
		interrupts = <0 92 4>;
		interrupt-parent = <&gic>;
		clocks = <&vid_s_axi_clk>, <&si570_2>;
		clock-names = "axi-lite", "dru-clk";

		xlnx,input-pixels-per-clock = <0x2>;
		xlnx,nidru = <0x1>;
		xlnx,nidru-refclk-sel = <0x4>;
		xlnx,rx-no-of-channels = <0x3>;
		xlnx,rx-pll-selection = <0x0>;
		xlnx,rx-protocol = <0x1>;
		xlnx,rx-refclk-sel = <0x1>;
		xlnx,tx-no-of-channels = <0x3>;
		xlnx,tx-pll-selection = <0x6>;
		xlnx,tx-protocol = <0x1>;
		xlnx,tx-refclk-sel = <0x0>;
		xlnx,hdmi-fast-switch = <0x1>;
		xlnx,transceiver-type = <0x5>;
		xlnx,tx-buffer-bypass = <0x1>;
		xlnx,transceiver-width = <4>;

		vphy_lane0: vphy_lane@0 {
			#phy-cells = <4>;
		};
		vphy_lane1: vphy_lane@1 {
			#phy-cells = <4>;
		};
		vphy_lane2: vphy_lane@2 {
			#phy-cells = <4>;
		};
		vphy_lane3: vphy_lane@3 {
			#phy-cells = <4>;
		};
	};
```

## Documentation/devicetree/bindings/pinctrl/xlnx,zynqmp-pinctrl.txt
```
	Binding for Xilinx ZynqMP Pinctrl

Required properties:
- compatible: "xlnx,zynqmp-pinctrl"
- reg: Offset and length of pinctrl space in IOU_SLCR

Please refer to pinctrl-bindings.txt in this directory for details of the
common pinctrl bindings used by client devices, including the meaning of the
phrase "pin configuration node".

ZynqMP's pin configuration nodes act as a container for an arbitrary number of
subnodes. Each of these subnodes represents some desired configuration for a
pin, a group, or a list of pins or groups. This configuration can include the
mux function to select on those pin(s)/group(s), and various pin configuration
parameters, such as pull-up, slew rate, etc.

Each configuration node can consist of multiple nodes describing the pinmux and
pinconf options. Those nodes can be pinmux nodes or pinconf nodes.

The name of each subnode is not important; all subnodes should be enumerated
and processed purely based on their content.

Required properties for pinmux nodes are:
 - groups: A list of pinmux groups.
 - function: The name of a pinmux function to activate for the specified set
   of groups.

Required properties for configuration nodes:
One of:
 - pins: A list of pin names
 - groups: A list of pinmux groups.

The following generic properties as defined in pinctrl-bindings.txt are valid
to specify in a pinmux subnode:
 groups, function

The following generic properties as defined in pinctrl-bindings.txt are valid
to specify in a pinconf subnode:
 groups, pins, bias-disable, bias-pull-up, bias-pull-down, slew-rate

 Valid arguments for 'slew-rate' are 'SLEW_RATE_SLOW' and 'SLEW_RATE_FAST' to
 select between slow and fast respectively.

 Valid values for groups are:
  ethernet0_0_grp, ethernet1_0_grp, ethernet2_0_grp, ethernet3_0_grp,
  gemtsu0_0_grp - gemtsu0_2_grp, mdio0_0_grp, mdio1_0_grp - mdio1_1_grp,
  mdio2_0_grp, mdio3_0_grp, qspi0_0_grp, qspi_ss_grp, qspi_fbclk_grp,
  spi0_0_grp - spi0_5_grp, spi0_0_ss0_grp - spi0_5_ss0_grp,
  spi0_0_ss1_grp - spi0_5_ss1_grp, spi0_0_ss2_grp - spi0_5_ss2_grp,
  spi1_0_grp - spi1_5_grp, spi1_0_ss0_grp - spi1_5_ss0_grp,
  spi1_0_ss1_grp - spi1_5_ss1_grp, spi1_0_ss2_grp - spi1_5_ss2_grp,
  sdio0_0_grp - sdio0_2_grp, sdio0_0_pc_grp - sdio0_2_pc_grp,
  sdio0_0_cd_grp - sdio0_2_cd_grp, sdio0_0_wp_grp - sdio0_2_wp_grp,
  sdio1_0_grp - sdio1_1_grp, sdio1_0_pc_grp - sdio1_1_pc_grp,
  sdio1_0_cd_grp - sdio1_1_cd_grp, sdio1_0_wp_grp - sdio1_2_wp_grp,
  sdio1_1bit_0_0_grp - sdio1_1bit_0_7_grp,
  sdio1_1bit_1_0_grp - sdio1_1bit_1_3_grp,
  sdio0_4bit_0_0_grp - sdio0_4bit_0_1_grp,
  sdio0_4bit_1_0_grp - sdio0_4bit_1_1_grp,
  sdio0_4bit_2_0_grp - sdio0_4bit_2_1_grp,
  sdio0_1bit_0_0_grp - sdio0_1bit_0_7_grp,
  sdio0_1bit_1_0_grp - sdio0_1bit_1_7_grp,
  sdio0_1bit_2_0_grp - sdio0_1bit_2_7_grp,
  sdio1_4bit_0_0_grp - sdio1_4bit_0_1_grp, sdio1_4bit_1_0_grp,
  nand0_0_grp, nand0_0_ce_grp - nand0_1_ce_grp,
  nand0_0_rb_grp - nand0_1_rb_grp, nand0_0_dqs_grp - nand0_1_dqs_grp,
  can0_0_grp - can0_18_grp, can1_0_grp - can1_19_grp,
  uart0_0_grp - uart0_18_grp, uart1_0_grp - uart1_18_grp,
  i2c0_0_grp - i2c0_18_grp, i2c1_0_grp - i2c1_19_grp,
  ttc0_0_clk_grp - ttc0_8_clk_grp, ttc0_0_wav_grp - ttc0_8_wav_grp,
  ttc1_0_clk_grp - ttc1_8_clk_grp, ttc1_0_wav_grp - ttc1_8_wav_grp,
  ttc2_0_clk_grp - ttc2_8_clk_grp, ttc2_0_wav_grp - ttc2_8_wav_grp,
  ttc3_0_clk_grp - ttc3_8_clk_grp, ttc3_0_wav_grp - ttc3_8_wav_grp,
  swdt0_0_clk_grp - swdt0_12_clk_grp, swdt0_0_rst_grp - swdt0_12_rst_grp,
  swdt1_0_clk_grp - swdt1_12_clk_grp, swdt1_0_rst_grp - swdt1_12_rst_grp,
  gpio0_0_grp_grp - gpio0_77_grp, usb0_0_grp, usb1_0_grp,
  pmu0_0_grp - pmu0_11_grp,
  pcie0_0_grp - pcie0_7_grp, csu0_0_grp - csu0_11_grp,
  dpaux0_0_grp - dpaux0_3_grp, pjtag0_0_grp - pjtag0_5_grp,
  trace0_0_grp - trace0_2_grp, trace0_0_clk_grp - trace0_2_clk_grp,
  testscan0_0_grp

 Valid values for pins are:
   MIO0 - MIO77

 Valid values for function are:
   ethernet0, ethernet1, ethernet2, ethernet3, gemtsu0, usb0, usb1, mdio0,
   mdio1, mdio2, mdio3, qspi0, qspi_fbclk, qspi_ss, spi0, spi1, spi0_ss,
   spi1_ss, sdio0, sdio0_pc, sdio0_wp, sdio0_cd, sdio1, sdio1_pc, sdio1_wp,
   sdio1_cd, nand0, nand0_ce, nand0_rb, nand0_dqs, can0, can1, uart0, uart1,
   i2c0, i2c1, ttc0_clk, ttc0_wav, ttc1_clk, ttc1_wav, ttc2_clk, ttc2_wav,
   ttc3_clk, ttc3_wav, swdt0_clk, swdt0_rst, swdt1_clk, swdt1_rst, gpio0, pmu0,
   pcie0, csu0, dpaux0, pjtag0, trace0, trace0_clk, testscan0

The following driver-specific properties as defined here are valid to specify in
a pin configuration subnode:
 - io-standard: Configure the pin to use the selected IO standard. Valid
   arguments are 'IO_STANDARD_LVCMOS33' and 'IO_STANDARD_LVCMOS18'.
 - schmitt-cmos: Selects either Schmitt or CMOS input for MIO pins. Valid
   arguments are 'PIN_INPUT_TYPE_SCHMITT' and 'PIN_INPUT_TYPE_CMOS'.

Example:
	pinctrl0: pinctrl@ff180000 {
		compatible = "xlnx,pinctrl-zynqmp";
		reg = <0x0 0xff180000 0x0 0x1000>;

		pinctrl_uart1_default: uart1-default {
			mux {
				groups = "uart0_4_grp";
				function = "uart0";
			};

			conf {
				groups = "uart0_4_grp";
				slew-rate = <SLEW_RATE_SLOW>;
				io-standard = <IO_STANDARD_LVCMOS18>;
			};

			conf-rx {
				pins = "MIO18";
				bias-high-impedance;
			};

			conf-tx {
				pins = "MIO19";
				bias-disable;
				schmitt-cmos = <PIN_INPUT_TYPE_CMOS>;
			};
		};
	};
```

## Documentation/devicetree/bindings/power/reset/xlnx,zynqmp-power.yaml
```yaml
# SPDX-License-Identifier: (GPL-2.0-only OR BSD-2-Clause)
%YAML 1.2
---
$id: http://devicetree.org/schemas/power/reset/xlnx,zynqmp-power.yaml#
$schema: http://devicetree.org/meta-schemas/core.yaml#

title: Xilinx Zynq MPSoC Power Management Driver

maintainers:
  - Abhyuday Godhasara <abhyuday.godhasara@xilinx.com>

description: |
  The zynqmp-power node describes the power management configurations.
  It will control remote suspend/shutdown interfaces.

select: false

properties:
  compatible:
    const: xlnx,zynqmp-power

  mboxes:
    description: Standard property to specify a Mailbox. Each value of
      the mboxes property should contain a phandle to the mailbox
      controller device node and an args specifier that will be the
      phandle to the intended sub-mailbox child node to be used for
      communication.
      See Documentation/devicetree/bindings/mailbox/mailbox.txt
      for more details about the generic mailbox controller and
      client driver bindings.
      Also see Documentation/devicetree/bindings/mailbox/ \
      xlnx,zynqmp-ipi-mailbox.txt for typical controller that
      is used to communicate with these system controllers.

    items:
      - description: transmit channel
      - description: receive channel

  mbox-names:
    description: Name given to channels seen in the 'mboxes' property.
                 "rx" - Mailbox corresponding to receive path
                 "tx" - Mailbox corresponding to transmit path

    items:
      - const: tx
      - const: rx

  interrupts:
    maxItems: 1

required:
  - compatible
  - interrupts

additionalProperties: false

examples:
  - |
    firmware {
      zynqmp_firmware: zynqmp-firmware {
        compatible = "xlnx,zynqmp-firmware";
        zynqmp_power: zynqmp-power {
          compatible = "xlnx,zynqmp-power";
          interrupts = <0 35 4>;
          mboxes = <&ipi_mailbox_pmu0 0>, <&ipi_mailbox_pmu0 1>;
          mbox-names = "tx", "rx";
        };
      };
    };
```

## Documentation/devicetree/bindings/power/zynqmp-genpd.txt
```
Device Tree bindings for Xilinx Zynq MPSoC PM domains

The binding for zynqmp-genpd follow the common generic PM domain binding[1].

[1] Documentation/devicetree/bindings/power/power_domain.txt

== Zynq MPSoC Generic PM Domain Node ==

Required properties:
 - compatible: Must be: "xlnx,zynqmp-genpd"

This node contains a number of subnodes, each representing a single PM domain
that PM domain consumer devices reference.

== PM Domain Nodes ==

Required properties:
 - #power-domain-cells: Number of cells in a PM domain specifier. Must be 0.
 - pd-id: List of domain identifiers of as defined by platform firmware. These
	  identifiers are passed to the PM firmware.

Example:
	zynqmp-genpd {
		compatible = "xlnx,zynqmp-genpd";

		pd_usb0: pd-usb0 {
			pd-id = <22>;
			#power-domain-cells = <0>;
		};

		pd_sata: pd-sata {
			pd-id = <25>;
			#power-domain-cells = <0>;
		};

		pd_gpu: pd-gpu {
			pd-id = <58 20 21>;
			#power-domain-cells = <0x0>;
		};
	};

	sata0: ahci@SATA_AHCI_HBA {
		...
		power-domains = <&pd_sata>;
		...
	};
```

## Documentation/devicetree/bindings/ptp/ptp-xilinx.yaml
```yaml
# SPDX-License-Identifier: GPL-2.0-or-later OR BSD-2-Clause
%YAML 1.2
---
$id: http://devicetree.org/schemas/ptp/xilinx/ptp-xilinx.yaml#
$schema: http://devicetree.org/meta-schemas/core.yaml#

title: Xilinx 1588 PTP timer-syncer

maintainers:
  - Harini Katakam <harini.katakam@xilinx.com>

description: |
  Xilinx 1588 PTP timer-syncer IP provides  precision timing functionality
  along with capabiity for time and fine adjustment. This IP is provided
  for use with Xilinx Ethernet MAC with HW timestamping capability.

properties:
  compatible:
    const: xlnx,timer-syncer-1588-1.0

  reg:
    description: |
      Offset and length of the register set for the device.

required:
  - compatible
  - reg

examples:
  - |
    ptp_timer@80000000 {
        compatible = "xlnx,timer-syncer-1588-1.0";
        reg = <0x0 0x80000000 0x0 0x10000>;
    };
```
