## Documentation/devicetree/bindings/remoteproc/xilinx,zynqmp-r5-remoteproc.yaml
```yaml
# SPDX-License-Identifier: (GPL-2.0 OR BSD-2-Clause)
%YAML 1.2
---
$id: http://devicetree.org/schemas/remoteproc/xilinx,zynqmp-r5-remoteproc.yaml#
$schema: http://devicetree.org/meta-schemas/core.yaml#

title: Xilinx R5 remote processor controller

description:
  This document defines the binding for the remoteproc component that loads and
  boots firmwares on the Xilinx Zynqmp and Versal family chipsets.

  Note that the Linux has global addressing view of the R5-related memory (TCM)
  so the absolute address ranges are provided in TCM reg's.

maintainers:
  - Ben Levinsky <ben.levinsky@amd.com>

properties:
  $nodename:
    pattern: "^r5[f|2]ss(@.*)?"

  compatible:
    enum:
      - xlnx,zynqmp-r5-remoteproc
      - xlnx,versal-r5-remoteproc
      - xlnx,versal-net-r52-remoteproc

  reg:
    items:
      - description: Address and Size of Xilinx RPU Configuration register

  "#address-cells":
    const: 2

  "#size-cells":
    const: 2

  ranges: true

# Optional properties:
# --------------------
  xlnx,cluster-mode:
    $ref: /schemas/types.yaml#/definitions/uint32
    enum: [0, 1]
    description: |
      Configuration Mode for the Dual R5F cores within the R5F cluster.
      Should be either a value of 0 (LockStep mode) or 1 (Split mode),
      default is LockStep mode if omitted.

# R5F Processor Child Nodes:
# ==========================

patternProperties:
  "^r5[f|2]_[a-f0-9]+$":
    type: object
    description: |
      The R5F Sub-System device node should define one or two R5F child nodes,
      each node representing a Xilinx instantiation of the Arm Cortex R5F core.
      There should be one or two child nodes if the R5F is in Split mode and
      one child node if the R5F is in Lockstep mode.

      In Split mode each R5F core has two associated TCM Banks. R5_0 has
      TCM Banks 0A and 0B and R5_1 has TCM Banks 1A and 1B.

      In Lockstep mode only one R5F child node should be defined. This one
      child has access to TCM Banks 0A, 0B, 1A and 1B and any of the four can
      be included in the child R5F's sram property.

      This also supports arm-cortexr52 clusters on Versal-net platform with
      the same runtime modes.

      The example below shows Split mode with two child nodes.

    properties:
      compatible:
        enum:
          - xilinx,r5f
          - xilinx,r52

# The following properties are mandatory for R5F Core0 in both LockStep and Split
# modes, and are mandatory for R5F Core1 _only_ in Split mode.

      memory-region:
        description: |
          Phandles to the memory nodes to be associated with the
          The reserved memory nodes should be carveout nodes, and
          should be defined with a "no-map" property as per the bindings in
          Documentation/devicetree/bindings/reserved-memory/reserved-memory.txt
        minItems: 1
        maxItems: 6
        items:
          - description: Region used for dynamic DMA allocations like vrings and
                         vring buffers
          - description: region reserved for firmware image sections
        additionalItems: true

      power-domain:
        $ref: /schemas/types.yaml#/definitions/uint32
        description: |
          Power node ID that is used to uniquely identify the RPU for Xilinx
          Power Management.

# Optional properties:
# --------------------
# The following properties are optional properties for each of the R5F cores:

      mboxes:
        description: |
          Standard property to specify a mailbox
          This property is required only if the rpmsg/virtio functionality
          is used

           Refer to the zynqmp-ipi-mailbox documentation for client usage of this
           property
        maxItems: 1

      mbox-names:
        description: |
          Refer to the zynqmp-ipi-mailbox documentation for client usage of this
          property
        items:
          - const: tx
          - const: rx

      sram:
        $ref: /schemas/types.yaml#/definitions/phandle-array
        minItems: 1
        maxItems: 4
        items:
          maxItems: 1
        description: |
          Phandles to one or more reserved on-chip SRAM regions. The regions
          should be defined as child nodes of the respective SRAM node, and
          should be defined as per the generic bindings in,
          Documentation/devicetree/bindings/sram/sram.yaml

      xlnx,rsc-tbl:
        $ref: /schemas/types.yaml#/definitions/phandle-array
        items:
          - items:
              - description: Phandle of carveout
              - description: The location of the resource table. It is expected
                             that the address is within the carveout. If not, then
                             the resource table physical address will not be stored
                             and attach will not work.
        description: |
          Reference to the carveout that has the resource table. The second
          argument is the address within the carveout where the resource table
          is located.

    required:
      - compatible
      - power-domain

    unevaluatedProperties: false

required:
  - reg
  - compatible
  - "#address-cells"
  - "#size-cells"
  - ranges

additionalProperties: false

examples:
  - |
    / {
        compatible = "xlnx,zynqmp-zcu102-rev1.0", "xlnx,zynqmp-zcu102", "xlnx,zynqmp";
        #address-cells = <2>;
        #size-cells = <2>;
        model = "ZynqMP ZCU102 ";

        r5fss@ff9a0000 {
          compatible = "xlnx,zynqmp-r5-remoteproc";
          #address-cells = <2>;
          #size-cells = <2>;
          ranges;
          reg = <0x0 0xff9a0000 0x0 0x10000>;
          xlnx,cluster-mode = <0>;

          r5f_0 {
               compatible = "xilinx,r5f";
               memory-region = <&elf_load0>,
                               <&rpu0vdev0vring0>,
                               <&rpu0vdev0vring1>,
                               <&rpu0vdev0buffer>;
               sram = <&tcm_0a>, <&tcm_0b>;
               power-domain = <0x7>;
               xlnx,rsc-tbl  = <&rproc_0_reserved 0x3ed20000>;
          };
          r5f_1 {
               compatible = "xilinx,r5f";
               memory-region = <&elf_load1>,
                               <&rpu1vdev0vring0>,
                               <&rpu1vdev0vring1>,
                               <&rpu1vdev0buffer>;
               sram = <&tcm_1a>, <&tcm_1b>;
               power-domain = <0x8>;
          };

        };
    };

...
```

## Documentation/devicetree/bindings/remoteproc/zynq_remoteproc.txt
```
Xilinx ARM Cortex A9-A9 remoteproc driver
==========================================

Zynq family of devices can use one A9 processor to help with various
low power / real time tasks.

This driver requires specific Zynq hardware design.

Zynq RemoteProc Device Node:
=================================
A zynq_remoteproc device node is used to represent the 2nd A9 instance
within Zynq SoC.

Required properties:
--------------------
 - compatible : should be "xlnx,zynq_remoteproc"
 - vring0: soft interrupt for kicking from firmware
 - vring1: soft interrupt for kicking from Linux kernel

Optional Properties:
--------------------
 - memory-region: reserved memory which will be used by R5 processor

Example:
--------

	reserved-memory {
		#address-cells = <1>;
		#size-cells = <1>;
		ranges;
		rproc_0_reserved: rproc@3e000000 {
			no-map;
			reg = <0x3e000000 0x400000>;
		};
		rproc_0_dma: rproc@3e800000 {
			no-map;
			compatible = "shared-dma-pool";
			reg = <0x3e800000 0x100000>;
		};
	};

	zynq_remoteproc@0 {
		compatible = "xlnx,zynq_remoteproc";
		vring0 = <15>;
		vring1 = <14>;
		memory-region = <&rproc_0_reserved>, <&rproc_0_dma>;
	};
```

## Documentation/devicetree/bindings/reset/zynqmp-reset.txt
```
Xilinx Zynqmp Reset Manager

The Zynq UltraScale+ MPSoC has several different resets.

See Chapter 36 of the Zynq UltraScale+ MPSoC TRM (UG) for more information
about zynqmp resets.

Please also refer to reset.txt in this directory for common reset
controller binding usage.

Required Properties:
- compatible: "xlnx,zynqmp-reset"
- #reset-cells : Specifies the number of cells needed to encode reset
		line, should be 1

Reset outputs:
	0   :PCIE config reset.
	1   :PCIE bridge block level reset (AXI interface).
	2   :PCIE control block level,reset.
	3   :Display Port block level reset (includes DPDMA).
	4   :FPD WDT reset.
	5   :AF_FM5 block level reset.
	6   :AF_FM4 block level reset.
	7   :AF_FM3 block level reset.
	8   :AF_FM2 block level reset.
	9   :AF_FM1 block level reset.
	10  :AF_FM0 block level reset.
	11  :GDMA block level reset.
	12  :Pixel Processor (GPU_PP1) block level reset.
	13  :Pixel Processor (GPU_PP0) block level reset.
	14  :GPU block level reset.
	15  :GT block level reset.
	16  :Sata block level reset.
	17  :ACPU3 power on reset.
	18  :ACPU2 power on reset.
	19  :ACPU1 power on reset.
	20  :ACPU0 power on reset.
	21  :APU L2 reset.
	22  :ACPU3 reset.
	23  :ACPU2 reset.
	24  :ACPU1 reset.
	25  :ACPU0 reset.
	26  :DDR block level reset inside of the DDR Sub System.
	27  :APM block level reset inside of the DDR Sub System.
	28  :soft reset.
	29  :GEM 0 reset.
	30  :GEM 1 reset.
	31  :GEM 2 reset.
	32  :GEM 3 reset.
	33  :qspi reset.
	34  :uart0 reset.
	35  :uart1 reset.
	36  :spi0 reset.
	37  :spi1 reset.
	38  :sdio0 reset.
	39  :sdio1 reset.
	40  :can0 reset.
	41  :can1 reset.
	42  :i2c0 reset.
	43  :i2c1 reset.
	44  :ttc0 reset.
	45  :ttc1 reset.
	46  :ttc2 reset.
	47  :ttc3 reset.
	48  :swdt reset.
	49  :nand reset.
	50  :adma reset.
	51  :gpio reset.
	52  :iou_cc reset.
	53  :timestamp reset.
	54  :rpu_r50 reset.
	55  :rpu r51 reset.
	56  :rpu_amba reset.
	57  :ocm reset.
	58  :rpu_pge reset.
	59  :usb0_core reset.
	60  :usb1_core reset.
	61  :usb0_hiber reset.
	62  :usb1_hiber reset.
	63  :usb0_apb reset.
	64  :usb1_apb reset.
	65  :ipi reset.
	66  :apm reset.
	67  :rtc reset.
	68  :sysmon reset.
	69  :afi_fm6 reset.
	70  :lpd_swdt reset.
	71  :fpd_reset.
	72  :rpu_dbg1 reset.
	73  :rpu_dbg0 reset.
	74  :dbg_lpd reset.
	75  :dbg_fpd reset.
	76  :apll reset.
	77  :dpll reset.
	78  :vpll reset.
	79  :iopll reset.
	80  :rpll reset.
	81  :gpio_pl_0 reset.
	82  :gpio_pl_1 reset.
	83  :gpio_pl_2 reset.
	84  :gpio_pl_3 reset.
	85  :gpio_pl_4 reset.
	86  :gpio_pl_5 reset.
	87  :gpio_pl_6 reset.
	88  :gpio_pl_7 reset.
	89  :gpio_pl_8 reset.
	90  :gpio_pl_9 reset.
	91  :gpio_pl_10 reset.
	92  :gpio_pl_11 reset.
	93  :gpio_pl_12 reset.
	94  :gpio_pl_13 reset.
	95  :gpio_pl_14 reset.
	96  :gpio_pl_15 reset.
	97  :gpio_pl_16 reset.
	98  :gpio_pl_17 reset.
	99  :gpio_pl_18 reset.
	100 :gpio_pl_19 reset
	101 :gpio_pl_20 reset.
	102 :gpio_pl_21 reset.
	103 :gpio_pl_22 reset.
	104 :gpio_pl_23 reset.
	105 :gpio_pl_24 reset.
	106 :gpio_pl_25 reset.
	107 :gpio_pl_26 reset.
	108 :gpio_pl_27 reset.
	109 :gpio_pl_28 reset.
	110 :gpio_pl_29 reset.
	111 :gpio_pl_30 reset.
	112 :gpio_pl_31 reset.
	113 :rpu_ls reset.
	114 :ps_only reset.
	115 :pl reset.
	116 :ps_pl0 reset
	117 :ps_pl1 reset
	118 :ps_pl2 reset
	119 :ps_pl3 reset

Example:
	reset-controller:reset-controller@0 {
		compatible = "xlnx,zynqmp-reset";
		#reset-cells = <1>;
	};
```

## Documentation/devicetree/bindings/serial/xlnx,opb-uartlite.yaml
```yaml
# SPDX-License-Identifier: (GPL-2.0-only OR BSD-2-Clause)
%YAML 1.2
---
$id: http://devicetree.org/schemas/serial/xlnx,opb-uartlite.yaml#
$schema: http://devicetree.org/meta-schemas/core.yaml#

maintainers:
  - Michal Simek <michals@xilinx.com>

title: Xilinx uartlite bindings

properties:
  compatible:
    enum:
      - xlnx,opb-uartlite-1.00.b
      - xlnx,xps-uartlite-1.00.a
      - xlnx,axi-uartlite-rs485

  reg:
    maxItems: 1

  interrupts:
    maxItems: 1

  clocks:
    maxItems: 1

  clock-name:
    const: s_axi_aclk
    description: |
      Input clock name.

  port-number:
    $ref: '/schemas/types.yaml#/definitions/uint32'
    description:
      The port number of the uartlite.

required:
  - compatible
  - reg
  - interrupts

additionalProperties: false

examples:
  - |
    serial@800c0000 {
      compatible = "xlnx,xps-uartlite-1.00.a";
      reg = <0x800c0000 0x10000>;
      interrupts = <0x0 0x6e 0x1>;
      port-number = <0>;
    };

...
```

## Documentation/devicetree/bindings/soc/xilinx/xlnx,ai-engine-npi.txt
```
Xilinx AI Engine NPI
--------------------

The Xilinx AI Engine NPI space is where the privileged operations for AI Engine
device are handled, such as reset and pll. The space is typically meant to be
owned by platform management software, and this space is accessible only when
the platform management software grants the access. Thus, this dt binding only
works in such configuration, and in case the platform locks the access,
the non-secure software fails to access the device.

This is a temporary solution to allow direct access to NPI space.

Required properties:

- compatible: Must be "xlnx,ai-engine-npi"
- reg: Physical base address and length of the registers set for the device.

Example:

	aie-npi@f70a0000 {
		compatible = "xlnx,ai-engine-npi";
		reg = <0x0 0xf70a0000 0x0 0x1000>;
	};
```
