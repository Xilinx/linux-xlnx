## Documentation/devicetree/bindings/soc/xilinx/xlnx,ai-engine.yaml
```yaml
# SPDX-License-Identifier: GPL-2.0
%YAML 1.2
---
$id: http://devicetree.org/schemas/soc/xilinx/xlnx,ai-engine.yaml#
$schema: http://devicetree.org/meta-schemas/core.yaml#

title: Xilinx AI Engine

maintainers:
  - Wendy Liang <wendy.liang@xilinx.com>

description: |+
  The Xilinx AI Engine is a tile processor with many cores (up to 400) that
  can run in parallel. The data routing between cores is configured through
  internal switches, and shim tiles interface with external interconnect, such
  as memory or PL. One AI engine device can have multiple apertures, each
  has its own address space and interrupt. At runtime application can create
  multiple partitions within an aperture which are groups of columns of AI
  engine tiles. Each AI engine partition is the minimum resetable unit for an
  AI engine application.

properties:
  compatible:
    enum:
      - xlnx,ai-engine-v2.0
      - xlnx,ai-engine-v1.0 # deprecated

  reg:
    deprecated: true
    description: |
      Physical base address and length of the device registers.
      The AI engine address space assigned to Linux is defined by Xilinx
      platform design tool.

  '#address-cells':
    enum: [2]
    description: |
      size of cell to describe AI engine range of tiles address.
      It is the location of the starting tile of the range.
      As the AI engine tiles are 2D array, the location of a tile
      is presented as (column, row), the address cell is 2.

  '#size-cells':
    enum: [2]
    description: |
      size of cell to describe AI engine range of tiles size.
      As the AI engine tiles are 2D array, the size cell is 2.

  interrupts:
    deprecated: true
    maxItems: 3

  interrupt-names:
    deprecated: true
    description: |
      Should be "interrupt1", "interrupt2" or "interrupt3".

  ranges: true

  xlnx,shim-rows:
    $ref: /schemas/types.yaml#/definitions/uint8-array
    description: |
      start row and the number of rows of SHIM tiles of the AI engine device

  xlnx,core-rows:
    $ref: /schemas/types.yaml#/definitions/uint8-array
    description: |
      start row and the number of rows of core tiles of the AI engine device

required:
  - compatible
  - '#address-cells'
  - '#size-cells'
  - ranges
  - power-domains
  - xlnx,shim-rows
  - xlnx,core-rows

patternProperties:
  "^aperture@[0-9]+$":
    type: object
    description: |
      AI engine aperture which is a group of column based tiles of the
      AI engine device. Each AI engine apertures isolated from the
      other AI engine apertures. An AI engine aperture is defined by
      Xilinx platform design tools.

    properties:
      reg:
        description: |
          Physical base address and length of the aperture registers.
          The AI engine address space assigned to Linux is defined by Xilinx
          platform design tool.

      xlnx,columns:
        $ref: /schemas/types.yaml#/definitions/uint32-array
        description:
          It describes the location of the aperture. It specifies the start
          column and the number of columns. E.g. an aperture starts from
          column 0 and there are 50 columns, it will be presented as <0 50>.

      interrupts:
        maxItems: 3

      interrupt-names:
        description: |
          Should be "interrupt1", "interrupt2" or "interrupt3".

      xlnx,node-id:
        $ref: /schemas/types.yaml#/definitions/uint32
        description: |
          AI engine aperture node ID, which is defined by Xilinx platform design
          tool to identify the AI engine aperture in the firmware.

    required:
      - reg
      - xlnx,columns
      - xlnx,node-id

  "^partition[0-9]@[0-9]+$":
    deprecated: true
    type: object
    description: |
      AI engine partition which is a group of column based tiles of the AI
      engine device. Each AI engine partition is isolated from the other
      AI engine partitions. An AI engine partition is defined by Xilinx
      platform design tools.
      AI engine partition driver will create a FPGA bridge when probes the
      AI engine partition. The AI engine SHIM row of the partition is the
      bridge to connect AI engine partition, FPGA and PS.

    properties:
      reg:
        description: |
          It describes the group of tiles of the AI engine partition. It needs
          to include the SHIM row. The format is defined by the parent AI engine
          device node's '#address-cells' and '#size-cells' properties. e.g. a v1
          AI engine device has 2D tiles array, the first row is SHIM row. A
          partition which has 50 columns and 8 rows of core tiles and 1 row of
          SHIM tiles will be presented as <0 0 50 9>.

      label:
        maxItems: 1

      xlnx,partition-id:
        $ref: /schemas/types.yaml#/definitions/uint32
        description: |
          AI engine partition ID, which is defined by Xilinx platform design
          tool to identify the AI engine partition in the system.

    required:
      - reg
      - xlnx,partition-id

additionalProperties: true

examples:
  - |
    #include <dt-bindings/power/xlnx-versal-power.h>
    bus {
      #address-cells = <2>;
      #size-cells = <2>;
      ai_engine: ai_engine {
        compatible = "xlnx,ai-engine-v2.0";
        xlnx,shim-rows = /bits/ 8 <0 1>;
        xlnx,core-rows = /bits/ 8 <1 8>;
        power-domains = <&versal_firmware PM_DEV_AI>;
        #address-cells = <2>;
        #size-cells = <2>;
        ranges;

        aperture0: aperture@0 {
          /* 50 columns and 8 core tile rows + 1 SHIM row */
          reg = <0x200 0x0 0x1 0x0>;
          xlnx,columns = <0 50>;
          xlnx,node-id = <1>;
          interrupt-parent = <&gic>;
          interrupts = <0x0 0x94 0x4>,
                       <0x0 0x95 0x4>,
                       <0x0 0x96 0x4>;
          interrupt-names = "interrupt1", "interrupt2", "interrupt3";
        };
      };
    };
```

## Documentation/devicetree/bindings/soc/xilinx/xlnx,ai_engine.txt
```
Xilinx AI Engine
----------------

The Xilinx AI Engine is a tile processor with many cores (up to 400) that
can run in parallel. The data routing between cores is configured through
internal switches, and shim tiles interface with external interconnect, such
as memory or PL.

Required properties:

- compatible: Must be "xlnx,ai_engine".
- reg: Physical base address and length of the registers set for the device.
- interrupt-parent: the phandle to the interrupt controller.
- interrupts: the interrupt numbers.
- interrupt-names: Should be "interrupt0", "interrupt1", "interrupt2" or
  "interrupt3".

Example:

	ai_engine@80000000 {
		compatible = "xlnx,ai_engine";
		reg = <0x0 0x80000000 0x0 0x20000000>;
		interrupt-parent = <&gic>;
		interrupts = <0x0 0x94 0x1>,
			     <0x0 0x95 0x1>,
			     <0x0 0x96 0x1>;
		interrupt-names = "interrupt1", "interrupt2", "interrupt3";
	};
```

## Documentation/devicetree/bindings/soc/xilinx/xlnx,vcu.txt
```
LogicoreIP designed compatible with Xilinx ZYNQ family.
-------------------------------------------------------

General concept
---------------

LogicoreIP design to provide the isolation between processing system
and programmable logic. Also provides the list of register set to configure
the frequency.

Required properties:
- compatible: shall be one of:
	"xlnx,vcu"
	"xlnx,vcu-logicoreip-1.0"
- reg, reg-names: There are two sets of registers need to provide.
	1. vcu slcr
	2. Logicore
	reg-names should contain name for the each register sequence.
- clocks: phandle for aclk and pll_ref clocksource
- clock-names: The identification string, "aclk", is always required for
   the axi clock. "pll_ref" is required for pll.
- ranges
- VCU Init driver node define the following child nodes:
	* Allegro encoder driver node
		- compatible: Must be "al,al5e"
		- reg: There is a one set of register.
		- interrupts: interrupt number to the cpu.
		- interrupt-parent: the phandle for the interrupt controller
		  that services interrupts for this device.
	* Allegro decoder driver node
		- compatible: Must be "al,al5d"
		- reg: There is a one set of register.
		- interrupts: interrupt number to the cpu.
		- interrupt-parent: the phandle for the interrupt controller
		  that services interrupts for this device.
Example:

	xlnx_vcu: vcu@a0040000 {
		compatible = "xlnx,vcu";
		#address-cells = <2>;
		#size-cells = <2>;
		reg = <0x0 0xa0040000 0x0 0x1000>,
			 <0x0 0xa0041000 0x0 0x1000>;
		reg-names = "vcu_slcr", "logicore";
		clocks = <&si570_1>, <&clkc 71>;
		clock-names = "pll_ref", "aclk";
		ranges;
		encoder: al5e@a0000000 {
			compatible = "al,al5e";
			reg = <0x0 0xa0000000 0x0 0x10000>;
			interrupts = <0 89 4>;
			interrupt-parent = <&gic>;
		};

		decoder: al5d@a0020000 {
			compatible = "al,al5d";
			reg = <0x0 0xa0020000 0x0 0x10000>;
			interrupts = <0 89 4>;
			interrupt-parent = <&gic>;
		};
	};
```

## Documentation/devicetree/bindings/soc/xilinx/xlnx,zynqmp-pm.txt
```
Xilinx Zynq MPSoC Firmware Device Tree Bindings

The zynqmp-pm node describes the interface to platform firmware.

Required properties:
 - compatible:	Must contain:  "xlnx,zynqmp-pm"
 - method:	The method of calling the PM-API firmware layer.
		Permitted values are:
		 - "smc" : To be used in configurations without a hypervisor
		 - "hvc" : To be used when hypervisor is present
 - interrupts:	Interrupt specifier

Optional Properties:
 - pinctrl-0: pin control group to be used for this controller
 - pinctrl-names: must contain a "default" entry

Examples:
	zynqmp-firmware {
		compatible = "xlnx,zynqmp-pm";
		method = "smc";
		interrupt-parent = <&gic>;
		interrupts = <0 35 4>;
	};
```

## Documentation/devicetree/bindings/soc/xilinx/xlnx,zynqmp-power.txt
```
Xilinx Zynq MPSoC Power Management Device Tree Bindings

The zynqmp-power node describes the power management configurations.

Required properties:
 - compatible	: Must contain:  "xlnx,zynqmp-power"
 - mbox-names	: Name given to channels seen in the 'mboxes' property.
		  "rx" - Mailbox corresponding to receive path
		  "tx" - Mailbox corresponding to transmit path
 - mboxes	: Standard property to specify a Mailbox. Each value of
		  the mboxes property should contain a phandle to the
		  mailbox controller device node and an args specifier
		  that will be the phandle to the intended sub-mailbox
		  child node to be used for communication. See
		  Documentation/devicetree/bindings/mailbox/mailbox.txt
		  for more details about the generic mailbox controller
		  and client driver bindings. Also see
		  Documentation/devicetree/bindings/mailbox/ \
		  xlnx,zynqmp-ipi-mailbox.txt for typical controller that
		  is used to communicate with this System controllers.

Examples:
	zynqmp_power: zynqmp-power {
		compatible = "xlnx,zynqmp-power";
		mboxes = <&ipi_mailbox_pmu0 0>,
			 <&ipi_mailbox_pmu0 1>;
		mbox-names = "tx", "rx";
	};
```

## Documentation/devicetree/bindings/soc/xilinx/zynq_mpsoc.txt
```
Xilinx Zynq MPSoC Device Tree Bindings

Zynq MPSoC based systems rely on the "psci" node to detect the presence of PMU
firmware as well as to determine the calling method (either "smc" or "hvc")
to the PM-API firmware layer.

Required properties:
 - compatible  : Must contain:  "xlnx,zynqmp-pm"

 - method      : The method of calling the PM-API firmware layer.
                 Permitted values are:
                 "smc" : To be used in configurations without a hypervisor
                 "hvc" : To be used when hypervisor is present
```

## Documentation/devicetree/bindings/sound/xlnx,audio-formatter.txt
```
Device-Tree bindings for Xilinx PL audio formatter

The IP core supports DMA, data formatting(packing, conversion)
of audio samples.

Required properties:
 - compatible: "xlnx,audio-formatter-1.0"
 - interrupt-names: Names specified to list of interrupts in same
		    order mentioned under "interrupts".
		    List of supported interrupt names are:
		    "irq_mm2s" : interrupt from MM2S block
		    "irq_s2mm" : interrupt from S2MM block
 - interrupts-parent: Phandle for interrupt controller.
 - interrupts: List of Interrupt numbers.
 - reg: Base address and size of the IP core instance.
 - xlnx,tx: connected audio sink node.
	    Should be one of below supported nodes:
		1. HDMI video Tx output
		2. I2S transmitter
		3. UHDSDI audio embed
	    Only those nodes were supported in sound card driver

 - xlnx,rx: connected audio source node.
	    Should be one of below supported nodes:
		1. HDMI video Rx input
		2. I2S receiver
		3. UHDSDI audio extract
	    Only those nodes were supported in sound card driver
 - clock-names: List of input clocks.
   Required elements: "s_axi_lite_aclk", "m_axis_mm2s_aclk", "aud_mclk", "s_axis_s2mm_aclk"
 - clocks: Input clock specifier. Refer to common clock bindings.

Example:
	audio_ss_0_audio_formatter_0: audio_formatter@80010000 {
		compatible = "xlnx,audio-formatter-1.0";
		interrupt-names = "irq_mm2s", "irq_s2mm";
		interrupt-parent = <&gic>;
		interrupts = <0 104 4>, <0 105 4>;
		reg = <0x0 0x80010000 0x0 0x1000>;
		xlnx,tx = <&i2s_transmitter>;
		xlnx,rx = <&i2s_receiver>;
		clock-names = "s_axi_lite_aclk", "m_axis_mm2s_aclk", "aud_mclk", "s_axis_s2mm_aclk";
		clocks = <&clk 71>, <&audio_ss_0_clk_wiz_0 0>, <&audio_ss_0_clk_wiz_0 0>, <&clk 71>;
	};
```
