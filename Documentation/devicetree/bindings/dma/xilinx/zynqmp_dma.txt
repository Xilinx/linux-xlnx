## Documentation/devicetree/bindings/dma/xilinx/zynqmp_dma.txt
```
Xilinx ZynqMP DMA engine, it does support memory to memory transfers,
memory to device and device to memory transfers. It also has flow
control and rate control support for slave/peripheral dma access.

Required properties:
- compatible: Should be "xlnx,zynqmp-dma-1.0"
- reg: Memory map for gdma/adma module access.
- interrupt-parent: Interrupt controller the interrupt is routed through
- interrupts: Should contain DMA channel interrupt.
- xlnx,bus-width: Axi buswidth in bits. Should contain 128 or 64

Optional properties:
- xlnx,include-sg: Indicates the controller to operate in simple or scatter
		   gather dma mode
- xlnx,ratectrl: Scheduling interval in terms of clock cycles for
		 source AXI transaction
- xlnx,overfetch: Tells whether the channel is allowed to over fetch the data
- xlnx,src-issue: Number of AXI outstanding transactions on source side
- xlnx,desc-axi-cohrnt: Tells whether the AXI transactions generated for the
			descriptor read are marked Non-coherent
- xlnx,src-axi-cohrnt: Tells whether the AXI transactions generated for the
			source descriptor payload are marked Non-coherent
- xlnx,dst-axi-cohrnt: Tells whether the AXI transactions generated for the
			dst descriptor payload are marked Non-coherent
- xlnx,desc-axi-qos: AXI QOS bits to be used for descriptor fetch
- xlnx,src-axi-qos: AXI QOS bits to be used for data read
- xlnx,dst-axi-qos: Axi QOS bits to be used for data write
- xlnx,desc-axi-cache: AXI cache bits to be used for descriptor fetch
- xlnx,desc-axi-cache: AXI cache bits to be used for data read
- xlnx,desc-axi-cache: AXI cache bits to be used for data write
- xlnx,src-burst-len: AXI length for data read. Support only power of 2 values
		      i.e 1,2,4,8 and 16.
- xlnx,dst-burst-len: AXI length for data write. Support only power of 2 values
		      i.e 1,2,4,8 and 16.

Example:
++++++++
fpd_dma_chan1: dma@FD500000 {
	compatible = "xlnx,zynqmp-dma-1.0";
	reg = <0x0 0xFD500000 0x1000>;
	interrupt-parent = <&gic>;
	interrupts = <0 117 4>;
	xlnx,bus-width = <128>;
	xlnx,include-sg;
	xlnx,overfetch;
	xlnx,ratectrl = <0>;
	xlnx,src-issue = <16>;
	xlnx,desc-axi-cohrnt;
	xlnx,src-axi-cohrnt;
	xlnx,dst-axi-cohrnt;
	xlnx,desc-axi-qos = <0>;
	xlnx,desc-axi-cache = <0>;
	xlnx,src-axi-qos = <0>;
	xlnx,src-axi-cache = <2>;
	xlnx,dst-axi-qos = <0>;
	xlnx,dst-axi-cache = <2>;
	xlnx,src-burst-len = <4>;
	xlnx,dst-burst-len = <4>;
};
```

## Documentation/devicetree/bindings/drm/xilinx/cresample.txt
```
Device-Tree bindings for Xilinx Chroma Resampler(CRESAMPLE)

Xilinx CRESAMPLE provides the chroma resampling of YUV formats.

Required properties:
 - compatible: value should be "xlnx,v-cresample-3.01.a"
 - reg: base address and size of the CRESAMPLE IP
 - xlnx,input-format, xlnx,output-format: the input/output video formats of
   CRESAMPLE. The value should be one of following format strings.

	yuv422
	yuv444
	yuv420

Example:

	v_cresample_0: v-cresample@40020000 {
		compatible = "xlnx,v-cresample-3.01.a";
		reg = <0x40020000 0x10000>;
		xlnx,input-format = "yuv444";
		xlnx,output-format = "yuv422";
	};
```

## Documentation/devicetree/bindings/drm/xilinx/dp.txt
```
Device-Tree bindings for Xilinx DisplayPort IP core

The IP core supports transmission of video data in DisplayPort protocol.

Required properties:
 - compatible: Should be "xlnx,v-dp".
 - reg: Base address and size of the IP core.
 - interrupts: Interrupt number.
 - interrupts-parent: phandle for interrupt controller.
 - clocks: phandle for aclk and audio clock
 - clock-names: The identification string, "aclk", is always required for
   the axi clock. "aud_clk" is required only when audio needs to be enabled.

 - xlnx,dp-version: Version of DisplayPort protocol.
 - xlnx,max-lanes: Maximum number of lanes of the IP core. The value should
   be one of 1, 2, or 4.
 - xlnx,max-link-rate: Maximum link rate of the IP core. The value should be
   one of 162000, 270000, or 540000.
 - xlnx,max-bpc: Maximum bits-per-color. The value should be one of 8, 10, 12,
   or 16.
 - xlnx,axi-clock: Clock rate of axi4-lite. This is required to provide
   the correct clock divider for AUX.

 - xlnx,colormetry: Color format. The value should be one of "rgb", "ycrcb422",
   "ycrcb444", or "yonly". These are based on the DisplayPort specification.
 - xlnx,bpc: bits-per-color value to be configured. The value should be one of
   6, 8, 10, 12, or 16.

Optional properties:
 - xlnx,enable-yonly: Enable yonly colormetry.
 - xlnx,enable-ycrcb: Enable ycrcb colormetry.
 - xlnx,enable-sync: Enable synchronous operation with video clock.
 - xlnx,max-pclock-frequency: Maximum pixel clock rate(KHz). The value should
   specify the maximum pixel clock rate in KHz that the IP core supports.
 - xlnx,dp-sub: A phandle referencing the ZynqMP DisplayPort subsystem
   which contains additional blocks such as buffer managers, blender, and audio.
 - phy-names: Names for each phy lane. The name should be 'dp-phy' with lane
   number. For example, 'dp-phy0', 'dp-phy1'. 'dp-phy0' should be the primary
   lane, and used for PLL lock.
 - phys: The phy phandles for each lane. This should follow the phy-zynqmp
   definition in Documentation/devicetree/bindings/phy/phy-zynqmp.txt

Example:

	xlnx_dp: dp@83c10000 {
		compatible = "xlnx,v-dp";
		reg = <0x83c10000 0x10000>;
		interrupts = <0 57 4>;
		interrupt-parent = <&ps7_scugic_0>;
		clocks = <&dp_aclk>, <&dp_aud_clk>;
		clock-names = "aclk", "aud_clk";

		xlnx,dp-version = "v1.2";
		xlnx,max-lanes = <4>;
		xlnx,max-link-rate = <270000>;
		xlnx,max-bpc = <16>;
		xlnx,max-pclock-frequency = <150000>;
		xlnx,enable-ycrcb;

		xlnx,colormetry = "rgb";
		xlnx,bpc = <8>;

		phy-names = "dp-phy0", "dp-phy1";
		phys = <&lane1 PHY_TYPE_DP 0 3 27000000>, <&lane0 PHY_TYPE_DP 1 3 27000000>;
		};
```

## Documentation/devicetree/bindings/drm/xilinx/dp_sub.txt
```
Device-Tree bindings for Xilinx ZynqMP DisplayPort Subsystem

The ZynqMP DisplayPort subsystem handles DMA channel buffer management,
blending, and audio mixing. The DisplayPort subsystem receives display
and audio frames from DPDMA and transmits output to the DisplayPort IP core.

Required properties:
 - compatible: Should be one of "xlnx,dp-sub".
 - reg: Base address and size of the IP core.
 - reg-names: "blend", "av_buf", and "aud" for Blender, AV Buffer manager, and
   Audio modules respectively.
 - xlnx,output-fmt: Output color format. The value should be one of "rgb",
   "ycrcb422", "ycrcb444", or "yonly". These are based on the DisplayPort
   specification. The value shall be synced with DP colormetry..

Optional properties:
 - xlnx,vid-fmt: Video input color format. The value should be one of
	"vyuy"
	"uyvy"
	"yuyv"
	"yvyu"
	"yuv422"
	"yvu422"
	"yuv444"
	"yvu444"
	"nv16"
	"nv61
	"bgr888"
	"rgb888"
	"xbgr8888"
	"xrgb8888"
	"xbgr2101010"
	"xrgb2101010"
	"yuv420"
	"yvu420"
	"nv12"
	"nv21".
   If nothing is specified, "vyuy" will be selected.
 - xlnx,gfx-fmt: Graphics input color format. The value should be one of
	"abgr8888"
	"argb8888"
	"rgba8888"
	"bgra8888"
	"bgr888"
	"rgb888"
	"rgba5551"
	"bgra5551"
	"rgba4444"
	"bgra4444"
	"rgb565"
	"bgr565".
   If nothing is specified, "abgr8888" will be selected.

Optional properties:
 - xlnx,vid-clk-pl: Should be used when the pixel clock is coming from PL.

Example:

	xlnx_dp_sub: dp_sub@43c0a000 {
		compatible = "xlnx,dp-sub";
		reg = <0x43c0a000 0x1000>, <0x43c0b000 0x1000>,
		      <0x43c0c000 0x1000>;
		reg-names = "blend", "av_buf", "aud";
		xlnx,output-fmt = "rgb";
	};
```

## Documentation/devicetree/bindings/drm/xilinx/dsi.txt
```
Device-Tree bindings for Xilinx MIPI DSI Tx IP core

The IP core supports transmission of video data in MIPI DSI protocol.

Required properties:
 - compatible: Should be "xlnx,mipi-dsi-tx-subsystem".
 - reg: Base address and size of the IP core.
 - xlnx,dsi-datatype: Color format. The value should be one of "MIPI_DSI_FMT_RGB888",
   "MIPI_DSI_FMT_RGB666", "MIPI_DSI_FMT_RGB666_PACKED" or "MIPI_DSI_FMT_RGB565".
 - simple_panel: The subnode for connected panel. This represents the
   DSI peripheral connected to the DSI host node. please refer to
   Documentation/devicetree/bindings/display/mipi-dsi-bus.txt. The
   simple-panel driver has auo,b101uan01 panel timing parameters added along
   with other existing panels. DSI driver derive the required Tx IP controller
   timing values from the panel timing parameters. Refer to the
   xilinx_dsi_mode_set() in the DSI driver on how to derive the DSI
   Tx controller timing paramters.
 - ports: Connects to the drm device node through device graph binding.
   The port should contain a 'remote-endpoint' subnode that points to the
   endpoint in the port of the drm device node. Refer to
   Documentation/devicetree/bindings/graph.txt.
 - xlnx,dsi-num-lanes: Possible number of DSI lanes for the Tx controller.
   The values should be 1, 2, 3 or 4. Based on xlnx,dsi-num-lanes and
   line rate for the MIPI D-PHY core in Mbps, the AXI4-stream received by
   Xilinx MIPI DSI Tx IP core adds markers as per DSI protocol and the packet
   thus framed is convered to serial data by MIPI D-PHY core. Please refer
   Xilinx pg238 for more details. This value should be equal to the number
   of lanes supported by the connected DSI panel. Panel has to support this
   value or has to be programmed to the same value that DSI Tx controller is
   configured to.

Required simple_panel properties:
 - compatible: Value should be one of the panel name mentioned in the
   of_match_table of simple panel driver drivers/gpu/drm/panel/panel-simple.c
   e.g. "auo,b101uan01".

Example:

#include <dt-bindings/drm/mipi-dsi.h>
	mipi_dsi_tx_subsystem_0: mipi_dsi_tx_subsystem@80000000 {
		compatible = "xlnx,mipi-dsi-tx-subsystem";
		reg = <0x0 0x80000000 0x0 0x10000>;
		xlnx,dsi-num-lanes = <4>;
		xlnx,dsi-data-type = <MIPI_DSI_FMT_RGB888>;
		#address-cells = <1>;
		#size-cells = <0>;
		ports {
			#address-cells = <1>;
			#size-cells = <0>;
			port@0 {
				reg = <0>;
				mipi_port: endpoint {
					remote-endpoint = <&drm_port>;
				};
			};
		};
		simple_panel: simple-panel@0 {
			compatible = "auo,b101uan01";
			reg = <0>;
		};
	};
```

## Documentation/devicetree/bindings/drm/xilinx/osd.txt
```
Device-Tree bindings for Xilinx Video On Screen Display(OSD)

Xilinx OSD provides the multiplane support. Some properties can be configured
in IP synthesis.

Required properties:
 - compatible: value should be "xlnx,v-osd-5.01.a"
 - reg: base address and size of the OSD IP
 - xlnx,num-layers: the number of layers(up to 8) supported by OSD
 - xlnx,screen-width: the maximum size(up to 4096) of screen pixel width by OSD

Example:

	v_osd_0: v-osd@40040000 {
		compatible = "xlnx,v-osd-5.01.a";
		reg = <0x40040000 0x10000>;
		xlnx,num-layers = <2>;
		xlnx,screen-width = <1920>;
	};
```

## Documentation/devicetree/bindings/drm/xilinx/rgb2ycrcb.txt
```
Device-Tree bindings for Xilinx RGB to YCrCb convertor(RGB2YCRCB)

Xilinx RGB2YCRCB converts the pixel format from RGB to YCrCb

Required properties:
 - compatible: value should be "xlnx,v-rgb2ycrcb-6.01.a"
 - reg: base address and size of the RGB2YCRCB IP

Example:

	v_rgb2ycrcb_0: v-rgb2ycrcb@40030000 {
		compatible = "xlnx,v-rgb2ycrcb-6.01.a";
		reg = <0x40030000 0x10000>;
	};
```

## Documentation/devicetree/bindings/drm/xilinx/sdi.txt
```
Device-Tree bindings for Xilinx SDI Tx IP core

The IP core supports transmission of video data in SDI Tx: protocol.

Required properties:
 - compatible: Should be "xlnx,v-smpte-uhdsdi-tx-ss".
 - interrupts: Interrupt number.
 - interrupts-parent: phandle for interrupt controller.
 - reg: Base address and size of the IP core.
 - ports: Connects to the drm device node through device graph binding.
   The port should contain a 'remote-endpoint' subnode that points to the
   endpoint in the port of the drm device node. Refer to
   Documentation/devicetree/bindings/graph.txt.
 - xlnx,vtc: vtc phandle

Example:

		v_smpte_uhdsdi_tx_ss: v_smpte_uhdsdi_tx_ss@80020000 {
			compatible = "xlnx,v-smpte-uhdsdi-tx-ss";
			interrupt-parent = <&gic>;
			interrupts = <0 90 4>;
			reg = <0x0 0x80020000 0x0 0x10000>;
			xlnx,vtc = <&v_tc_0>;
			ports {
				#address-cells = <1>;
				#size-cells = <0>;
				port@0 {
					reg = <0>;
					sdi_port: endpoint {
						remote-endpoint = <&drm_port>;
					};
				};
		        };
		};
```

## Documentation/devicetree/bindings/drm/xilinx/vtc.txt
```
Device-Tree bindings for Xilinx Video Timing Controller(VTC)

Xilinx VTC provides the timings for Video IPs.

Required properties:
 - compatible: value should be "xlnx,v-tc-5.01.a"
 - reg: base address and size of the VTC IP
 - interrupts: the interrupt number
 - interrupts-parent: the phandle for interrupt controller

Example:

	v_tc_0: v-tc@40010000 {
		compatible = "xlnx,v-tc-5.01.a";
		interrupt-parent = <&intc>;
		interrupts = <0 54 4>;
		reg = <0x40010000 0x10000>;
	};
```
