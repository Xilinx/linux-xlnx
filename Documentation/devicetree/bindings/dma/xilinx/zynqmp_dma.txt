## Documentation/devicetree/bindings/edac/xlnx,versal-ddrmc-edac.yaml
```yaml
# SPDX-License-Identifier: GPL-2.0
%YAML 1.2
---
$id: http://devicetree.org/schemas/edac/xlnx,versal-ddrmc-edac.yaml#
$schema: http://devicetree.org/meta-schemas/core.yaml#

title: Xilinx Versal DDRMC EDAC driver

maintainers:
  - Sai Krishna Potthuri <lakshmi.sai.krishna.potthuri@xilinx.com>

description: |
  Versal DDR controller has an optional ECC support which correct
  single bit ECC errors and detect double bit ECC errors.

properties:
  compatible:
    items:
      - enum:
          - xlnx,versal-ddrmc-edac

  reg:
    maxItems: 2
    items:
      - description: DDR Memory Controller registers
      - description: NOC registers corresponding to DDR Memory Controller

  reg-names:
    items:
      - const: ddrmc_base
      - const: ddrmc_noc_base

  interrupts:
    maxItems: 1

  xlnx,mc-id:
    $ref: /schemas/types.yaml#/definitions/uint32
    description: Instance number of the DDR Memory Controller

required:
  - compatible
  - reg
  - reg-names
  - interrupts
  - xlnx,mc-id

examples:
  - |
    bus {
      #address-cells = <2>;
      #size-cells = <2>;
      memory-controller@f6150000 {
        compatible = "xlnx,versal-ddrmc-edac";
        reg = <0x0 0xf6150000 0x0 0x2000>, <0x0 0xf6070000 0x0 0x20000>;
        reg-names = "ddrmc_base", "ddrmc_noc_base";
        interrupt-parent = <&gic>;
        interrupts = <0 147 4>;
        xlnx,mc-id = <0>;
      };
    };
```

## Documentation/devicetree/bindings/edac/xlnx,versal-xilsem-edac.yaml
```yaml
# SPDX-License-Identifier: GPL-2.0
%YAML 1.2
---
$id: http://devicetree.org/schemas/edac/xlnx,versal-xilsem-edac.yaml#
$schema: http://devicetree.org/meta-schemas/core.yaml#

title: Xilinx Versal Xilsem EDAC driver

maintainers:
  - Rama Devi Veggalam <rama.devi.veggalam@amd.com>

description: |
  Xilinx Versal Soft Error Mitigation (XilSEM) is part of the
  Platform Loader and Manager (PLM) which is loaded into and runs on the
  Platform Management Controller (PMC). XilSEM is responsible for detecting
  and optionally correcting soft errors in Configuration Memory of Versal.
  Whenever an error is detected, be it correctable or uncorrectable, XilSEM
  notifies the errors to user application.
  This driver is responsible for handling error events received from XilSEM
  on PLM.

properties:
  compatible:
    items:
      - enum:
          - xlnx,versal-xilsem-edac

  reg:
    maxItems: 1

required:
  - compatible
  - reg

additionalProperties: false

examples:
  - |
      edac@f2014050 {
        compatible = "xlnx,versal-xilsem-edac";
        reg = <0xF2014050 0xC4>;
      };
```

## Documentation/devicetree/bindings/edac/zynq_edac.txt
```
Zynq/ZynqMP EDAC driver, it does reports the DDR ECC single bit errors that are
corrected and double bit ecc errors that are detected by the DDR ECC controller.
ECC support for DDR is available in half-bus width(16 bit) configuration only.

Required properties:
- compatible: Should be "xlnx,zynq-ddrc-a05" for Zynq
	      and "xlnx,zynqmp-ddrc-2.40a""for ZynqMP
- reg: Should contain DDR controller registers location and length.
- interrupt-parent: Should be core interrupt controller
		    valid for ZynqMP DDR Controller
- interrupts: Property with a value describing the interrupt number
	      Valid for ZynqMP DDR Controller

Example:
++++++++

zynq_ddrc_0: zynq-ddrc@f8006000 {
	compatible = "xlnx,zynq-ddrc-a05";
	reg = <0xf8006000 0x1000>;
};

mc: memory-controller@fd070000 {
	compatible = "xlnx,zynqmp-ddrc-2.40a";
	reg = <0x0 0xfd070000 0x0 0x30000>;
	interrupt-parent = <&gic>;
	interrupts = <0 112 4>;
};

Zynq/ZYnqMP EDAC driver detects the DDR ECC enable state by reading the appropriate
control register.
```

## Documentation/devicetree/bindings/edac/zynqmp_ocm_edac.txt
```
Xilinx ZynqMP OCM EDAC driver, it does reports the OCM ECC single bit errors
that are corrected and double bit ecc errors that are detected by the OCM
ECC controller.

Required properties:
- compatible: Should be "xlnx,zynqmp-ocmc-1.0".
- reg: Should contain OCM controller registers location and length.
- interrupt-parent: Should be core interrupt controller.
- interrupts: Property with a value describing the interrupt number.

Example:
++++++++
ocm: memory-controller@ff960000 {
	compatible = "xlnx,zynqmp-ocmc-1.0";
	reg = <0x0 0xff960000 0x1000>;
	interrupt-parent = <&gic>;
	interrupts = <0 10 4>;
};
```

## Documentation/devicetree/bindings/fpga/xilinx-pr-decoupler.txt
```
Xilinx FPGA PR Decoupler

The Partial Reconfiguration (PR) Decoupler IP provides logical isolation
capabilities for PR designs. One or more PR Decoupler cores can be used to
make the interface between a Reconfigurable Partition (RP) and the static logic
safe from unpredictable activity while partial reconfiguration is occurring.
When active, user-selected signals crossing between the RP and the static logic
are driven to user configurable values. When inactive, signals are passed
unaltered. PR Decoupler cores can be connected to the PR Controller IP or custom
user controllers to create a complete Partial Reconfiguration management
solution.

Driver supports only MMIO handling. PR region can have multiple PR Decouplers
which can be handled independently or chained via decouple/decouple_status
signals.

Required properties:
- compatible:	should contain "xlnx,pr_decoupler"
- reg:		base address and size for memory mapped IO
- clocks:	input clock to IP
- clock-names:	should contain "aclk"

Example:
	fpga_bridge0: fpga-bridge@83c00000 {
		compatible = "xlnx,pr_decoupler";
		reg = <0x83c00000 0x10000>;
		clocks = <&clkc 15>;
		clock-names = "aclk";
	};
```

## Documentation/devicetree/bindings/fpga/xilinx-zynq-fpga-mgr.txt
```
Xilinx Zynq FPGA Manager

Required properties:
- compatible:		should contain "xlnx,zynq-devcfg-1.0"
- reg:			base address and size for memory mapped io
- interrupt parent:	interrupt source phandle
- interrupts:		interrupt for the FPGA manager device
- clocks:		phandle for clocks required operation
- syscon:		phandle for access to SLCR registers

Optional properties:
- clock-names:		names for clocks



Example:
	devcfg: devcfg@f8007000 {
		compatible = "xlnx,zynq-devcfg-1.0";
		reg = <0xf8007000 0x100>;
		interrupt-parent = <&intc>;
		interrupts = <0 8 4>;
		clocks = <&clkc 12>;
		clock-names = "ref_clk";
		syscon = <&slcr>;
	};
```

## Documentation/devicetree/bindings/fpga/xilinx-zynqmp-fpga-mgr.txt
```
Xilinx Zynqmp FPGA Manager

Required properties:
- compatible:		should contain "xlnx,zynqmp-pcap-fpga"
- clocks:		phandle for clocks required operation
- clock-names:		name for the clock, should be "ref_clk"

Example:
	pcap: pcap@00 {
		compatible = "xlnx,zynqmp-pcap-fpga";
		clocks = <&clkc 41>;
		clock-names = "ref_clk";
	};
```
