## Documentation/devicetree/bindings/drm/xilinx/xlnx,v-hdmi-tx-ss.txt
```
Xilinx HDMI TX Subsystem

The Xilinx HDMI TX Subsystem contains several subcores to implement
a HDMI receiver. /hdmi/xilinx_drm_hdmi.c implements a
DRM/KMS driver that slaves to xilinx_drm_drv.c in the output pipeline.

retimer-clk is optional. If specified, the corresponding driver
should offer a CCF clock that supports .set_rate(). Through this,
the device can retime/redrive the HDMI TX signal on the connector
depending on the TX clock line rate.

There are 2 optional HDCP cores that can be included in the IP configuration.
Below provided sample device tree depicts the configuration when both cores are 
included. If an optional core is included then corresponding entries for the 
core parameters (interrupts, key-management block address) must be included in
the device tree

Note: If HDCP cores are included in the design, the user must provide valid
	  HDCP keys for the encryption to work. 

Refer to xlnx,vphy.txt for the phy specifics.
	  
Required properties:
 - compatible: Should be "xlnx,v-hdmi-tx-ss-3.0".
 - reg: Base address and size of the IP core and hdcp1x key management block
 - reg-names: Identification string for included register blocks
		"hdmi-txss": Identification string for hdmitx subsystem. Always present
		"hdcp1x-keymngmt": Identification string for Key management block for
			hdcp1x. [Optional]

 - interrupts-parent: phandle for interrupt controller.
 - interrupts: Interrupt numbers for mandatory and optional blocks
 - interrupt-names: Identification string that binds irq number to block 
		generating the interrupt
		"hdmitx": interrupt for tx subcore [always present]
		"hdcp1x": interrupt for hdcp1.4 core [optional]
		"hdcp1x-timer": interrupt for hdcp1.4 timer [present if hdcp1x is 
			included]
		"hdcp22": interrupt for hdcp22 core [optional]
		"hdcp22-timer": interrupt for hdcp2.2 timer [present if hdcp22 is
			included]

 - clocks: phandle for axi-lite, video stream and retimer clock
 - clock-names: The identification string, "axi-lite", is always required for
                the axi-lite clock, "video" is always required for video stream
				clock and "retimer-clk" is required only when retimer is being 
				used 
   
 - phys: phandle for phy lanes registered for hdmi protocol. HDMI always 
         require 3 lanes
 - phy-names: The identification string, "hdmi-phy0" and so on
 
 - xlnx,input-pixels-per-clock: IP configuration for samples/clk (2, 4)
         Note: Only 2 is supported at this time
 - xlnx,max-bits-per-component: The data width per video component (8,10,12,16)
         Note: Only 8 & 10 is supported at this time
 - xlnx,include-hdcp-1-4: Boolean parameter that denotes if hdcp14 is included.
		If present indicates inclusion of the optional core
 - xlnx,include-hdcp-2-2: Boolean parameter that denotes if hdcp22 is included.
		If present indicates inclusion of the optional core
 - xlnx,hdcp-authenticate: Flag to enable/disable hdcp authentication. 
		Applicable when either hdcp14 or hdcp22 is included in the design
 - xlnx,hdcp-encrypt: Flag to enable/disable stream encryption
 		Applicable when either hdcp14 or hdcp22 is included in the design
		
The "retimer-clk" is optional. If present, it is notified of TX link
clock changes through set_rate(). Tested with dp159.c driver.

==Example==
If hdcp1.4 is included in the design then key management block node should be
added to the device tree

	hdmi_output_hdcp_keymngmt_blk_top_0: hdcp_keymngmt_blk_top@a0280000 {
		compatible = "xlnx,hdcp-keymngmt-blk-top-1.0";
		reg = <0x0 0xa0280000 0x0 0x10000>;
	};

	hdmi_output_v_hdmi_tx_ss_0: v_hdmi_tx_ss@a0020000 {
		compatible = "xlnx,v-hdmi-tx-ss-3.0";
		reg = <0x0 0xa0100000 0x0 0x100000>, <0x0 0xa0280000 0x0 0x10000>;
		reg-names = "hdmi-txss", "hdcp1x-keymngmt";			
		interrupt-parent = <&gic>;
		interrupts = <0 93 4>, <0 104 4>, <0 105 4>, <0 106 4>, <0 107 4>;
		interrupt-names = "hdmitx", "hdcp1x", "hdcp1x-timer", "hdcp22", "hdcp22-timer";
		
		clocks = <&vid_s_axi_clk>, <&vid_stream_clk>, <&dp159>;
		clock-names = "axi-lite", "video", "retimer-clk";
		phy-names = "hdmi-phy0", "hdmi-phy1", "hdmi-phy2";
		phys = <&vphy_lane0 0 1 1 1>, <&vphy_lane1 0 1 1 1>, <&vphy_lane2 0 1 1 1>;
	
		xlnx,input-pixels-per-clock = <0x2>;
		xlnx,max-bits-per-component = <0x8>;
		xlnx,include-hdcp-1-4;
		xlnx,include-hdcp-2-2;

		/* settings for HDCP */
		xlnx,hdcp-authenticate = <0x0>;
		xlnx,hdcp-encrypt = <0x0>;			
	};
```

## Documentation/devicetree/bindings/drm/xilinx/xv_mixer.txt
```
Device Tree Bindings for Xilinx Video Mixer IP core

Required properties for Core IP Node:

    Required General Properties:
    - compatible: "xlnx,video_mixer-1.0"

    - reg: MMIO base address and size of the Xilinx Video Mixer IP core address 
           space

    - interrupts-parent: Phandle for interrupt controller

    - interrupts: Interrupt number

    Required Mixer IP Core Properties
    - xlnx,bpc [number]: The data width per video component (8,10,12,16) Note:
	only 8 is currently supported

    - xlnx,num-layers [number]: Number of active overlay layers supported (1-7)
	(does not include logo layer but does include base layer)

    Optional Mixer IP Core Properties:
    - xlnx,logo-layer: Boolean indicating that logo layer is enabled

Layer Sub Node Properties:
    The device tree will need to include a sub node for each enabled layer
    in the IP core that is to be utilized by the driver.
    These layer nodes describe the base layer as well as each overlay layer 
    but not the logo layer (see Logo Layer Properties below).
    Each layer node should be named using "layer_#" format (e.g.
	layer_0 { }; layer_1 {}; ...)

    Required Properties:
    - xlnx,layer-id [number]: Mixer layer number; should correspond to layer
	number in the IP (e.g.  layer_1 should use xlnx,layer_id = <1).  Node
	Layer_0 is the only required node (exception: if xlnx,logo-layer
	property exists, then a logo {}; node must be present).  Layer_0 will
	be interpreted as the background layer and must use layer-id = <0>.

    - xlnx,vformat [string]: Expected layer input data format ("rgb" | "yuv444"
	| "yuv422" | "yuv420")

    - xlnx,layer-width [number]: Maximum number of columns (before scaling) for
	this layer (i.e. horizontal pixels)

    - xlnx,layer-height [number]: Only required for layer_0 node (master layer).
	Indicates maximum vertical size of active screen display in pixels

    Optional Properties:
    - xlnx,layer-alpha: Indicates that this layer supports global alpha blending

    - xlnx,layer-scale: Indicates that this layer supports mixer scaling

    - xlnx,streaming: Layer obtains data as video stream (if omitted, layer is
        presumed to be memory mapped)


Logo Layer Sub Node Properties:
    This node is only required if the core IP node contains the 
    'xlnx,logo-layer' property indicating the the core supports a logo layer.
    This subnode should be labled "logo" (e.g. logo { }; ).

    Required Properties:	
    - xlnx,layer-id [number]: This should be set to <8>.

    - xlnx,logo-height [number]: Maximum number of vertical pixels for the logo
	layer

    - xlnx,logo-width [number]: Maximum number of horizontal pixels for the logo
	layer


    Optional Properties:
    - xlnx,logo-scale: Indicates that logo layer supports scaling in mixer

    - xlnx,logo-alpha: Indicates that logo layer supports global alpha blending


Example:

This sample is of a mixer IP core that has two overlay layers enabled in
addition to the logo layer.  One overlay 1 is a streaming video input layer and
the overlay 2 is memory-based (i.e. dma-driven) layer.

v_mix_0: v_mix@80040000 {
	compatible = "xlnx,v-mix-1.0";
	interrupt-parent = <&gic>;
	interrupts = <0 90 4>;
	reg = <0x0 0x80040000 0x0 0x40000>;

	xlnx,bpc = <8>;
	xlnx,num-layers = <3>;
	xlnx,logo-layer;

	mixer_master_layer: layer_0 {
		xlnx,layer-id = <0>;
		xlnx,vformat = "rgb";
		xlnx,layer-width = <1920>;
		xlnx,layer-height = <1080>;
	};

	mixer_overlay_1: layer_1 {
		xlnx,layer-id = <1>;
		xlnx,vformat = "yuv422";
		xlnx,layer-streaming;
		xlnx,layer-alpha;
		xlnx,layer-width = <1920>;
	};

	mixer_overlay_2: layer_2 {
		xlnx,layer-id = <2>;
		xlnx,vformat = "yuv420";
		xlnx,layer-scale;
		xlnx,layer-width = <1920>;
	};

	mixer_logo: logo {
		xlnx,layer-id = <8>;
		xlnx,logo-scale;
		xlnx,logo-alpha;
		xlnx,logo-width = <64>;	
		xlnx,logo-height = <64>;	
	};
};
```

## Documentation/devicetree/bindings/drm/xylon/logicvc.txt
```
Binding for Xylon configurable video controller logiCVC IP core

Required properties:
 - compatible: "xylon,logicvc-4.00.a", "xylon,logicvc-4.01.a"
 - reg: MMIO base address and size of the logiCVC IP core address space
 - interrupts-parent: the phandle for interrupt controller
 - interrupts: the interrupt number
 - pixel-stride: layer width in pixels
      Common for all available logiCVC standard layers.

 - layer_N: layer has its own configuration described with below properties,
      where N is layer ID in range 0 - 4
   - bits-per-pixel: layer bits per pixel configuration (16, 32)
         Layer is configured to be used with specified pixel width in bits.
         Pixels written to layer video memory must match in size to configured
         bits per pixel value.
   - type: layer type (rgb, yuv)
         Layer is configured to be used with specified color space.
         Pixels written to layer video memory must match specified color format.
   - transparency: layer transparency (layer, pixel)
         logiCVC layer can be configured to have transparency control on
         layer or pixel level.
         "Layer" mode enables controlling of layer transparency by changing
         alpha value in single logiCVC register.
         "Pixel" mode enables controlling of pixel transparency by changing
         dedicated alpha bits of specific pixel in video memory.

Optional properties:
 - background-layer-bits-per-pixel: background layer bits per pixel (16, 32)
      If omitted, last available layer is logiCVC standard layer, which has its
      own video memory of specific size, color format and specified
      bits per pixel.
      If 16 or 32, last available layer is logiCVC background layer,
      with only specified bits per pixel value.
 - background-layer-type: background layer type (rgb, yuv)
      Must be used only when "background-layer-bits-per-pixel" exist.
      If set to "rgb", in case of 32 bits per pixel, background color register
      must be written with XRGB8888 value. In case of 16 bits per pixel,
      background color register must be written with RGB565 value.
      If set to "yuv", background color register must be written with XYUV8888
      value.
 - is-hsync-active-low: horizontal synchronization pulse polarity
      If omitted, generated horizontal synchronization pulse polarity is logic
      high "H".
 - is-vsync-active-low: vertical synchronization pulse polarity
      If omitted, generated vertical synchronization pulse polarity is logic
      high "H".
 - is-pixel-data-invert: output pixel data polarity
      If omitted, logiCVC outputs pixel data at default interface polarity.
 - is-pixel-data-output-trigger-high: output pixel data trigger polarity
      If omitted, logiCVC outputs pixel data on falling edge of pixel clock.
 - is-readable-regs: all logiCVC registers are available for reading
      If omitted, only Interrupt Status, Power Control and IP Version registers
      are available for reading.
 - is-size-position: logiCVC functionality for controlling on screen layer size
      and position is available
      If omitted, functionality is not available.
 - address: layer video memory address for layer_N where N is layer ID in
      range 0 - 4
      logiCVC can be configured to have layer video memory address hardcoded
      as layer register reset value. This video memory is not part of the system
      memory nor visible from the system. Still it is accessible by CPU and hw
      devices.
      If omitted, layer video memory address is set dynamically by
      device driver.

Example:

	logicvc_0: logicvc@40000000 {
		compatible = "xylon,logicvc-4.00.a";
		reg = <0x40000000 0x6000>;
		interrupt-parent = <&gic_0>;
		interrupts = <0 59 4>;
		background-layer-bits-per-pixel = <32>;
		background-layer-type = "rgb";
		is-hsync-active-low;
		is-vsync-active-low;
		is-readable-regs;
		is-size-position;
		pixel-stride = <2048>;
		layer_0 {
			address = <0x30000000>;
			bits-per-pixel = <16>;
			type = "rgb";
			transparency = "layer";
		};
		layer_1 {
			address = <0x30500000>;
			bits-per-pixel = <32>;
			type = "rgb";
			transparency = "layer";
		};
		layer_2 {
			address = <0x30E00000>;
			bits-per-pixel = <32>;
			type = "rgb";
			transparency = "pixel";
		};
		layer_3 {
			address = <0x31700000>;
			bits-per-pixel = <16>;
			type = "yuv";
			transparency = "layer";
		};
	};
```

## Documentation/devicetree/bindings/drm/xylon/xylon_drm.txt
```
Binding for Xylon DRM driver

Xylon DRM driver supports the Xylon configurable video controller
logiCVC FPGA IP core device.

Required properties:
 - compatible: value should be "xylon,drm-1.00.a".
 - clocks: the phandle for the pixel clock generator
 - device: the phandle for logiCVC video controller device
 - encoder: the phandle for the video encoder
 - primary-plane: logiCVC layer ID used for DRM driver primary plane

Example:

	xylon_drm {
		compatible = "xylon,drm-1.00.a";
		clocks = <&si570>;
		device = <&logicvc_0>;
		encoder = <&adv7511>;
		primary-plane = <0>;
	};
```

## Documentation/devicetree/bindings/drm/zocl/zocl_drm.txt
```
Binding for ZynQ OpenCL DRM driver

Required properties:
- compatible: should contain "xlnx,zocl"
- reg: base address and size for memory mapped control port for opencl kernel

Example:

	zocl_drm {
		compatible = "xlnx,zocl";
		status = "okay";
		reg = <0x80000000 0x10000>;
	};
```

## Documentation/devicetree/bindings/edac/cortex-arm64-edac.txt
```
* ARM Cortex A57 and A53 L1/L2 cache error reporting

CPU Memory Error Syndrome and L2 Memory Error Syndrome registers can be used
for checking L1 and L2 memory errors.

The following section describes the Cortex A57/A53 EDAC DT node binding.

Required properties:
- compatible: Should be "arm,cortex-a57-edac" or "arm,cortex-a53-edac"

Example:
	edac {
		compatible = "arm,cortex-a57-edac";
	};
```

## Documentation/devicetree/bindings/edac/pl310_edac_l2.txt
```
Pl310 L2 Cache EDAC driver, it does reports the data and tag ram parity errors.

Required properties:
- compatible: Should be "arm,pl310-cache".
- intterupts: Interrupt number to the cpu.
- reg: Physical base address and size of cache controller's memory mapped
  registers

Example:
++++++++

	L2: cache-controller {
		compatible = "arm,pl310-cache";
		interrupts = <0 2 4>;
		reg = <0xf8f02000 0x1000>;
	};

PL310 L2 Cache EDAC driver detects the Parity enable state by reading the
appropriate control register.
```
