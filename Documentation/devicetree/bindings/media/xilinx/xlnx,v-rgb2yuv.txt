## Documentation/devicetree/bindings/media/xilinx/xlnx,v-scd.yaml
```yaml
# SPDX-License-Identifier: (GPL-2.0-only OR BSD-2-Clause)
%YAML 1.2
---
$id: http://devicetree.org/schemas/media/xilinx/xlnx,v-scd.yaml#
$schema: http://devicetree.org/meta-schemas/core.yaml#

title: Xilinx Scene Change Detection IP.

maintainers:
  - Asif Ikbal <asif.ikbal@amd.com>

description:
  The Xilinx Scene Change Detection IP contains two blocks, one IP block is used
  for reading video frame data from memory to the device and the other IP block
  is used for determining whether there is a scene change between current and the
  previous frame. The IP supports YUV planar and semi-planar formats. IP only
  needs luma frame to determine the scene change event. The IP supports memory
  based model, which means that it will accept a dma buffer address and perform
  MEM2DEV transfer followed by statistical based image processing and give the
  data back to application if scene change detection is present or not.
  Another version of scene change detection IP which supports streaming model,
  which means that IP can be inserted in a capture pipeline. For example,
  "hdmirx -> streaming-scd -> fb_wr" is a typical capture pipeline where
  streaming SCD can be embedded. The IP accespts the AXI video data and perform
  histogram based statistical analysis to detect scene change. The IP supports
  single channel.

properties:
  compatible:
    const: xlnx,v-scd

  reg:
    maxItems: 1

  clocks:
    description: Reference to the AXI Streaming clock.
    maxItems: 1

  interrupts:
    maxItems: 1

  reset-gpios:
    maxItems: 1
    description: Should contain GPIO reset phandle

  xlnx,memorybased:
    description: This is to differentiate between memory based and
      streaming based IP. The value is 1 for memory based
      and 0 for streaming based IPs.
    type: boolean

  xlnx,numstreams:
    description: Number of stream IP connected with SCD.
    $ref: /schemas/types.yaml#/definitions/uint32
    minimum: 1
    maximum: 8

  xlnx,addrwidth:
    description: Size of dma address pointer in IP
    $ref: /schemas/types.yaml#/definitions/uint32
    enum: [32, 64]

  "#address-cells":
    const: 1

  "#size-cells":
    const: 0

  "#dma-cells":
    const: 1
    description: Number of cells in a DMA specifier for consumers.

  ports:
    type: object
    description: Streaming-based device node.

    properties:
      "#address-cells":
        const: 1

      "#size-cells":
        const: 0

    patternProperties:
      "^port@[0-1]$":
        type: object
        description: port@0 is input port. port@1 is output port.

        properties:
          reg:
            enum: [0, 1]

          endpoint:
            type: object

            properties:
              remote-endpoint: true

            required:
              - remote-endpoint

            additionalProperties: false

        required:
          - reg
          - endpoint

        additionalProperties: false

    required:
      - "#address-cells"
      - "#size-cells"
      - port@0
      - port@1

    additionalProperties: false

patternProperties:
  "^subdev@[0-7]$":
    type: object
    description: SCD channel subdevice for memory-based operation.
      Each channel provides an independent V4L2 subdevice interface
      for processing separate video streams.

    properties:
      reg:
        description: Subdevice index (0-7)
        $ref: /schemas/types.yaml#/definitions/uint32
        minimum: 0
        maximum: 7

      "#address-cells":
        const: 1

      "#size-cells":
        const: 0

      port@0:
        type: object
        description: Input port configuration

        properties:
          reg:
            const: 0

          endpoint:
            type: object

            properties:
              remote-endpoint: true

            required:
              - remote-endpoint

            additionalProperties: false

        required:
          - reg
          - endpoint

        additionalProperties: false

    required:
      - "#address-cells"
      - "#size-cells"
      - reg
      - port@0

    additionalProperties: false

required:
  - reg
  - clocks
  - interrupts
  - reset-gpios
  - xlnx,numstreams
  - xlnx,addrwidth

allOf:
  - if:
      required:
        - xlnx,memorybased
    then:
      required:
        - '#dma-cells'

additionalProperties: false

examples:
  - |
    /* Memory-based example (8 streams) */
    v_scenechange: scenechange@a0100000 {
        compatible = "xlnx,v-scd";
        reg = <0xa0100000 0x2000>;
        clocks = <&misc_clk_0>;
        interrupt-parent = <&gic>;
        interrupts = <0 90 4>;
        reset-gpios = <&gpio 94 1>;
        xlnx,memorybased;
        xlnx,numstreams = <8>;
        xlnx,addrwidth = <0x20>;
        #address-cells = <1>;
        #size-cells = <0>;
        #dma-cells = <1>;

        subdev@0 {
          #address-cells = <1>;
          #size-cells = <0>;
          reg = <0>;
          port@0 {
            reg = <0>;
            endpoint {
              remote-endpoint = <&vcap0_out0>;
            };
          };
        };
        subdev@1 {
          #address-cells = <1>;
          #size-cells = <0>;
          reg = <1>;
          port@0 {
            reg = <0>;
            endpoint {
              remote-endpoint = <&vcap0_out1>;
            };
          };
        };
        subdev@2 {
          #address-cells = <1>;
          #size-cells = <0>;
          reg = <2>;
          port@0 {
            reg = <0>;
            endpoint {
              remote-endpoint = <&vcap0_out2>;
            };
          };
        };
        subdev@3 {
          #address-cells = <1>;
          #size-cells = <0>;
          reg = <3>;
          port@0 {
            reg = <0>;
            endpoint {
              remote-endpoint = <&vcap0_out3>;
            };
          };
        };
        subdev@4 {
          #address-cells = <1>;
          #size-cells = <0>;
          reg = <4>;
          port@0 {
            reg = <0>;
            endpoint {
              remote-endpoint = <&vcap0_out4>;
            };
          };
        };
        subdev@5 {
          #address-cells = <1>;
          #size-cells = <0>;
          reg = <5>;
          port@0 {
            reg = <0>;
            endpoint {
              remote-endpoint = <&vcap0_out5>;
            };
          };
        };
        subdev@6 {
          #address-cells = <1>;
          #size-cells = <0>;
          reg = <6>;
          port@0 {
            reg = <0>;
            endpoint {
              remote-endpoint = <&vcap0_out6>;
            };
          };
        };
        subdev@7 {
          #address-cells = <1>;
          #size-cells = <0>;
          reg = <7>;
          port@0 {
            reg = <0>;
            endpoint {
                remote-endpoint = <&vcap0_out7>;
            };
          };
        };
    };

  - |
    /* Streaming-based example (1 stream) */
    v_scenechange_0: scenechange@a0280000 {
        compatible = "xlnx,v-scd";
        reg = <0xa0280000 0x2000>;
        clocks = <&clk 72>;
        interrupt-parent = <&gic>;
        interrupts = <0 111 4>;
        reset-gpios = <&gpio 100 1>;
        xlnx,numstreams = <1>;
        xlnx,addrwidth = <32>;
        #address-cells = <1>;
        #size-cells = <0>;

        ports {
          #address-cells = <1>;
          #size-cells = <0>;
          port@0 {
            reg = <0>;
            scd_in0: endpoint {
              remote-endpoint = <&vpss_scaler_out>;
            };
          };
          port@1 {
            reg = <1>;
            scd_out0: endpoint {
              remote-endpoint = <&vcap_hdmi_in_1>;
            };
          };
        };
    };
```

## Documentation/devicetree/bindings/media/xilinx/xlnx,v-switch.txt
```
Xilinx Video Switch
-------------------

Required properties:

  - compatible: Must be "xlnx,v-switch-1.0".

  - reg: Physical base address and length of the registers set for the device.

  - clocks: Reference to the video core clock.

  - #xlnx,inputs: Number of input ports
  - #xlnx,outputs: Number of outputs ports

  - ports: Video ports, using the DT bindings defined in ../video-interfaces.txt.

Example:

	switch: switch@43c10000 {
		compatible = "xlnx,v-switch-1.0";
		reg = <0x43c10000 0x10000>;
		clocks = <&clkc 15>;

		#xlnx,inputs = <2>;
		#xlnx,outputs = <2>;

		ports {
			#address-cells = <1>;
			#size-cells = <0>;
			port@0 {
				reg = <0>;
				switch_in0: endpoint {
					remote-endpoint = <&tpg_out>;
				};
			};
			port@1 {
				reg = <1>;
				switch_in1: endpoint {
					remote-endpoint = <&cresample0_out>;
				};
			};
			port@2 {
				reg = <2>;
				switch_out0: endpoint {
					remote-endpoint = <&scaler0_in>;
				};
			};
			port@3 {
				reg = <3>;
				switch_out1: endpoint {
					remote-endpoint = <&vcap0_in1>;
				};
			};
		};
	};
```

## Documentation/devicetree/bindings/media/xilinx/xlnx,v-tc.yaml
```yaml
# SPDX-License-Identifier: (GPL-2.0-only OR BSD-2-Clause)
%YAML 1.2
---
$id: http://devicetree.org/schemas/media/xilinx/xlnx,v-tc.yaml#
$schema: http://devicetree.org/meta-schemas/core.yaml#

title: Xilinx Video Timing Controller (VTC)

maintainers:
  - Rajesh Gugulothu  <rajesh.gugulothu@amd.com>

description:
  The Xilinx Video Timing Controller core is a general purpose video
  timing generator and detector. The core is highly programmable
  through a comprehensive register set allowing control of various
  timing generation parameters. This programmability is coupled with
  a comprehensive set of interrupt bits which provides easy integration
  into a processor system for in-system control of the block in
  real-time. The Video Timing Controller is provided with an optional
  AXI4-Lite compliant interface.
  For more details refer to PG 016 Xilinx Video Timing Controller.

properties:
  compatible:
    items:
      - const: xlnx,v-tc-6.1

  reg:
    maxItems: 1

  clocks:
    maxItems: 1

  xlnx,generator:
    type: boolean
    $ref: /schemas/types.yaml#/definitions/flag
    description:
      Indicator of timing generator.

  xlnx,detector:
    type: boolean
    $ref: /schemas/types.yaml#/definitions/flag
    description:
      Indicator of timing detector.

required:
  - reg
  - clocks

additionalProperties: false

examples:
  - |
    vtc: vtc@43c40000 {
      compatible = "xlnx,v-tc-6.1";
      reg = <0x43c40000 0x10000>;
      clocks = <&clkc 15>;
      xlnx,generator;
    };
...
```

## Documentation/devicetree/bindings/media/xilinx/xlnx,v-tpg.txt
```
Xilinx Video Test Pattern Generator (TPG)
-----------------------------------------

Required properties:

- compatible: Must contain at least one of

    "xlnx,v-tpg-5.0" (TPG version 5.0)
    "xlnx,v-tpg-7.0" (TPG version 7.0)
    "xlnx,v-tpg-8.0" (TPG version 8.0)

  TPG versions backward-compatible with previous versions should list all
  compatible versions in the newer to older order.

- reg: Physical base address and length of the registers set for the device.

- clocks: Reference to the video core clock.

- xlnx,video-format, xlnx,video-width: Video format and width, as defined in
  video.txt.

- port: Video port, using the DT bindings defined in ../video-interfaces.txt.
  The TPG has a single output port numbered 0.

Optional properties:

- xlnx,ppc: Pixels per clock. Valid values are 1, 2, 4 or 8.

- xlnx,vtc: A phandle referencing the Video Timing Controller that generates
  video timings for the TPG test patterns.

- timing-gpios: Specifier for a GPIO that controls the timing mux at the TPG
  input. The GPIO active level corresponds to the selection of VTC-generated
  video timings.

- reset-gpios: Specifier for a GPIO that assert TPG (AP_RST_N) reset.
  This property is mandatory for TPG v7.0 and above.

- xlnx,max-height: Maximum number of lines.
  This property is mandatory for TPG v8.0. Value ranges from 64 to 7760.

- xlnx,max-width: Maximum number of pixels in a line.
  This property is mandatory for TPG v8.0. Value ranges from 64 to 10328.

The xlnx,vtc and timing-gpios properties are mandatory when the TPG is
synthesized with two ports and forbidden when synthesized with one port.

Example:

	tpg_0: tpg@40050000 {
		compatible = "xlnx,v-tpg-5.0";
		reg = <0x40050000 0x10000>;
		clocks = <&clkc 15>;

		xlnx,ppc = <2>;
		xlnx,vtc = <&vtc_3>;
		timing-gpios = <&ps7_gpio_0 55 GPIO_ACTIVE_LOW>;

		ports {
			#address-cells = <1>;
			#size-cells = <0>;

			port@0 {
				reg = <0>;

				xlnx,video-format = <XVIP_VF_YUV_422>;
				xlnx,video-width = <8>;

				tpg_in: endpoint {
					remote-endpoint = <&adv7611_out>;
				};
			};
			port@1 {
				reg = <1>;

				xlnx,video-format = <XVIP_VF_YUV_422>;
				xlnx,video-width = <8>;

				tpg1_out: endpoint {
					remote-endpoint = <&switch_in0>;
				};
			};
		};
	};
```
