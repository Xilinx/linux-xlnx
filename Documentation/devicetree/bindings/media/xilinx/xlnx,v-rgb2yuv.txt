## Documentation/devicetree/bindings/media/xilinx/xlnx,v-tpg.yaml
```yaml
# SPDX-License-Identifier: (GPL-2.0-only OR BSD-2-Clause)
%YAML 1.2
---
$id: http://devicetree.org/schemas/media/xilinx/xlnx,v-tpg.yaml#
$schema: http://devicetree.org/meta-schemas/core.yaml#

title: Xilinx Test Pattern Generator IP.

maintainers:
  - Kunal Rane <kunal.rane@amd.com>

description:
  The Xilinx TPG IP is used generate different live video test patterns
  for different video resolutions and video color formats. One can also
  generate video patterns for different pixels per clock.

properties:
  compatible:
    enum:
      - xlnx,v-tpg-8.2
      - xlnx,v-tpg-8.0

  reg:
    maxItems: 1

  clocks:
    description: Reference to video core clock.
    maxItems: 1

  clock-names:
    deprecated: true
    maxItems: 1

  reset-gpios:
    description: Should contain GPIO reset phandle
    maxItems: 1

  xlnx,ppc:
    description: Pixels per clock.
    $ref: /schemas/types.yaml#/definitions/uint32
    enum: [1, 2, 4, 8]

  xlnx,vtc:
    description: phandle of xilinx video timing controller.
    $ref: /schemas/types.yaml#/definitions/phandle

  ports:
    type: object

    properties:
      "#address-cells":
        const: 1

      "#size-cells":
        const: 0

    patternProperties:
      "^port@[0-1]$":
        type: object
        description: port@0 is input. port@1 is output.

        properties:
          reg:
            enum: [0, 1]

          xlnx,video-format:
            description: Video format details for input/output port.
              The possible values are -
              0 - RGB
              1 - YUV444
              2 - YUV422
              3 - YUV420
            $ref: /schemas/types.yaml#/definitions/uint32
            enum: [0, 1, 2, 3]

          xlnx,video-width:
            description: The video width to which input/output pads
              of the VPSS IP are set.
            $ref: /schemas/types.yaml#/definitions/uint32
            enum: [8, 10, 12, 16]

          endpoint:
            type: object

            properties:
              remote-endpoint: true

            required:
              - remote-endpoint

            additionalProperties: false

        required:
          - reg
          - xlnx,video-format
          - xlnx,video-width
          - endpoint

        additionalProperties: false

    required:
      - "#address-cells"
      - "#size-cells"
      - port@0
      - port@1

    additionalProperties: false

required:
  - reg
  - clocks
  - clock-names
  - reset-gpios
  - xlnx,ppc
  - xlnx,vtc
  - ports

additionalProperties: false

examples:
  - |
    tpg@40050000 {
        compatible = "xlnx,v-tpg-8.0";
        reg = <0x40050000 0x10000>;
        clocks = <&clkc 15>;
        clock-names = "ap_clk";
        reset-gpios = <&gpio 0 1>;
        xlnx,ppc = <2>;
        xlnx,vtc = <&vtc_3>;
        ports {
            #address-cells = <1>;
            #size-cells = <0>;
            port@0 {
                reg = <0>;
                xlnx,video-format = <2>;
                xlnx,video-width = <8>;
                tpg_in: endpoint {
                    remote-endpoint = <&adv7611_out>;
                };
            };
            port@1 {
                reg = <1>;
                xlnx,video-format = <2>;
                xlnx,video-width = <8>;
                tpg1_out: endpoint {
                    remote-endpoint = <&switch_in0>;
                };
            };
        };
    };
```

## Documentation/devicetree/bindings/media/xilinx/xlnx,v-vpss-csc.txt
```
Xilinx VPSS Color Space Converter (CSC)
-----------------------------------------
The Xilinx VPSS Color Space Converter (CSC) is a Video IP that supports
color space conversion from RGB or YUV(444, 422, 420)input to RGB or
YUV(444, 422, 420) output.

Required properties:

- compatible: Must be "xlnx,v-vpss-csc".

- reg: Physical base address and length of the registers set for the device.

- clocks: Reference to the clock that drives the ap_clk signal.

- xlnx,max-height: Maximum number of lines.
  Valid range from 64 to 4320.

- xlnx,max-width: Maximum number of pixels in a line.
  Valid range from 64 to 8192.

- reset-gpios: Specifier for a GPIO that assert VPSS CSC (AP_RST_N) reset.

- ports: Video ports, using the DT bindings defined in ../video-interfaces.txt.
  The scaler has an input port (0) and an output port (1).

Required port properties:

- xlnx,video-format: Must be XVIP_VF_RBG, XVIP_VF_YUV_444 or XVIP_VF_YUV_422
  for input port (0) and XVIP_VF_RBG, XVIP_VF_YUV_444 or XVIP_VF_YUV_422
  for output port (1). See <dt-bindings/media/xilinx-vip.h> for more details.

- xlnx,video-width: Video width as defined in video.txt. Must be either 8 or 10.

Example:
	csc_1:csc@a0040000 {
		compatible = "xlnx,v-vpss-csc";
		reg = <0x0 0xa0040000 0x0 0x10000>;
		clocks = <&vid_stream_clk>;
		reset-gpios = <&gpio 84 1>;
		xlnx,max-width = <3840>;
		xlnx,max-height = <2160>;

		ports {
			#address-cells = <1>;
			#size-cells = <0>;
			/* Sink Pad */
			port@0 {
				reg = <0>;
				xlnx,video-format = <XVIP_VF_RBG>;
				xlnx,video-width = <8>;

				csc_in: endpoint {
					remote-endpoint = <&gamma_out>;
				};
			};
			/* Source Pad */
			port@1 {
				reg = <1>;
				xlnx,video-format = <XVIP_VF_RBG>;
				xlnx,video-width = <8>;

				csc_out: endpoint {
					remote-endpoint = <&scalar_in>;
				};
			};
		};
	};
```

## Documentation/devicetree/bindings/media/xilinx/xlnx,v-vpss-csc.yaml
```yaml
# SPDX-License-Identifier: (GPL-2.0-only OR BSD-2-Clause)
%YAML 1.2
---
$id: http://devicetree.org/schemas/media/xilinx/xlnx,v-vpss-csc.yaml#
$schema: http://devicetree.org/meta-schemas/core.yaml#

title: Xilinx VPROC_SS IP.

maintainers:
  - Kunal Rane <kunal.rane@amd.com>

description:
  The Xilinx VPSS Color Space Converter (CSC) is a Video IP that supports
  color space conversion from RGB or YUV(444, 422, 420)input to RGB or
  YUV(444, 422, 420) output.

properties:
  compatible:
    const: xlnx,v-vpss-csc

  reg:
    maxItems: 1

  clocks:
    description: Reference to video core clock.
    maxItems: 1

  clock-names:
    deprecated: true
    maxItems: 1

  reset-gpios:
    maxItems: 1
    description: Should contain GPIO reset phandle

  xlnx,max-height:
    description: Maximum number of lines.
    $ref: /schemas/types.yaml#/definitions/uint32
    minimum: 64
    maximum: 4320

  xlnx,max-width:
    description: Maximum number of pixels in a line.
    $ref: /schemas/types.yaml#/definitions/uint32
    minimum: 64
    maximum: 8192

  ports:
    type: object

    properties:
      "#address-cells":
        const: 1

      "#size-cells":
        const: 0

    patternProperties:
      "^port@[0-1]$":
        type: object
        description: port@0 is input. port@1 is output.

        properties:
          reg:
            enum: [0, 1]

          xlnx,video-format:
            description:
              Video format details for input and output port.
              The possible values are -
              0 - RGB
              1 - YUV444
              2 - YUV422
              3 - YUV420
            $ref: /schemas/types.yaml#/definitions/uint32
            enum: [0, 1, 2, 3]

          xlnx,video-width:
            description:
              The video with to which input and output pads
              of the VPSS IP are set.
            $ref: /schemas/types.yaml#/definitions/uint32
            enum: [8, 10, 12, 16]

          endpoint:
            type: object

            properties:
              remote-endpoint: true

            required:
              - remote-endpoint

            additionalProperties: false

        required:
          - reg
          - xlnx,video-format
          - xlnx,video-width
          - endpoint

        additionalProperties: false

    required:
      - "#address-cells"
      - "#size-cells"
      - port@0
      - port@1

    additionalProperties: false

required:
  - reg
  - clocks
  - clock-names
  - reset-gpios
  - xlnx,max-height
  - xlnx,max-width
  - ports

additionalProperties: false

examples:
  - |
    csc@a0040000 {
        compatible = "xlnx,v-vpss-csc";
        reg = <0xa0040000 0x10000>;
        clocks = <&misc_clk_2>;
        clock-names = "ap_clk";
        reset-gpios = <&gpio 0 1>;
        xlnx,max-height = <2160>;
        xlnx,max-width = <3840>;
        ports {
            #address-cells = <1>;
            #size-cells = <0>;
            port@0 {
                reg = <0>;
                xlnx,video-format = <0>;
                xlnx,video-width = <8>;
                csc_in: endpoint {
                    remote-endpoint = <&gamma_out>;
                };
            };
            port@1 {
                reg = <1>;
                xlnx,video-format = <3>;
                xlnx,video-width = <8>;
                csc_out: endpoint {
                    remote-endpoint = <&scaler_in>;
                };
            };
        };
    };
```

## Documentation/devicetree/bindings/media/xilinx/xlnx,v-vpss-scaler.txt
```
  Xilinx VPSS Scaler
------------------------

Required properties:

- compatible: Must be "xlnx,v-vpss-scaler".

- reg: Physical base address and length of the registers set for the device.

- clocks: Reference to the AXI Streaming clock feeding the VPSS Scaler AP_CLK

- xlnx,num-hori-taps, xlnx,num-vert-taps: The number of horizontal and vertical
  taps for scaling filter(range: 2,4,6,8,10,12).

  A value of 2 represents bilinear filters. A value of 4 represents bicubic.
  Values 6,8,10,12 represent polyphase filters.

- xlnx,pix-per-clk : The pixels per clock property of the IP

- reset-gpios: Specifier for a GPIO that assert for VPSS Scaler reset.
  This property is mandatory for the Scaler

- ports: Video ports, using the DT bindings defined in ../video-interfaces.txt.
  The scaler has an input port (0) and an output port (1).

Required port properties:

- xlnx,video-format: Must be one of XVIP_VF_RBG or XVIP_VF_YUV_422 for
  input port (0) and must be XVIP_VF_RBG or XVIP_VF_YUV_422 or for
  the output port (1).
  See <dt-bindings/media/xilinx-vip.h> for more details.

- reg: This value represents the media pad of the V4L2 sub-device.
  A Sink Pad is represented by reg = <0>
  A Source Pad is represented by reg = <1>

- xlnx,video-width: Video width as defined in video.txt

Example:

	scaler_1:scaler@a0000000 {
		compatible = "xlnx,v-vpss-scaler";
		reg = <0x0 0xa0000000 0x0 0x40000>;
		clocks = <&vid_stream_clk>;
		xlnx,num-hori-taps = <8>;
		xlnx,num-vert-taps = <8>;
		xlnx,pix-per-clk = <2>;
		reset-gpios = <&gpio 87 1>;

		ports {
			#address-cells = <1>;
			#size-cells = <0>;

			port@0 {
				/* Sink Pad */
				reg = <0>;

				xlnx,video-format = <XVIP_VF_RBG>;
				xlnx,video-width = <8>;

				scaler_in: endpoint {
					remote-endpoint = <&csc_out>;
				};
			};

			port@1 {
				/* Source Pad */
				reg = <1>;

				xlnx,video-format = <XVIP_VF_YUV_422>;
				xlnx,video-width = <8>;

				scaler_out: endpoint {
					remote-endpoint = <&vcap_tpg_in>;
				};
			};
		};

	};
```

## Documentation/devicetree/bindings/media/xilinx/xlnx,v-vpss-scaler.yaml
```yaml
# SPDX-License-Identifier: (GPL-2.0-only OR BSD-2-Clause)
%YAML 1.2
---
$id: http://devicetree.org/schemas/media/xilinx/xlnx,v-vpss-scaler.yaml#
$schema: http://devicetree.org/meta-schemas/core.yaml#

title: Xilinx VPROC_SS IP.

maintainers:
  - Kunal Rane <kunal.rane@amd.com>

description:
  The Xilinx VPSS Scaler IP is a Video IP that supports up and down
  scaling as well as color space conversion from RGB or YUV(444, 422, 420)
  input to RGB or YUV(444, 422, 420) output.

properties:
  compatible:
    const: xlnx,v-vpss-scaler-1.0

  reg:
    maxItems: 1

  clocks:
    description: Reference to video core clock.
    maxItems: 1

  clock-names:
    deprecated: true
    maxItems: 1

  reset-gpios:
    description: Should contain GPIO reset phandle
    maxItems: 1

  xlnx,max-height:
    description: Maximum number of lines.
    $ref: /schemas/types.yaml#/definitions/uint32
    minimum: 64
    maximum: 4320

  xlnx,max-width:
    description: Maximum number of pixels in a line.
    $ref: /schemas/types.yaml#/definitions/uint32
    minimum: 64
    maximum: 8192

  xlnx,num-hori-taps:
    description: The number of horizontal taps for scaling filter.
      A value of 2 represents bilinear filters.
      A value of 4 represents bicubic. Values 6, 8, 10, 12 represent
      polyphase filters.
    $ref: /schemas/types.yaml#/definitions/uint32
    enum: [2, 4, 6, 8, 10, 12]

  xlnx,num-vert-taps:
    description: The number of vertical taps for scaling filter.
      A value of 2 represents bilinear filters.
      A value of 4 represents bicubic. Values 6, 8, 10, 12 represent
      polyphase filters.
    $ref: /schemas/types.yaml#/definitions/uint32
    enum: [2, 4, 6, 8, 10, 12]

  xlnx,pix-per-clk:
    description: The pixels per clock property of the IP.
    $ref: /schemas/types.yaml#/definitions/uint32
    enum: [1, 2, 4, 8]

  ports:
    type: object

    properties:
      "#address-cells":
        const: 1

      "#size-cells":
        const: 0

    patternProperties:
      "^port@[0-1]$":
        type: object
        description: port@0 is input. port@1 is output.

        properties:
          reg:
            enum: [0, 1]

          xlnx,video-format:
            description:
              Video format details for input and output port.
              The possible values are -
              0 - RGB
              1 - YUV444
              2 - YUV422
              3 - YUV420
            $ref: /schemas/types.yaml#/definitions/uint32
            enum: [0, 1, 2, 3]

          xlnx,video-width:
            description:
              The video with to which input and output pads
              of the VPSS IP are set.
            $ref: /schemas/types.yaml#/definitions/uint32
            enum: [8, 10, 12, 16]

          endpoint:
            type: object

            properties:
              remote-endpoint: true

            required:
              - remote-endpoint

            additionalProperties: false

        required:
          - reg
          - xlnx,video-format
          - xlnx,video-width
          - endpoint

        additionalProperties: false

    required:
      - "#address-cells"
      - "#size-cells"
      - port@0
      - port@1

    additionalProperties: false

required:
  - reg
  - clocks
  - clock-names
  - reset-gpios
  - xlnx,max-height
  - xlnx,max-width
  - xlnx,num-hori-taps
  - xlnx,num-vert-taps
  - xlnx,pix-per-clk
  - ports

additionalProperties: false

examples:
  - |
    csc@a0040000 {
        compatible = "xlnx,v-vpss-scaler-1.0";
        reg = <0xa0040000 0x10000>;
        clocks = <&misc_clk_2>;
        clock-names = "ap_clk";
        reset-gpios = <&gpio 0 1>;
        xlnx,max-height = <2160>;
        xlnx,max-width = <3840>;
        xlnx,num-hori-taps = <8>;
        xlnx,num-vert-taps = <8>;
        xlnx,pix-per-clk = <2>;
        ports {
            #address-cells = <1>;
            #size-cells = <0>;
            port@0 {
                reg = <0>;
                xlnx,video-format = <0>;
                xlnx,video-width = <8>;
                csc_in: endpoint {
                    remote-endpoint = <&gamma_out>;
                };
            };
            port@1 {
                reg = <1>;
                xlnx,video-format = <3>;
                xlnx,video-width = <8>;
                csc_out: endpoint {
                    remote-endpoint = <&scaler_in>;
                };
            };
        };
    };
```
