## Documentation/devicetree/bindings/media/xilinx/xlnx,video.txt
```
Xilinx Video IP Pipeline (VIPP)
-------------------------------

General concept
---------------

Xilinx video IP pipeline processes video streams through one or more Xilinx
video IP cores. Each video IP core is represented as documented in video.txt
and IP core specific documentation, xlnx,v-*.txt, in this directory. The DT
node of the VIPP represents as a top level node of the pipeline and defines
mappings between DMAs and the video IP cores.

Required properties:

- compatible: Must be "xlnx,video".

- dmas, dma-names: List of one DMA specifier and identifier string (as defined
  in Documentation/devicetree/bindings/dma/dma.txt) per port. Each port
  requires a DMA channel with the identifier string set to "port" followed by
  the port index.

- ports: Video port, using the DT bindings defined in ../video-interfaces.txt.

Optional properties:
- memory-region : phandle to /reserved-memory node.
  If memory is reserved for special use by DMAs then this node
  can be used to refer and use from this reserved memory region.

- xlnx,atomic_streamon: This property is useful for the scenario where some of
  the upstream entities are being shared with multiple video devices (dma
  engines) in the same media pipeline. When set, all entities belonging to
  the media pipeline will get enabled even when any one of the dma engine
  present in the media  pipeline start streaming, otherwise the entities
  get enabled only when all dma engines start streaming.

Required port properties:

- direction: should be either "input" or "output" depending on the direction
  of stream.

Example:

	video_cap {
		compatible = "xlnx,video";
		dmas = <&vdma_1 1>, <&vdma_3 1>;
		dma-names = "port0", "port1";

		ports {
			#address-cells = <1>;
			#size-cells = <0>;

			port@0 {
				reg = <0>;
				direction = "input";
				vcap0_in0: endpoint {
					remote-endpoint = <&scaler0_out>;
				};
			};
			port@1 {
				reg = <1>;
				direction = "input";
				vcap0_in1: endpoint {
					remote-endpoint = <&switch_out1>;
				};
			};
		};
	};

Example using reserved memory:
Reserving from 32bit Shared CMA pool of 512MiB using System RAM:
++++++++++++++++++++++++++++++++++++++++++++++++++++++++++++++++
/ {
	reserved-memory {
		#address-cells = <0x2>;
		#size-cells = <0x2>;
		ranges;
		psmem_multimedia: multimedia_cma_mem_region {
			compatible = "shared-dma-pool";
			reg = <0x00 0x40000000 0x00 0x20000000>;
			reusable;
		};
	};
};
...
	video_cap {
		/* ... */
		memory-region = <&psmem_multimedia>;
	};


Reserving from 64bit Shared DMA pool of 1792 MiB using external PL based
DDR memory:
++++++++++++++++++++++++++++++++++++++++++++++++++++++++++++++++++++++++
/ {
	reserved-memory {
		#address-cells = <0x2>;
		#size-cells = <0x2>;
		ranges;
		plmem_multimedia: multimedia_dma_mem_region {
			compatible = "shared-dma-pool";
			no-map;
			reg = <0x48 0x0 0x0 0x70000000>;
		};
	};
};
...
	video_cap {
		/* ... */
		memory-region = <&plmem_multimedia>;
	}
```

## Documentation/devicetree/bindings/memory-controllers/pl353-smc.txt
```
Device tree bindings for ARM PL353 static memory controller

PL353 static memory controller supports two kinds of memory
interfaces.i.e NAND and SRAM/NOR interfaces.
The actual devices are instantiated from the child nodes of pl353 smc node.

Required properties:
- compatible		: Should be "arm,pl353-smc-r2p1"
- reg			: Controller registers map and length.
- clock-names		: List of input clock names - "ref_clk", "aper_clk"
			  (See clock bindings for details).
- clocks		: Clock phandles (see clock bindings for details).
- address-cells		: Address cells, must be 1.
- size-cells		: Size cells. Must be 1.

Child nodes:
 For NAND the "arm,pl353-nand-r2p1" and for NOR the "cfi-flash" drivers are
supported as child nodes.

Mandatory timing properties for child nodes:
- arm,nand-cycle-t0	: Read cycle time(t_rc).
- arm,nand-cycle-t1	: Write cycle time(t_wc).
- arm,nand-cycle-t2	: re_n assertion delay(t_rea).
- arm,nand-cycle-t3	: we_n de-assertion delay(t_wp).
- arm,nand-cycle-t4	: Status read time(t_clr)
- arm,nand-cycle-t5	: ID read time(t_ar)
- arm,nand-cycle-t6	: busy to re_n(t_rr)

for nand partition information please refer the below file
Documentation/devicetree/bindings/mtd/partition.txt

Example:
	pl353smcc_0: pl353smcc@e000e000 {
			compatible = "arm,pl353-smc-r2p1"
			clock-names = "memclk", "aclk";
			clocks = <&clkc 11>, <&clkc 44>;
			reg = <0xe000e000 0x1000>;
			#address-cells = <1>;
			#size-cells = <1>;
			ranges;
			nand_0: nand@e1000000 {
				compatible = "arm,pl353-nand-r2p1"
				reg = <0xe1000000 0x1000000>;
				arm,nand-cycle-t0 = <0x4>;
				arm,nand-cycle-t1 = <0x4>;
				arm,nand-cycle-t2 = <0x1>;
				arm,nand-cycle-t3 = <0x2>;
				arm,nand-cycle-t4 = <0x2>;
				arm,nand-cycle-t5 = <0x2>;
				arm,nand-cycle-t6 = <0x4>;
				(...)
			};
	};
```

## Documentation/devicetree/bindings/memory-controllers/synopsys.txt
```
Binding for Synopsys IntelliDDR Multi Protocol Memory Controller

Synopsys EDAC driver, it does reports the DDR ECC single bit errors
that are corrected and double bit ecc errors that are detected by the DDR
ECC controller.

The Zynq DDR ECC controller has an optional ECC support in half-bus width
(16-bit) configuration. The ECC controller corrects one bit error and detects
two bit errors.

Required properties:
 - compatible: One of:
	- 'xlnx,zynq-ddrc-a05' : Zynq DDR ECC controller
	- 'xlnx,zynqmp-ddrc-2.40a' : ZynqMP DDR ECC controller
 - reg: Should contain DDR controller registers location and length.

Required properties for "xlnx,zynqmp-ddrc-2.40a":
 - interrupt-parent: Should be core interrupt controller.
 - interrupts: Property with a value describing the interrupt number.

Example:
	memory-controller@f8006000 {
		compatible = "xlnx,zynq-ddrc-a05";
		reg = <0xf8006000 0x1000>;
	};

	mc: memory-controller@fd070000 {
		compatible = "xlnx,zynqmp-ddrc-2.40a";
		reg = <0x0 0xfd070000 0x0 0x30000>;
		interrupt-parent = <&gic>;
		interrupts = <0 112 4>;
	};
```

## Documentation/devicetree/bindings/memory-controllers/xlnx,zynqmp-ocmc-1.0.yaml
```yaml
# SPDX-License-Identifier: (GPL-2.0 OR BSD-2-Clause)
%YAML 1.2
---
$id: http://devicetree.org/schemas/edac/xlnx,zynqmp-ocmc.yaml#
$schema: http://devicetree.org/meta-schemas/core.yaml#

title: Xilinx Zynqmp OCM EDAC driver

maintainers:
  - Shubhrajyoti Datta <shubhrajyoti.datta@xilinx.com>

description: |
  Xilinx ZynqMP OCM EDAC driver, it does reports the OCM ECC single bit errors
  that are corrected and double bit ecc errors that are detected by the OCM
  ECC controller.

properties:
  compatible:
    const: xlnx,zynqmp-ocmc-1.0

  reg:
    maxItems: 1

  interrupts:
    maxItems: 1

required:
  - compatible
  - reg
  - interrupts

additionalProperties: false

examples:
  - |
      memory-controller@ff960000 {
        compatible = "xlnx,zynqmp-ocmc-1.0";
        reg = <0xff960000 0x1000>;
        interrupt-parent = <&gic>;
        interrupts = <0 10 4>;
      };
```

## Documentation/devicetree/bindings/misc/jesd-phy.txt
```
* Xilinx JESD204B Phy

Description:
The LogiCORE™ IP JESD204 PHY core implements a JESD204B Physical interface supporting
line rates between 1.0 and 12.5 Gb/s on 1 to 12 lanes using GTX, GTH, or GTP transceivers.

Required properties:
- compatible = "xlnx,jesd204-phy-2.0"
- reg = Should contain JESD204B phy registers location and length
- xlnx,pll-selection = The PLL selection 3 for QPLL and 1 For CPLL
- xlnx,lanes = No of Lanes
- xlnx,gt-refclk-freq = Reference frequency in Hz
- clocks = The phandle to the clock tree

Example:
++++++++
	jesd204_phycores:phy@41e10000 {
		compatible = "xlnx,jesd204-phy-2.0";
		reg = <0x41e10000 0x10000>;
		xlnx,gt-refclk-freq = "156250000";
		xlnx,lanes = <0x1>;
		xlnx,pll-selection = <0x3>;
		clocks = <&si570>;
	};
```

## Documentation/devicetree/bindings/misc/jesd204b.txt
```
* Xilinx JESD204B core

Description:
The LogiCORE™ IP JESD204 core implements a JESD204B core

Required properties:
- compatible = Should be one of
		"xlnx,jesd204-5.1";
		"xlnx,jesd204-5.2";
		"xlnx,jesd204-6.1";
- reg = Should contain JESD204B registers location and length
- xlnx,frames-per-multiframe = No of frames per multiframe
- xlnx,bytes-per-frame = No of bytes per frame
- xlnx,lanes = No of Lanes
- xlnx,subclass = subclass
- xlnx,node-is-transmit = should be present only for transmit nodes

Example:
++++++++
jesd_Tx_axi_0: jesd_Tx@44a20000 {
	compatible = "xlnx,jesd204-5.1";
	reg = <0x44a20000 0x10000>;
	xlnx,frames-per-multiframe = <30>;
	xlnx,bytes-per-frame = <2>;
	xlnx,subclass = <1>;
	xlnx,lanes = <0x2>;
	xlnx,node-is-transmit;
};
```

## Documentation/devicetree/bindings/misc/ti,dp159.txt
```
Binding for TI DP159 programmable i2c retimer

Reference
[1] DP159 Data Sheet
	http://www.ti.com/lit/ds/symlink/sn65dp159.pdf

The SNx5DP159 device is a dual mode DisplayPort to transition-minimized
differential signal (TMDS) retimer supporting digital video interface
(DVI) 1.0 and high-definition multimedia interface (HDMI) 1.4b and 2.0
output signals. The internal structure of the retimer can be found in [1].

==I2C device node==

Required properties:
- compatible: shall be "ti,dp159".
- status: shall be "okay"
- reg: i2c device address, shall be 0x5e.
- #clock-cells: from common clock binding; shall be set to 0.
- #address-cells: shall be set to 1.
- #size-cells: shall be set to 0.

==Example==

	dp159: hdmi-retimer@5e {
		status = "okay";
		compatible = "ti,dp159";
		reg = <0x5e>;
		#address-cells = <1>;
		#size-cells = <0>;
		#clock-cells = <0>;
	};			
```

## Documentation/devicetree/bindings/misc/xlnx,axi-traffic-gen.txt
```
* Xilinx AXI Traffic generator IP

Required properties:
- compatible: "xlnx,axi-traffic-gen"
- interrupts: Should contain AXI Traffic Generator interrupts.
- interrupt-parent: Must be core interrupt controller.
- reg: Should contain AXI Traffic Generator registers location and length.
- interrupt-names: Should contain both the intr names of device - error
		   and completion.
- xlnx,device-id: Device instance Id.

Optional properties:
- clocks: Input clock specifier. Refer to common clock bindings.

Example:
++++++++
axi_traffic_gen_1: axi-traffic-gen@76000000 {
	compatible = "xlnx,axi-traffic-gen-1.0", "xlnx,axi-traffic-gen";
	clocks = <&clkc 15>;
	interrupts = <0 2 2 2>;
	interrupt-parent = <&axi_intc_1>;
	interrupt-names = "err-out", "irq-out";
	reg = <0x76000000 0x800000>;
	xlnx,device-id = <0x0>;
} ;
```

## Documentation/devicetree/bindings/misc/xlnx,axi-traffic-gen.yaml
```yaml
# SPDX-License-Identifier: (GPL-2.0 OR BSD-2-Clause)
%YAML 1.2
---
$id: http://devicetree.org/schemas/misc/xlnx,axi-traffic-gen.yaml#
$schema: http://devicetree.org/meta-schemas/core.yaml#

title: Xilinx Axi Traffic generator Device Tree Bindings

maintainers:
  - shubhrajyoti.datta@xilinx.com

properties:
  compatible:
    enum:
      - xlnx,axi-traffic-gen
      - xlnx,axi-traffic-gen-1.0

  reg:
    maxItems: 1

  interrupts:
    items:
      - description: err-out interrupt
      - description: irq-out interrupt

  interrupt-names:
    items:
      - const: err-out
      - const: irq-out

  clocks:
    minItems: 1

  xlnx,device-id:
    description: Device instance id
    $ref: /schemas/types.yaml#/definitions/uint32

required:
  - compatible
  - reg
  - interrupts
  - interrupt-names

additionalProperties: false

examples:
  - |
    trafgen_0: trafgen@76000000 {
        compatible = "xlnx,axi-traffic-gen";
        clocks = <&clkc 15>;
        interrupts = <0 93 4 >, < 0 94 4 >;
        interrupt-parent = <&axi_intc_1>;
        interrupt-names = "err-out", "irq-out";
        reg = <0x76000000 0x800000>;
        xlnx,device-id = <0x0>;
    };
```

## Documentation/devicetree/bindings/misc/xlnx,dpu.yaml
```yaml
# SPDX-License-Identifier: (GPL-2.0 OR BSD-2-Clause)
%YAML 1.2
---
$id: http://devicetree.org/schemas/misc/xlnx,dpu.yaml#
$schema: http://devicetree.org/meta-schemas/core.yaml#

title: Xilinx Deep learning Processing Unit (DPU) Vivado Flow DT Bindings

maintainers:
  - Ye Yang <ye.yang@xilinx.com>

description: |+
    The DPUCZDX8G is the deep learning processing unit (DPU) designed to
    support the Zynq UltraScale+ MPSoC. It is a configurable computation
    engine optimized for convolutional neural networks.

    The driver supports up to 4 DPU cores with 40-bit addressing and 1
    softmax core with 32-bit addressing, depending on how the user config
    the IP in Vivado TRD Flow.

    For more details refer to PG338 "DPUCZDX8G for Zynq UltraScale+ MPSoCs"
    (https://www.xilinx.com/content/dam/xilinx/support/documentation/ip_documentation/dpu/v3_4/pg338-dpu.pdf)

properties:
  compatible:
    items:
      - const: xlnx,dpuczdx8g-3.4

  reg:
    maxItems: 1

  clocks:
    description: List of clock specifiers.
    items:
      - description: AXI Lite clock
      - description: dsp clock, used for DSP blocks in the DPUCZDX8G. The frequency is twice that of dpu clock
      - description: dpu clock, used for DPUCZDX8G general logic

  clock-names:
    items:
      - const: s_axi_aclk
      - const: dpu_2x_clk
      - const: m_axi_dpu_aclk

  interrupts:
    description: One interrupt per available DPU core(up to 4) or 1 softmax core
    minItems: 1
    maxItems: 5

  interrupt-names:
    minItems: 1
    maxItems: 5
    items:
      pattern: "^(dpu[0-3]|sfm)_interrupt$"

required:
  - compatible
  - reg
  - interrupts
  - interrupt-names

additionalProperties: false

examples:
  # Example for ZynqMP (2 DPU and 1 SOFTMAX)
  - |
    #include <dt-bindings/interrupt-controller/arm-gic.h>

    dpuczdx8g@8f000000 {
        compatible = "xlnx,dpuczdx8g-3.4";
        reg = <0x8f000000 0x1000000>;
        interrupt-parent = <&gic>;
        interrupts = <GIC_SPI 88 IRQ_TYPE_LEVEL_HIGH>,
                     <GIC_SPI 89 IRQ_TYPE_LEVEL_HIGH>,
                     <GIC_SPI 92 IRQ_TYPE_LEVEL_HIGH>;
        interrupt-names = "dpu0_interrupt", "dpu1_interrupt", "sfm_interrupt";
        clocks = <&zynqmp_clk 71>, <&misc_clk_0>, <&misc_clk_1>;
        clock-names = "s_axi_aclk", "dpu_2x_clk", "m_axi_dpu_aclk";
    };

  # Example for Microblaze (1 DPU)
  - |
    dpuczdx8g@1000000 {
        compatible = "xlnx,dpuczdx8g-3.4";
        reg = <0x01000000 0x1000000>;
        interrupt-parent = <&microblaze_0_axi_intc>;
        interrupts = <8 2>;
        interrupt-names = "dpu0_interrupt";
    };
```

## Documentation/devicetree/bindings/misc/xlnx,fclk.txt
```
* Xilinx fclk clock enable
Temporary solution for enabling the PS_PL clocks.

Required properties:
- compatible: "xlnx,fclk"

Example:
++++++++
fclk0: fclk0 {
	compatible = "xlnx,fclk";
	clocks = <&clkc 71>;
};
```

## Documentation/devicetree/bindings/misc/xlnx,fec-engine.txt
```
* Xilinx SDFEC(16nm) IP *

The Soft Decision Forward Error Correction (SDFEC) Engine is a Hard IP block
which provides high-throughput LDPC and Turbo Code implementations.
The LDPC decode & encode functionality is capable of covering a range of
customer specified Quasi-cyclic (QC) codes. The Turbo decode functionality
principally covers codes used by LTE. The FEC Engine offers significant
power and area savings versus implementations done in the FPGA fabric.

Required properties:
- compatible: Must be "xlnx,fec-engine"
- reg: Should contain Xilinx SDFEC 16nm Hardened IP block registers
  location and length.
- interrupt-parent: Must be core interrupt controller
- interrupts: should contain SDFEC interrupt number
- xlnx,sdfec-code : Should contain "ldpc" or "turbo" to describe the codes
  being used.
- xlnx,sdfec-op-mode : Should contain "encode" or "decode"

Example
---------------------------------------
	fec_engine_0: fec_engine@a0040000 {
		compatible = "xlnx,fec-engine";
		reg = <0x0 0xa0040000 0x0 0x40000>;
		interrupt-parent = <&gic>;
		interrupts = <0 89 4>;
		xlnx,sdfec-op-mode = "decode";
		xlnx,sdfec-code = "ldpc";
	};
```
