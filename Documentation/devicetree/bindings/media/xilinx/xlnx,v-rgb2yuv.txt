## Documentation/devicetree/bindings/media/xilinx/xlnx,v-rgb2yuv.txt
```
Xilinx RGB to YUV (RGB2YUV)
---------------------------

Required properties:

- compatible: Must be "xlnx,v-rgb2yuv-7.1".

- reg: Physical base address and length of the registers set for the device.

- clocks: Reference to the video core clock.

- ports: Video ports, using the DT bindings defined in ../video-interfaces.txt.
  The rgb2yuv has an input port (0) and an output port (1).

Required port properties:

- xlnx,video-format: Must be RBG for the input port (0) and YUV_444 for the
  output port (1).

- xlnx,video-width: Video width as defined in video.txt

Example:

	rgb2yuv_0: rgb2yuv@40100000 {
		compatible = "xlnx,v-rgb2yuv-7.1";
		reg = <0x40100000 0x10000>;
		clocks = <&clkc 15>;

		ports {
			#address-cells = <1>;
			#size-cells = <0>;

			port@0 {
				reg = <0>;

				xlnx,video-format = <XVIP_VF_RBG>;
				xlnx,video-width = <8>;

				rgb2yuv0_in: endpoint {
					remote-endpoint = <&gamma0_out>;
				};
			};
			port@1 {
				reg = <1>;

				xlnx,video-format = <XVIP_VF_YUV_444>;
				xlnx,video-width = <8>;

				rgb2yuv0_out: endpoint {
					remote-endpoint = <&cresample0_in>;
				};
			};
		};
	};
```

## Documentation/devicetree/bindings/media/xilinx/xlnx,v-scaler-hls-8.1.txt
```
Xilinx Scaler (SCALER)
------------------------------------

Required properties:

- compatible: Must be "xlnx,v-scaler-hls-8.1".

- reg: Physical base address and length of the registers set for the device.

- clocks: Reference to the video core clock.

- xlnx,num-hori-taps, xlnx,num-vert-taps: The number of horizontal and vertical
  taps for scaling filter(range: 6,8,10,12).

- xlnx,max-num-phases: The maximum number of phases for scaling filter
  (Only allowed is 64).

- xlnx,max-num-lines : The maxiumum number of lines for the scaler
 (For this IP the values is 2160)

- xlnx,max-pixels : The maxium number of pixes on a line
 (For this IP the value is 3840)
 
- xlnx,pix-per-clk : The pixels per clock property of the IP
 (Currently only 1 pixel per clock is supported)

- ports: Video ports, using the DT bindings defined in ../video-interfaces.txt.
  The scaler has an input port (0) and an output port (1).


Required port properties:

- xlnx,video-format: Must be one of RBG, YUV_422, YUV_422 or YUV_420 for
  both input port (0) and output port (1). The two formats must be identical.

- xlnx,video-width: Video width as defined in video.txt

Example:

	scalar_1:scalar@a0000000 {
		compatible = "xlnx,v-scaler-hls-8.1";
		reg = <0x0 0xa0000000 0x0 0x40000>;
		clocks = <&vid_stream_clk>;
		xlnx,num-hori-taps = <6>;
                xlnx,num-vert-taps = <6>;
                xlnx,max-num-phases = <64>;
                xlnx,max-lines = <2160>;
                xlnx,max-pixels = <3840>;
                xlnx,pix-per-clk = <1>;

		ports {
                        #address-cells = <1>;
                        #size-cells = <0>;

                        port@0 {
                                reg = <0>;

                                xlnx,video-format = <XVIP_VF_RBG>;
                                xlnx,video-width = <8>;

                                scalar_in: endpoint {
                                        remote-endpoint = <&csc_out>;
                                };
                        };
                        /*
                         * Do not change this 
                         * Reason being VDMA supports only YUV 422
                         */
                        port@1 {
                                reg = <1>;

                                xlnx,video-format = <XVIP_VF_YUV_422>;
                                xlnx,video-width = <8>;

                                scalar_out: endpoint {
                                        remote-endpoint = <&vcap_tpg_in>;
                                };
                        };
                };

	};
```

## Documentation/devicetree/bindings/media/xilinx/xlnx,v-scaler.txt
```
Xilinx Scaler (SCALER)
------------------------------------

Required properties:

- compatible: Must be "xlnx,v-scaler-8.1".

- reg: Physical base address and length of the registers set for the device.

- clocks: Reference to the video core clock.

- xlnx,num-hori-taps, xlnx,num-vert-taps: The number of horizontal and vertical
  taps for scaling filter(range: 2 - 12).

- xlnx,max-num-phases: The maximum number of phases for scaling filter
  (range: 2 - 64).

- ports: Video ports, using the DT bindings defined in ../video-interfaces.txt.
  The scaler has an input port (0) and an output port (1).

Optional properties:

- xlnx,separate-yc-coef: When set, this boolean property specifies that
  the hardware uses separate coefficients for the luma and chroma filters.
  Otherwise a single set of coefficients is shared for both.

- xlnx,separate-hv-coef: When set, this boolean property specifies that
  the hardware uses separate coefficients for the horizontal and vertical
  filters. Otherwise a single set of coefficients is shared for both.

Required port properties:

- xlnx,video-format: Must be one of RBG, YUV_422, YUV_422 or YUV_420 for
  both input port (0) and output port (1). The two formats must be identical.

- xlnx,video-width: Video width as defined in video.txt

Example:

	scaler_0: scaler@43c30000 {
		compatible = "xlnx,v-scaler-8.1";
		reg = <0x43c30000 0x10000>;
		clocks = <&clkc 15>;

		xlnx,num-hori-taps = <12>;
		xlnx,num-vert-taps = <12>;
		xlnx,max-num-phases = <4>;
		xlnx,separate-hv-coef;

		ports {
			#address-cells = <1>;
			#size-cells = <0>;

			port@0 {
				reg = <0>;

				xlnx,video-format = <XVIP_VF_YUV_422>;
				xlnx,video-width = <8>;

				scaler0_in: endpoint {
					remote-endpoint = <&cresample0_out>;
				};
			};
			port@1 {
				reg = <1>;

				xlnx,video-format = <XVIP_VF_YUV_422>;
				xlnx,video-width = <8>;

				scaler0_out: endpoint {
					remote-endpoint = <&vcap0_in>;
				};
			};
		};
	};
```

## Documentation/devicetree/bindings/media/xilinx/xlnx,v-scd.txt
```
Xilinx Scene Change Detection IP (SCD)
--------------------------------------

The Xilinx Scene Change Detection IP contains two blocks: one IP block is used
for reading video frame data from memory to the device and the other IP block
is used for determining whether there is a scene change between current and the
previous frame. The IP supports YUV planar and semi-planar formats. IP only
needs luma frame to determine the scene change event. The IP supports memory
based model, which means that it will accept a dma buffer address and perform
MEM2DEV transfer followed by statistical based image processing and give the
data back to application if scene change detection is present or not.

Required properties:

- compatible: Should be "xlnx,v-scd"

- reg: Physical base address and length of the registers set for the device

- clocks: Reference to the video core clock.

- reset-gpios: Specifier for a GPIO that assert SCD (AP_RST_N) reset.

- xlnx,numstreams: Maximum active streams IP can support is 8 and this is based
  on the design.

- xlnx,addrwidth: Size of dma address pointer in IP (either 32 or 64)

- subdev: Each channel will have its own subdev node. Each subdev will have its
  sink port.

- port: Video port, using the DT bindings defined in ../video-interfaces.txt.

Example:
The following example shows what the device tree would look like for a memory
based design where 8 streams are enabled.

	scd: scenechange@a0100000 {
		compatible = "xlnx,v-scd";
		reg = <0x0 0xa0100000 0x0 0x1fff>;
		clocks = <&misc_clk_0>;
		interrupt-parent = <&gic>;
		interrupts = <0 90 4>;
		reset-gpios = <&gpio 94 1>;

		xlnx,numstreams = <8>;
		xlnx,addrwidth = <0x20>;

		#address-cells = <1>;
		#size-cells = <0>;
		#dma-cells = <1>;

		subdev@0 {
			port@0 {
				reg = <0>;
				scd_in0: endpoint {
					remote-endpoint = <&vcap0_out0>;
				};
			};
		};
		subdev@1 {
			port@0 {
				reg = <0>;
				scd_in1: endpoint {
					remote-endpoint = <&vcap0_out1>;
				};
			};
		};
		subdev@2 {
			port@0 {
				reg = <0>;
				scd_in2: endpoint {
					remote-endpoint = <&vcap0_out2>;
				};
			};
		};
		subdev@3 {
			port@0 {
				reg = <0>;
				scd_in3: endpoint {
					remote-endpoint = <&vcap0_out3>;
				};
			};
		};
		subdev@4 {
			port@0 {
				reg = <0>;
				scd_in4: endpoint {
					remote-endpoint = <&vcap0_out4>;
				};
			};
		};
		subdev@5 {
			port@0 {
				reg = <0>;
				scd_in5: endpoint {
					remote-endpoint = <&vcap0_out5>;
				};
			};
		};
		subdev@6 {
			port@0 {
				reg = <0>;
				scd_in6: endpoint {
					remote-endpoint = <&vcap0_out6>;
				};
			};
		};
		subdev@7 {
			port@0 {
				reg = <0>;
			scd_in7: endpoint {
					remote-endpoint = <&vcap0_out7>;
				};
			};
		};
	};
```
