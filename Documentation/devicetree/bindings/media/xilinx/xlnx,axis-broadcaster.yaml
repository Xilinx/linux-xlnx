## Documentation/devicetree/bindings/media/xilinx/xlnx,v-hdmi-rx-ss.txt
```
Xilinx HDMI RX Subsystem

The Xilinx HDMI RX Subsystem contains several subcores to implement
a HDMI receiver. /hdmi/xilinx-hdmi-rx.c implements a
V4L2 video-capture sub-device for the Xilinx Video IP Pipeline device
(xilinx-vipp).

There are 2 optional HDCP cores that can be included in the IP configuration.
Below provided sample device tree depicts the configuration when both cores are 
included. If an optional core is included then corresponding entries for the 
core parameters (interrupts, key-management block address) must be included in
the device tree

Note: If HDCP cores are included in the design, the user must provide valid
	  HDCP keys for the encryption to work. 

Refer to xlnx,vphy.txt for the phy specifics.

Required Properties:
 - compatible: Should be "xlnx,v-hdmi-rx-ss-3.0".
 - reg: Base address and size of the IP core and hdcp1x key management block
 - reg-names: Identification string for included register blocks
		"hdmi-rxss": Identification string for hdmirx subsystem. Always present
		"hdcp1x-keymngmt": Identification string for Key management block for
			hdcp1x. [Optional]
 - interrupts-parent: phandle for interrupt controller.
 - interrupts: Interrupt numbers for mandatory and optional blocks
 - interrupt-names: Identification string that binds irq number to block 
		generating the interrupt
		"hdmirx": interrupt for rx subcore [always present]
		"hdcp1x": interrupt for hdcp1.4 core [optional]
		"hdcp1x-timer": interrupt for hdcp1.4 timer [present if hdcp1x is 
			included]
		"hdcp22": interrupt for hdcp22 core [optional]
		"hdcp22-timer": interrupt for hdcp2.2 timer [present if hdcp22 is
			included]
		
 - clocks: phandle for axi-lite, video stream
 - clock-names: The identification string, "axi-lite", is always required for
                the axi-lite clock, "video" is always required for video stream
				clock
   
 - phys: phandle for phy lanes registered for hdmi protocol. HDMI always 
         require 3 lanes
 - phy-names: The identification string, "hdmi-phy0" and so on
 
 - xlnx,input-pixels-per-clock: IP configuration for samples/clk (2, 4)
         Note: Only 2 is supported at this time
 - xlnx,edid-ram-size: Denotes amount of BRAM allocated for EDID in IP 
 - xlnx,include-hdcp-1-4: Boolean parameter that denotes if hdcp14 is included.
		If present indicates inclusion of the optional core
 - xlnx,include-hdcp-2-2: Boolean parameter that denotes if hdcp22 is included.
		If present indicates inclusion of the optional core
 - ports: Video ports, using the DT bindings defined in ../video-interfaces.txt.
          The Rx only has an output port (0).
 
==Example==
If hdcp1.4 is included in the design then key management block node should be
added to the device tree

	hdmi_input_hdcp_keymngmt_blk_top_1: hdcp_keymngmt_blk_top@a0270000 {
		compatible = "xlnx,hdcp-keymngmt-blk-top-1.0";
		reg = <0x0 0xa0270000 0x0 0x10000>;
	};

	hdmi_input_v_hdmi_rx_ss_0: v_hdmi_rx_ss@a0000000 {
		compatible = "xlnx,v-hdmi-rx-ss-3.0";
		reg = <0x0 0xa0000000 0x0 0x100000>, <0x0 0xa0270000 0x0 0x10000>;
		reg-names = "hdmi-rxss", "hdcp1x-keymngmt";	
		interrupt-parent = <&gic>;
		interrupts = <0 91 4>, <0 108 4>, <0 109 4>, <0 110 4>, <0 111 4>;
		interrupt-names = "hdmirx", "hdcp1x", "hdcp1x-timer", "hdcp22", "hdcp22-timer";
		clocks = <&vid_s_axi_clk>, <&vid_stream_clk>;
		clock-names = "axi-lite", "video";
		phy-names = "hdmi-phy0", "hdmi-phy1", "hdmi-phy2";
		phys = <&vphy_lane0 0 1 1 0>, <&vphy_lane1 0 1 1 0>, <&vphy_lane2 0 1 1 0>;
	
		xlnx,input-pixels-per-clock = <0x2>;
		xlnx,edid-ram-size = <0x100>;
		xlnx,include-hdcp-1-4;
		xlnx,include-hdcp-2-2;

		ports {
			#address-cells = <1>;
			#size-cells = <0>;
			port@0 {
				reg = <0>;
	
				/* HDMI RX SS -> FB-WR */
				hdmi_rxss_out: endpoint {
					remote-endpoint = <&vcap_hdmi_in>;
				};
			};
		};			
	};
```

## Documentation/devicetree/bindings/media/xilinx/xlnx,v-hls.txt
```
Xilinx High-Level Synthesis Core (HLS)
--------------------------------------

High-Level Synthesis cores are synthesized from a high-level function
description developed by the user. As such their functions vary widely, but
they all share a set of common characteristics that allow them to be described
by common bindings.


Required properties:

- compatible: This property must contain "xlnx,v-hls" to indicate that the
  core is compatible with the generic Xilinx HLS DT bindings. It can also
  contain a more specific string to identify the HLS core implementation. The
  value of those implementation-specific strings is out of scope for these DT
  bindings.

- reg: Physical base address and length of the registers sets for the device.
  The HLS core has two registers sets, the first one contains the core
  standard registers and the second one contains the custom user registers.

- clocks: Reference to the video core clock.

- ports: Video ports, using the DT bindings defined in ../video-interfaces.txt.
  The HLS core has one input port (0) and one output port (1).

Required port properties:

- xlnx,video-format: Video format as defined in video.txt.
- xlnx,video-width: Video width as defined in video.txt.

Example:

	hls_0: hls@43c00000 {
		compatible = "xlnx,v-hls-sobel", "xlnx,v-hls";
		reg = <0x43c00000 0x24>, <0x43c00024 0xa0>;
		clocks = <&clkc 15>;

		ports {
			#address-cells = <1>;
			#size-cells = <0>;

			port@0 {
				reg = <0>;

				xlnx,video-format = <XVIP_VF_YUV_422>;
				xlnx,video-width = <8>;

				hls0_in: endpoint {
					remote-endpoint = <&vdma_out>;
				};
			};
			port@1 {
				reg = <1>;

				xlnx,video-format = <XVIP_VF_YUV_422>;
				xlnx,video-width = <8>;

				hls0_out: endpoint {
					remote-endpoint = <&vdma_in>;
				};
			};
		};
	};
```

## Documentation/devicetree/bindings/media/xilinx/xlnx,v-hls.yaml
```yaml
# SPDX-License-Identifier: (GPL-2.0-only OR BSD-2-Clause)
%YAML 1.2
---
$id: http://devicetree.org/schemas/media/xilinx/xlnx,v-hls.yaml#
$schema: http://devicetree.org/meta-schemas/core.yaml#

title: Xilinx HLS core.

maintainers:
  - Kunal Rane <kunal.rane@amd.com>

description:
  Xilinx High-Level Synthesis Core (HLS) are synthesized from a high-level function
  description developed by the user. As such their functions vary widely, but
  they all share a set of common characteristics that allow them to be described
  by common bindings.

properties:
  compatible:
    const: xlnx,v-hls

  reg:
    maxItems: 1

  clocks:
    description: Reference to the video core clock.
    maxItems: 1

  ports:
    type: object

    properties:
      "#address-cells":
        const: 1

      "#size-cells":
        const: 0

    patternProperties:
      "^port@[0-1]$":
        type: object
        description: port@0 is input. port@1 is output.

        properties:
          reg:
            enum: [0, 1]

          xlnx,video-format:
            description:
              Video format details for input and output port.
              The possible values are -
              0 - RGB
              1 - YUV444
              2 - YUV422
              3 - YUV420
            $ref: /schemas/types.yaml#/definitions/uint32
            enum: [0, 1, 2, 3]

          xlnx,video-width:
            description:
              The video with to which input and output pads
              of the VPSS IP are set.
            $ref: /schemas/types.yaml#/definitions/uint32
            enum: [8, 10, 12, 16]

          endpoint:
            type: object

            properties:
              remote-endpoint: true

            required:
              - remote-endpoint

            additionalProperties: false

        required:
          - reg
          - xlnx,video-format
          - xlnx,video-width
          - endpoint

        additionalProperties: false

    required:
      - "#address-cells"
      - "#size-cells"
      - port@0
      - port@1

    additionalProperties: false

required:
  - reg
  - clocks
  - ports

additionalProperties: false

examples:
  - |
    hls@43c00000 {
        compatible = "xlnx,v-hls";
        reg = <0x43c00000 0x24>;
        clocks = <&clkc 15>;
        ports {
            #address-cells = <1>;
            #size-cells = <0>;
            port@0 {
                reg = <0>;
                xlnx,video-format = <0>;
                xlnx,video-width = <8>;
                hls0_in: endpoint {
                    remote-endpoint = <&vdma_out>;
                };
            };
            port@1 {
                reg = <1>;
                xlnx,video-format = <3>;
                xlnx,video-width = <8>;
                hls0_out: endpoint {
                    remote-endpoint = <&vdma_in>;
                };
            };
        };
    };
```

## Documentation/devicetree/bindings/media/xilinx/xlnx,v-multi-scaler.txt
```
Xilinx mem2mem Multi Video Scaler (XM2MSC)
-----------------------------------------

Required propertie(s):
- compatible		: Should be "xlnx,v-multi-scaler-v1.0"
- clocks		: Input clock specifier. Refer to common clk bindings.
- interrupt-parent	: Interrupt controller the interrupt is routed through
- interrupts		: Should contain MultiScaler interrupt
- reset-gpios		: Should contain GPIO reset phandle
- reg			: Physical base address and
			  length of the registers set for the device.
- xlnx,max-chan		: Maximum number of supported scaling channels (1 - 8)
- xlnx,max-width	: Maximum number of supported column/width (64 - 3840)
- xlnx,max-height	: Maximum number of supported row/height (64 - 2160)
- xlnx,dma-addr-width	: dma address width (either 32 or 64)
- xlnx,pixels-per-clock	: pixels per clock set in IP (1, 2 or 4)
- xlnx,vid-formats	: A list of strings indicating what video memory
			  formats the IP has been configured to support.
			  See VIDEO FORMATS table below and examples.
- xlnx,num-taps		: The number of filter taps for scaling (6, 8, 10, 12)

VIDEO FORMATS
The following table describes the legal string values to be used for
the xlnx,vid-formats property. To the left is the string value and the
column to the right describes the format.

IP FORMAT	DTS String	Description
-------------|----------------|---------------------
RGB8		bgr888		Packed RGB, 8 bits per component.
				Every RGB pixel in memory is represented with
				24 bits.
RGBX8		xbgr8888	Packed RGB, 8 bits per component. Every RGB
				pixel in memory is represented with 32 bits.
				Bits[31:24] do not contain pixel information.
BGRX8		xrgb8888	Packed BGR, 8 bits per component. Every BGR
				pixel in memory is represented with 32 bits.
				Bits[31:24] do not contain pixel information.
RGBX10		xbgr2101010	Packed RGB, 10 bits per component. Every RGB
				pixel is represented with 32 bits. Bits[31:30]
				do not contain any pixel information.
YUV8		vuy888		Packed YUV 4:4:4, 8 bits per component. Every
				YUV 4:4:4 pixel in memory is represented with
				24 bits.
YUVX8		xvuy8888	Packed YUV 4:4:4, 8 bits per component.
				Every YUV 4:4:4 pixel in memory is represented
				with 32 bits. Bits[31:24] do not contain pixel
				information.
YUYV8		yuyv		Packed YUV 4:2:2, 8 bits per component. Every
				two YUV 4:2:2 pixels in memory are represented
				with 32 bits.
UYVY8		uyvy		Packed YUV 4:2:2, 8 bits per component.
				Every two YUV 4:2:2 pixels in memory are
				represented with 32 bits.
YUVX10		yuvx2101010	Packed YUV 4:4:4, 10 bits per component.
				Every YUV 4:4:4 pixel is represented with 32 bits.
				Bits[31:30] do not contain any pixel information.
Y8		y8		Packed Luma-Only, 8 bits per component. Every
				luma-only pixel in memory is represented with
				8 bits. Y8 is presented as YUV 4:4:4 on the
				AXI4-Stream interface.
Y10		y10		Packed Luma-Only, 10 bits per component. Every
				three luma-only pixels in memory is represented
				with 32 bits. Y10 is presented as YUV 4:4:4 on
				the AXI4-Stream interface.
Y_UV8		nv16		Semi-planar YUV 4:2:2 with 8 bits per component.
				Y and UV stored in separate planes.
Y_UV8_420	nv12		Semi-planar YUV 4:2:0 with 8 bits per component.
				Y and UV stored in separate planes.
Y_UV10		xv20		Semi-planar YUV 4:2:2 with 10 bits per component.
				Every 3 pixels is represented with 32 bits.
				Bits[31:30] do not contain any pixel information.
				Y and UV stored in separate planes.
Y_UV10_420	xv15		Semi-planar YUV 4:2:0 with 10 bits per component.
				Every 3 pixels is represented with 32 bits.
				Bits[31:30] do not contain any pixel information.
				Y and UV stored in separate planes.

Example

v_multi_scaler_0: v_multi_scaler@a0000000 {\
	clocks = <&clk 71>;
	compatible = "xlnx,v-multi-scaler-v1.0";
	interrupt-names = "interrupt";
	interrupt-parent = <&gic>;
	interrupts = <0 89 4>;
	reg = <0x0 0xa0000000 0x0 0x10000>;
	xlnx,vid-formats = "bgr888","vuy888";
	reset-gpios = <&gpio 78 1>;
	xlnx,max-chan = <0x01>;
	xlnx,dma-addr-width = <0x20>;
	xlnx,pixels-per-clock = /bits/ 8 <2>;
	xlnx,max-width = <3840>;
	xlnx,max-height = <2160>;
	xlnx,num-taps = <6>;
};
```
