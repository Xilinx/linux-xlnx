## Documentation/devicetree/bindings/media/xilinx/xlnx,isppipeline.yaml
```yaml
# SPDX-License-Identifier: (GPL-2.0-only OR BSD-2-Clause)
%YAML 1.2
---
$id: http://devicetree.org/schemas/media/xilinx/xlnx,isppipeline.yaml#
$schema: http://devicetree.org/meta-schemas/core.yaml#

title: Xilinx Video ISP Pipeline IP

maintainers:
  - Kaushal Kumar <kaushal.kumar@amd.com>
  - Venkat Praveen Kancharlapalli <venkat.praveen.kancharlapalli@amd.com>
  - Mounik Katikala <mounik.katikala@amd.com>

description: |
    The Xilinx Video ISP pipeline IP is used to interface to a bayer video source.
    It is a pipeline of image processing functions, such as black level correction, bad pixel correction,
    gain control, auto-white balance, gamma correction etc., processing the raw video from the sensor.
    Gamma_lut array values are computed using compute_gamma function whose link is mentioned below:
    https://github.com/Xilinx/Vitis_Libraries/blob/de67b58ca9c7f4a76411103c0ecf9d467731b476/vision/L1/examples/isppipeline/xf_isp_tb.cpp#L313
    Link to product guide for ISP pipeline is mentioned below:
    https://docs.amd.com/r/en-US/Vitis_Libraries/vision/index.html

properties:
  compatible:
    enum:
      - xlnx,isppipeline-1.0
      - xlnx,isppipeline-2.0

  reg:
    maxItems: 1

  clocks:
    maxItems: 1
    description: Reference to the AXI Streaming clock.

  clock-names:
    items:
      - const: ap_clk

  xlnx,max-height:
    $ref: /schemas/types.yaml#/definitions/uint16
    description: Maximum number of lines.
    minimum: 64
    maximum: 4320

  xlnx,max-width:
    $ref: /schemas/types.yaml#/definitions/uint16
    description: Maximum number of pixels in a line.
    minimum: 64
    maximum: 8192

  xlnx,rgain:
    $ref: /schemas/types.yaml#/definitions/uint16
    description: To configure gain value for the red channel.
    minimum: 0
    maximum: 65535

  xlnx,bgain:
    $ref: /schemas/types.yaml#/definitions/uint16
    description: To configure gain value for the blue channel.
    minimum: 0
    maximum: 65535

  xlnx,pawb:
    $ref: /schemas/types.yaml#/definitions/uint16
    description: |
        It is used in calculating the threshold value, which is used in gray world
        white balance method to compute average pixel values below the threshold value.
    minimum: 0
    maximum: 65535

  xlnx,mode-reg:
    type: boolean
    description: Flag to enable/disable AWB algorithm

  reset-gpios:
    maxItems: 1
    description: Specifier for GPIO that asserts ISP pipeline IP. Use GPIO_ACTIVE_LOW on ap_rst_n.

  ports:
    type: object

    properties:
      "#address-cells":
        const: 1

      "#size-cells":
        const: 0

      port@0:
        type: object
        description: |
          Input/sink port node, describing module connected to the
          input of ISP pipeline IP.

        properties:
          reg:
            description: |
              Input/sink port number.
            const: 0

          endpoint:
            type: object

            properties:
              remote-endpoint: true

            required:
              - remote-endpoint

            additionalProperties: false

          xlnx,video-width:
            $ref: /schemas/types.yaml#/definitions/uint32
            description: Width of the video data in bits
            enum: [8, 10, 12, 16]
            default: 10

        required:
          - reg
          - endpoint

        additionalProperties: false

      "port@1":
        type: object
        description: |
          Output/source port node, describing module connected to the
          output.

        properties:
          reg:
            description: |
              Output/source port number.
            const: 1

          endpoint:
            type: object

            properties:
              remote-endpoint: true

            required:
              - remote-endpoint

            additionalProperties: false

          xlnx,video-width:
            $ref: /schemas/types.yaml#/definitions/uint32
            description: Width of the video data in bits
            enum: [8, 10, 12, 16]
            default: 8

        required:
          - reg
          - endpoint

        additionalProperties: false

    required:
      - "#address-cells"
      - "#size-cells"
      - port@0
      - port@1

    additionalProperties: false

required:
  - compatible
  - reg
  - clocks
  - reset-gpios
  - ports

additionalProperties: false

allOf:
  - if:
      properties:
        compatible:
          contains:
            const: xlnx,isppipeline-1.0
    then:
      required:
        - xlnx,max-height
        - xlnx,max-width
        - xlnx,rgain
        - xlnx,bgain
        - xlnx,pawb
        - xlnx,mode-reg

  - if:
      properties:
        compatible:
          contains:
            const: xlnx,isppipeline-2.0
    then:
      properties:
        ports:
          properties:
            port@0:
              required:
                - xlnx,video-width
            port@1:
              required:
                - xlnx,video-width

examples:
  - |
   ISPPipeline0: ISPPipeline@a40c0000 {
        compatible = "xlnx,isppipeline-1.0";
        reg = <0xa40c0000 0x10000>;
        clocks = <&misc_clk_0>;
        clock-names = "ap_clk";
        reset-gpios = <&gpio 87 1>;
        xlnx,max-width = /bits/ 16 <3840>;
        xlnx,max-height = /bits/ 16 <2160>;
        xlnx,rgain = /bits/ 16 <128>;
        xlnx,bgain = /bits/ 16 <210>;
        xlnx,pawb = /bits/ 16 <350>;
        xlnx,mode-reg;
        ports {
            #address-cells = <1>;
            #size-cells = <0>;

            port@0 {
                /* Sink port */
                reg = <0>;
                isppipeline0_in: endpoint {
                    remote-endpoint = <&isp_csiss_out>;
                };
            };
            port@1 {
                /* Source port */
                reg = <1>;
                isppipeline0_out: endpoint {
                    remote-endpoint = <&isp_vcap_csi_in>;
                };
            };
        };
    };

  - |
    ISPPipeline1: ISPPipeline@a40f0000 {
        compatible = "xlnx,isppipeline-2.0";
        reg = <0xa40f0000 0x10000>;
        clocks = <&misc_clk_0>;
        reset-gpios = <&gpio0 27 1>;
        ports {
            #address-cells = <1>;
            #size-cells = <0>;

            port@0 {
                /* Sink port */
                reg = <0>;
                xlnx,video-width = <10>;
                isppipeline1_in: endpoint {
                    remote-endpoint = <&isp_csiss_out>;
                };
            };

            port@1 {
                /* Source port */
                reg = <1>;
                xlnx,video-width = <8>;
                isppipeline1_out: endpoint {
                    remote-endpoint = <&isp_vcap_csi_in>;
                };
            };
        };
    };
```

## Documentation/devicetree/bindings/media/xilinx/xlnx,mem2mem.txt
```
Xilinx Video IP MEM2MEM Pipeline (XVIM2M)
----------------------------------------

Xilinx video IP mem2mem pipeline processes DMA transfers to achieve memory
copy from one physical memory to other. The data is copied by employing two
DMA transfers memory to device and device to memory transactions one after
the other. The DT node of the XVIM2M represents as a top level node of the
pipeline and defines mappings between DMAs.

Required properties:

- compatible: Must be "xlnx,mem2mem".

- dmas, dma-names: List of two DMA specifier and identifier strings (as
  defined in Documentation/devicetree/bindings/dma/dma.txt) per port.
  Identifier string of one DMA channel should be "tx" and other should be
  "rx".

Example:

	video_m2m {
		compatible = "xlnx,mem2mem";
		dmas = <&dma_1 0>, <&dma_2 0>;
		dma-names = "tx", "rx";
	};
```

## Documentation/devicetree/bindings/media/xilinx/xlnx,mem2mem.yaml
```yaml
# SPDX-License-Identifier: (GPL-2.0-only OR BSD-2-Clause)
%YAML 1.2
---
$id: http://devicetree.org/schemas/media/xilinx/xlnx,mem2mem.yaml#
$schema: http://devicetree.org/meta-schemas/core.yaml#

title: Xilinx Video IP MEM2MEM Pipeline (XVIM2M)

maintainers:
  - Vishal Sagar <vishal.sagar@amd.com>

description:
  Xilinx video IP mem2mem pipeline processes DMA transfers to achieve memory
  copy from one physical memory to other. The data is copied by employing two
  DMA transfers memory to device and device to memory transactions one after
  the other. The DT node of the XVIM2M represents as a top level node of the
  pipeline and defines mappings between DMAs.

properties:
  compatible:
    const: xlnx,mem2mem

  dmas:
    description:
      List of two DMA specifier (as defined in
      Documentation/devicetree/bindings/dma/dma-controller.yaml) per port.
    maxItems: 2

  dma-names:
    description:
      List of two Corrsponding DMA specifier's identifier strings per port.
      Identifier string of one DMA channel should be "tx" and other should be
      "rx".
    items:
      - const: tx
      - const: rx

additionalProperties: false

examples:
  - |
   video_m2m {
        compatible = "xlnx,mem2mem";
        dmas = <&dma_1 0>, <&dma_2 0>;
        dma-names = "tx", "rx";
   };
...
```

## Documentation/devicetree/bindings/media/xilinx/xlnx,preprocess.yaml
```yaml
# SPDX-License-Identifier: (GPL-2.0-only OR BSD-2-Clause)
# Copyright (C) 2026 AMD
%YAML 1.2
---
$id: http://devicetree.org/schemas/media/xilinx/xlnx,preprocess.yaml#
$schema: http://devicetree.org/meta-schemas/core.yaml#

title: Xilinx Video Preprocess IP

maintainers:
  - Mounik Katikala <mounik.katikala@amd.com>

description: |
  Xilinx Video Preprocess IP applies per-channel normalization to input
  RGB pixel data and produces output samples in INT8, BF16, FP16, or FP32
  precision. The block supports output paths with 1, 3, or 4 channels
  depending on configuration.
  Linux fixes the output channel packing count from the first
  xlnx,vid-formats entry for the lifetime of the device: V4L2 per-channel
  alpha/beta controls are sized to that count, and the source pad rejects
  set_fmt to media-bus codes with a different channel count even if a later
  DT entry would enable that format. List only formats that share the same
  channel count as the first string (or repeat the same packing with
  different precision).

properties:
  compatible:
    const: xlnx,preprocess-1.0

  reg:
    maxItems: 1

  clocks:
    description: Reference to video core clock.
    maxItems: 1

  clock-names:
    deprecated: true
    maxItems: 1

  reset-gpios:
    maxItems: 1

  xlnx,vid-formats:
    description:
      Ordered list of supported output format identifiers for this instance.
      Each entry selects output sample packing and the number of channels
      the IP produces for that format. The first entry sets the channel
      packing for V4L2.
    $ref: /schemas/types.yaml#/definitions/string-array
    minItems: 1
    maxItems: 64
    items:
      enum:
        - bgr888
        - gray32
        - gray_bf16
        - gray_fp16
        - rgb323232
        - rgb_bf161616
        - rgb_fp161616
        - rgba32323232
        - rgba8888
        - rgba_bf16161616
        - rgba_fp16161616
        - y8

  ports:
    $ref: /schemas/graph.yaml#/properties/ports

    properties:
      port@0:
        $ref: /schemas/graph.yaml#/properties/port
        description: Input/sink port node for the upstream video connection.

        unevaluatedProperties: false

      port@1:
        $ref: /schemas/graph.yaml#/properties/port
        description: Output/source port node for the downstream video connection.

        unevaluatedProperties: false

    required:
      - port@0
      - port@1

    unevaluatedProperties: false

required:
  - compatible
  - reg
  - clocks
  - reset-gpios
  - xlnx,vid-formats
  - ports

additionalProperties: false

examples:
  - |
    #include <dt-bindings/gpio/gpio.h>
    preprocess@a0000000 {
        compatible = "xlnx,preprocess-1.0";
        reg = <0xa0000000 0x1000>;
        clocks = <&misc_clk_1>;
        reset-gpios = <&gpio0 5 GPIO_ACTIVE_LOW>;
        xlnx,vid-formats = "bgr888", "rgb_bf161616", "rgb_fp161616";
        ports {
            #address-cells = <1>;
            #size-cells = <0>;

            port@0 {
                reg = <0>; /* sink */
                endpoint {
                    remote-endpoint = <&upstream_out>;
                };
            };

            port@1 {
                reg = <1>; /* source */
                endpoint {
                    remote-endpoint = <&downstream_in>;
                };
            };
        };
    };
```

## Documentation/devicetree/bindings/media/xilinx/xlnx,sdirxss.txt
```
Xilinx SDI Receiver Subsystem
------------------------------

The Xilinx SDI Rx Subsystem is used to capture SDI Video in upto 12G mode.
It outputs the video as an AXI4 Stream video data in YUV 422 10bpc mode.
The subsystem consists of the SDI Rx IP whose SDI native output is connected
to a SDI to Native conversion Bridge. The output of the Native bridge is
connected to a Native to AXI4S Bridge which generates the AXI4 Stream of
YUV422 or YUV420 10 bpc in dual pixel per clock.

Required properties:

- compatible: Must contain "xlnx,v-smpte-uhdsdi-rx-ss"

- reg: Physical base address and length of the registers set for the device.

- interrupts: Contains the interrupt line number.

- interrupt-parent: phandle to interrupt controller.

- xlnx,include-edh: Whether the EDH processor is enabled in design or not.

- xlnx,line-rate: The maximum mode supported by the design.

- clocks: Input clock specifier. Refer to common clock bindings.

- clock-names: List of input clocks.
  Required elements: "s_axi_aclk", "sdi_rx_clk", "video_out_clk"

- port: Video port, using the DT bindings defined in ../video-interfaces.txt.
  The SDI Rx subsystem has one port configured as output port.

- xlnx,video-format, xlnx,video-width: Video format and width, as defined in
  video.txt. Please note that the video format is fixed to either YUV422 or YUV420
  and the video-width is 10.

Optional properties:

- reset_gt-gpios: contains GPIO reset phandle for FMC init done pin in GT.
  This pin is active low.
- picxo_reset-gpios: contains GPIO reset phandle for PICXO done pin for PICXO module.
  This pin is active high.
- xlnx,bpp: This denotes the bit depth as 10 or 12 based on IP configuration.
  The default value is 10 for backward compatibility.

Example:
		v_smpte_uhdsdi_rx_ss: v_smpte_uhdsdi_rx_ss@80000000 {
			compatible = "xlnx,v-smpte-uhdsdi-rx-ss";
			interrupt-parent = <&gic>;
			interrupts = <0 89 4>;
			reg = <0x0 0x80000000 0x0 0x10000>;
			xlnx,include-axilite = "true";
			xlnx,include-edh = "true";
			xlnx,include-vid-over-axi = "true";
			xlnx,line-rate = "12G_SDI_8DS";
			clocks = <&clk_1>, <&si570_1>, <&clk_2>;
			clock-names = "s_axi_aclk", "sdi_rx_clk", "video_out_clk";
			reset_gt-gpios = <&axi_gpio_0 0 0 GPIO_ACTIVE_LOW>;
			picxo_reset-gpios = <&axi_gpio_0 2 0 GPIO_ACTIVE_HIGH>;

			ports {
				#address-cells = <1>;
				#size-cells = <0>;

				port@0 {
					reg = <0>;

					xlnx,video-format = <XVIP_VF_YUV_422>;
					xlnx,video-width = <10>;

					sdirx_out: endpoint {
						remote-endpoint = <&vcap_sdirx_in>;
					};
				};
			};
		};
```
