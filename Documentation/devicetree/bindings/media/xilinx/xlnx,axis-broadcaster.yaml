## Documentation/devicetree/bindings/media/xilinx/xlnx,v-demosaic-v1.0.txt
```
Xilinx HLS Video Demosaic IP
------------------------------------------------
The Xilinx HLS Video Demosaic IP is used to interface to a Bayer source.
It can convert 8-bit Bayer formats to 24 bit RGB format. Currently, the
driver supports only the following configurations :
	- 8 bit, High Quality Interpolation
	- No zipper

The driver comes in RGGB as default Sink Pad media bus format.
It can be changed through media-ctl user utility. The IP and driver
only support RGB as its Source Pad media format.

Required properties:

- compatible: Must be "xlnx,v-demosaic-v1.0".

- reg: Physical base address and length of the registers set for the device.

- clocks: Reference to the video core clock.

- reset-gpios: Specifier for a GPIO that assert Demosaic IP (AP_RST_N) reset.

- ports: Video ports, using the DT bindings defined in ../video-interfaces.txt.
  The scaler has an input port (0) and an output port (1).


Required port properties:

- reg: This value represents the media pad of the V4L2 sub-device.
  A Sink Pad is represented by reg = <0>
  A Source Pad is represented by reg = <1>

- xlnx,video-width: Video width as defined in video.txt

Example :
	demosaic_1: demosaic@0xA00B0000 {
		compatible = "xlnx,v-demosaic-v1.0";
		reg = <0x0 0xa00b0000 0x0 0x10000>;
		clocks = <&vid_stream_clk>;
		reset-gpios = <&gpio 87 1>;
		ports {
			#address-cells = <1>;
			#size-cells = <0>;

			port@0 {
				reg = <0>;
				xlnx,video-width = <8>;

				demosaic_in: endpoint {
					remote-endpoint = <&tpg_out>;
				};
			};

			port@1 {
				reg = <1>;
				xlnx,video-width = <8>;

				demosaic_out: endpoint {
					remote-endpoint = <&gamma_in>;
				};
			};
		};
	};
```

## Documentation/devicetree/bindings/media/xilinx/xlnx,v-demosaic.txt
```
Xilinx Video Demosaic IP
-----------------------------
The Xilinx Video Demosaic IP is used to interface to a Bayer video source.

The driver set default Sink Pad media bus format to RGGB.
The IP and driver only support RGB as its Source Pad media format.

Required properties:

- compatible: Must be "xlnx,v-demosaic".

- reg: Physical base address and length of the registers set for the device.

- clocks: Reference to the AXI Streaming clock feeding the Demosaic ap_clk.

- reset-gpios: Specifier for GPIO that asserts Demosaic IP (AP_RST_N) reset.

- ports: Video ports, using the DT bindings defined in ../video-interfaces.txt.

Required port properties:

- reg: This value represents the media pad of the V4L2 sub-device.
  A Sink Pad is represented by reg = <0>
  A Source Pad is represented by reg = <1>

- xlnx,video-width: Video width as defined in video.txt

Example :
	demosaic_1: demosaic@a00b0000 {
		compatible = "xlnx,v-demosaic";
		reg = <0x0 0xa00b0000 0x0 0x10000>;
		clocks = <&vid_stream_clk>;
		reset-gpios = <&gpio 87 1>;
		ports {
			#address-cells = <1>;
			#size-cells = <0>;

			port@0 {
				reg = <0>;
				xlnx,video-width = <8>;

				demosaic_in: endpoint {
					remote-endpoint = <&tpg_out>;
				};
			};

			port@1 {
				reg = <1>;
				xlnx,video-width = <8>;

				demosaic_out: endpoint {
					remote-endpoint = <&gamma_in>;
				};
			};
		};
	};
```

## Documentation/devicetree/bindings/media/xilinx/xlnx,v-demosaic.yaml
```yaml
# SPDX-License-Identifier: (GPL-2.0-only OR BSD-2-Clause)
%YAML 1.2
---
$id: http://devicetree.org/schemas/media/xilinx/xlnx,v-demosaic.yaml#
$schema: http://devicetree.org/meta-schemas/core.yaml#

title: Xilinx Demosaic IP.

maintainers:
  - Kunal Rane <kunal.rane@amd.com>

description:
  The Xilinx Video Demosaic IP is used to interface to a Bayer video source.
  The driver set default Sink Pad media bus format to RGB.
  The IP and driver only support RGB as its Source Pad media format.

properties:
  compatible:
    const: xlnx,v-demosaic-1.1

  reg:
    maxItems: 1

  clocks:
    description: Reference to video core clock.
    maxItems: 1

  clock-names:
    deprecated: true
    maxItems: 1

  xlnx,max-height:
    description: Maximum number of lines.
    $ref: /schemas/types.yaml#/definitions/uint32
    minimum: 64
    maximum: 4320

  xlnx,max-width:
    description: Maximum number of pixels in a line.
    $ref: /schemas/types.yaml#/definitions/uint32
    minimum: 64
    maximum: 8192

  reset-gpios:
    description: Should contain GPIO reset phandle
    maxItems: 1

  ports:
    type: object

    properties:
      "#address-cells":
        const: 1

      "#size-cells":
        const: 0

    patternProperties:
      "^port@[0-1]$":
        type: object
        description: port@0 is input. port@1 is output.

        properties:
          reg:
            enum: [0, 1]

          endpoint:
            type: object

            properties:
              remote-endpoint: true

            required:
              - remote-endpoint

            additionalProperties: false

        required:
          - reg
          - endpoint

        additionalProperties: false

    required:
      - "#address-cells"
      - "#size-cells"
      - port@0
      - port@1

    additionalProperties: false

required:
  - reg
  - clocks
  - clock-names
  - xlnx,max-height
  - xlnx,max-width
  - reset-gpios
  - ports

additionalProperties: false

examples:
  - |
    v_demosaic@a0010000 {
        compatible = "xlnx,v-demosaic-1.1";
        reg = <0xa0010000 0x10000>;
        clock-names = "ap_clk";
        clocks = <&misc_clk_2>;
        reset-gpios = <&gpio 0 1>;
        xlnx,max-height = <2160>;
        xlnx,max-width = <3840>;
        ports {
            #address-cells = <1>;
            #size-cells = <0>;
            port@0 {
                /* For cfa-pattern=rggb user needs to fill as per BAYER format */
                reg = <0>;
                demo_in: endpoint {
                    remote-endpoint = <&mipi_csirx_outcsirx_0>;
                };
            };
            port@1 {
                /* For cfa-pattern=rggb user needs to fill as per BAYER format */
                reg = <1>;
                demo_out: endpoint {
                    remote-endpoint = <&psng0_vg0psng0_dm0>;
                };
            };
        };
    };
```

## Documentation/devicetree/bindings/media/xilinx/xlnx,v-gamma-lut-v1.0.txt
```
Xilinx Video Gamma Correction IP
------------------------------------------------
The Xilinx Video Gamma Correction IP is used to provide RGB gamma correction.
The IP provides a look up table for each R,G and B components.

It takes an a 24bit RBG streaming input and provides a gamma corrected 24 bit RGB format.
Currently, the driver supports only the following configurations :
	- 8 bit (bits per pixel)

All other configurations are not supported.

The V4L2 subdevice driver exposes a control interface through which you can specify
gamma values for R,G and B components individually.

Example :
A value of  1 represents a gamma of 0.1
A value of 10 represents a gamma of 1.0 (default)
A value of 40 represents a gamma of 4.0 (maximum)

Note : A gamma of value 1.0 is a linear curve or pass through design, with
no corrective action.

Required properties:

- compatible: Must be "xlnx,v-gamma-lut-v1.0".

- reg: Physical base address and length of the registers set for the device.

- clocks: Reference to the video core clock.

- reset-gpios: Specifier for a GPIO that assert gamma IP (AP_RST_N) reset.

- ports: Video ports, using the DT bindings defined in ../video-interfaces.txt.
  The scaler has an input port (0) and an output port (1).


Required port properties:
- reg: This value represents the media pad of the V4L2 sub-device.
  A Sink Pad is represented by reg = <0>
  A Source Pad is represented by reg = <1>

- xlnx,video-width: Video width as defined in video.txt


Example :

	gamma_lut_1: gamma_lut_1@0xa0080000 {
		compatible = "xlnx,v-gamma-lut-v1.0";
		reg = <0x0 0xa0080000 0x0 0x10000>;
		clocks = <&vid_stream_clk>;
		reset-gpios = <&gpio 83 1>;
		ports {
			#address-cells = <1>;
			#size-cells = <0>;

			port@0 {
				reg = <0>;
				xlnx,video-width = <8>;

				gamma_in: endpoint {
					remote-endpoint = <&demosaic_out>;
				};
			};

			port@1 {
				reg = <1>;
				xlnx,video-width = <8>;

				gamma_out: endpoint {
					remote-endpoint = <&csc_in>;
				};
			};
		};
	};
```

## Documentation/devicetree/bindings/media/xilinx/xlnx,v-gamma-lut.txt
```
Xilinx Video Gamma Correction IP
-----------------------------------
The Xilinx Video Gamma Correction IP is used to provide RGB gamma correction.
The IP provides a look up table for each R,G and B components.

Required properties:

- compatible: Must be "xlnx,v-gamma-lut".

- reg: Physical base address and length of the registers set for the device.

- clocks: Reference to the clock that drives the ap_clk
	  signal of Video Gamma Lookup.

- reset-gpios: Specifier for a GPIO that asserts Gamma IP (AP_RST_N) reset

- ports: Video ports, using the DT bindings defined in ../video-interfaces.txt.
  The Gamma LUT IP has an input port (0) and an output port (1).


Required port properties:
- reg: This value represents the media pad of the V4L2 sub-device.
  A Sink Pad is represented by reg = <0>
  A Source Pad is represented by reg = <1>

- xlnx,video-width: Video width as defined in video.txt. Can be either 8 or 10.

Example :

	gamma_lut_1: gamma_lut_1@0xa0080000 {
		compatible = "xlnx,v-gamma-lut";
		reg = <0x0 0xa0080000 0x0 0x10000>;
		clocks = <&vid_stream_clk>;
		reset-gpios = <&gpio 83 1>;
		ports {
			#address-cells = <1>;
			#size-cells = <0>;

			port@0 {
				reg = <0>;
				xlnx,video-width = <8>;

				gamma_in: endpoint {
					remote-endpoint = <&demosaic_out>;
				};
			};

			port@1 {
				reg = <1>;
				xlnx,video-width = <8>;

				gamma_out: endpoint {
					remote-endpoint = <&csc_in>;
				};
			};
		};
	};
```

## Documentation/devicetree/bindings/media/xilinx/xlnx,v-gamma-lut.yaml
```yaml
# SPDX-License-Identifier: (GPL-2.0-only OR BSD-2-Clause)
%YAML 1.2
---
$id: http://devicetree.org/schemas/media/xilinx/xlnx,v-gamma-lut.yaml#
$schema: http://devicetree.org/meta-schemas/core.yaml#

title: Xilinx Gamma LUT IP.

maintainers:
  - Kunal Rane <kunal.rane@amd.com>

description:
  The Xilinx Gamma LUT IP is used to provide RGB Gamma correction.
  The IP provides a look up table for each R,G and B components.

properties:
  compatible:
    const: xlnx,v-gamma-lut

  reg:
    maxItems: 1

  clocks:
    description: Reference to video core clock.
    maxItems: 1

  clock-names:
    deprecated: true
    maxItems: 1

  xlnx,max-height:
    description: Maximum number of lines.
    $ref: /schemas/types.yaml#/definitions/uint32
    minimum: 64
    maximum: 4320

  xlnx,max-width:
    description: Maximum number of pixels in a line.
    $ref: /schemas/types.yaml#/definitions/uint32
    minimum: 64
    maximum: 8192

  reset-gpios:
    description: Should contain GPIO reset phandle
    maxItems: 1

  ports:
    type: object

    properties:
      "#address-cells":
        const: 1

      "#size-cells":
        const: 0

    patternProperties:
      "^port@[0-1]$":
        description: port@0 is input. port@1 is output.
        type: object

        properties:
          reg:
            enum: [0, 1]

          xlnx,video-width:
            description: Number of bits per color.
            $ref: /schemas/types.yaml#/definitions/uint32
            enum: [8, 16]

          endpoint:
            type: object

            properties:
              remote-endpoint: true

            required:
              - remote-endpoint

            additionalProperties: false

        required:
          - reg
          - xlnx,video-width
          - endpoint

        additionalProperties: false

    required:
      - "#address-cells"
      - "#size-cells"
      - port@0
      - port@1

    additionalProperties: false

required:
  - reg
  - clocks
  - xlnx,max-height
  - xlnx,max-width
  - reset-gpios
  - ports

additionalProperties: false

examples:
  - |
    gamma_lut_1@a0080000 {
        compatible = "xlnx,v-gamma-lut";
        reg = <0xa0080000 0x10000>;
        clocks = <&vid_stream_clk>;
        reset-gpios = <&gpio 83 1>;
        xlnx,max-height = <2160>;
        xlnx,max-width = <3840>;
        ports {
            #address-cells = <1>;
            #size-cells = <0>;
            port@0 {
                reg = <0>;
                xlnx,video-width = <8>;
                gamma_in: endpoint {
                    remote-endpoint = <&demosaic_out>;
                };
            };
            port@1 {
                reg = <1>;
                xlnx,video-width = <8>;
                gamma_out: endpoint {
                    remote-endpoint = <&csc_in>;
                };
            };
        };
    };
```
