## Documentation/devicetree/bindings/media/xilinx/xlnx,sdirxss.yaml
```yaml
# SPDX-License-Identifier: (GPL-2.0-only OR BSD-2-Clause)
# %YAML 1.2
---
$id: http://devicetree.org/schemas/media/xilinx/xlnx,sdirxss.yaml#
$schema: http://devicetree.org/meta-schemas/core.yaml#

title: Xilinx SDI Receiver Subsystem

maintainers:
  - katta Dhanunjanrao <katta.dhanunjanrao@amd.com>

description:
  The Xilinx SDI Rx Subsystem is used to capture SDI Video in upto 12G mode.
  It outputs the video as an AXI4 Stream video data in YUV 422 10bpc mode.
  The subsystem consists of the SDI Rx IP whose SDI native output is connected
  to a SDI to Native conversion Bridge. The output of the Native bridge is
  connected to a Native to AXI4S Bridge which generates the AXI4 Stream of
  YUV422 or YUV420 10 bpc in dual pixel per clock.

properties:
  compatible:
    const: xlnx,v-smpte-uhdsdi-rx-ss

  reg:
    maxItems: 1

  interrupts:
    maxItems: 1

  clocks:
    description: Input clock specifier. Refer to common clock bindings.
    items:
      - description: AXI4-Lite clock.
      - description: SMPTE UHD SDI Rx core clock.
      - description: Video output clock.

  clock-names:
    items:
      - const: s_axi_aclk
      - const: sdi_rx_clk
      - const: video_out_clk

  picxo-reset-gpios:
    description: It contains the GPIO reset phandle for PICXO done pin for PICXO module.
                 This GPIO pin is active high.

  reset-gt-gpios:
    description: It contains the GPIO reset phandle for FMC init done pin in GT.
                 This GPIO pin is active low.

  xlnx,bpp:
    description: This denotes the bit depth as 10 or 12 based on IP configuration.
                 The default value is 10 for backward compatibility.
    $ref: /schemas/types.yaml#/definitions/uint32
    enum: [10, 12]

  xlnx,include-edh:
    description: Whether the EDH processor is enabled or not in the design.
    type: boolean

  xlnx,line-rate:
    description: The maximum mode supported by the design.
    $ref: /schemas/types.yaml#/definitions/string

  xlnx,video-format:
    description: The video format is fixed to either YUV422 or YUV420.
                 Here, 0 is for YUV422 and 1 for YUV420

  xlnx,video-width:
    description: The video width supported value is 10.

  ports:
    type: object

    properties:
      "#address-cells":
        const: 1

      "#size-cells":
        const: 0

      port@0:
        type: object
        description: Output / source port node, endpoint describing modules
                     connected to the SDI receiver.
        properties:
          reg:
            const: 0
          xlnx,video-format:
            description: Video format identifier.
          xlnx,video-width:
            description: Width of the video stream.

          endpoint:
            type: object

            properties:
              remote-endpoint: true

            required:
              - remote-endpoint

            additionalProperties: false

        additionalProperties: false

    additionalProperties: false

required:
  - reg
  - clocks
  - clock-names
  - interrupts
  - xlnx,bpp
  - xlnx,include-edh
  - xlnx,line-rate
  - ports

additionalProperties: false

examples:
  - |
    v-smpte-uhdsdi-rx-ss@80000000 {
        compatible = "xlnx,v-smpte-uhdsdi-rx-ss";
        reg = <0x80000000 0x10000>;
        clocks = <&clk_1>, <&si570_1>, <&clk_2>;
        clock-names = "s_axi_aclk", "sdi_rx_clk", "video_out_clk";
        interrupts = <0 89 4>;
        xlnx,bpp = <10>;
        xlnx,include-edh;
        xlnx,line-rate = "12G_SDI_8DS";
        ports {
            #address-cells = <1>;
            #size-cells = <0>;

            port@0 {
                reg = <0>;
                xlnx,video-format = <0>;
                xlnx,video-width = <10>;

                endpoint {
                    remote-endpoint = <&vcap_sdirx_in>;
                };
            };
        };
    };
...
```

## Documentation/devicetree/bindings/media/xilinx/xlnx,v-axi4s-switch.txt
```
Xilinx AXI4-Stream Switch
-------------------------------

The AXI4-Stream Switch provides configurable routing between masters and slaves.
It supports up to 16 masters/sources and 16 slaves/sinks and two routing options.
There is atleast one slave/sink port and two master/source ports.

The two routing options available are TDEST routing and control register routing.
The TDEST based routing uses design parameters and hence there no software control.
Each port is mapped as a pad and has its own format specified.

Control register routing introduces an AXI4-Lite interface to configure the
routing table. There is one register for each of the master interfaces to
control each of the selectors. This routing mode requires that there is
precisely only one path between master and slave. When attempting to map the
same slave interface to multiple master interfaces, only the lowest master
interface is able to access the slave interface.
Here only the slave/sink ports have formats as master/source ports will inherit
the corresponding slave ports formats. A routing table is maintained in this case.

Please refer to PG085 AXI4-Stream Infrastructure IP Suite v2.2 for more details.

Required properties:

 - compatible: Must be "xlnx,axis-switch-1.1".
 - xlnx,routing-mode: Can be 0 (TDEST routing) or 1 (Control reg routing)
 - xlnx,num-si-slots: Number of slave / input ports. Min 1 Max 16 .
 - xlnx,num-mi-slots: Number of master / output ports. Min 1 Max 16.
 - ports: Video ports, using the DT bindings defined in ../video-interfaces.txt.
 - clocks: Reference to the AXI Streaming clock feeding the ACLK and
   AXI4 Lite control interface clock when control routing is enabled.
 - clock-names: Must have "aclk".

Optional properties:
 - reg: Physical base address and length of the registers set for the device.
	This is required only if xlnx,routing-mode is 1.
 - clocks: Reference to AXI4 Lite control interface clock when routing-mode is 1.
 - clock-names: "s_axi_ctl_clk" clock for AXI4 Lite interface when routing-mode is 1.

Example:

For TDEST routing, from 1 slave port to 4 master ports

	axis_switch_0: axis_switch@0 {
		compatible = "xlnx,axis-switch-1.1";
		xlnx,routing-mode = <0x0>;
		xlnx,num-si-slots = <0x1>;
		xlnx,num-mi-slots = <0x4>;
		clocks = <&vid_stream_clk>;
		clock-names = "aclk";

		ports {
			#address-cells = <1>;
			#size-cells = <0>;
			port@0 {
				reg = <0>;
				switch_in0: endpoint {
					remote-endpoint = <&csirxss_out>;
				};
			};
			port@1 {
				reg = <1>;
				switch_out0: endpoint {
					remote-endpoint = <&vcap_csirxss0_in>;
				};
			};
			port@2 {
				reg = <2>;
				switch_out1: endpoint {
					remote-endpoint = <&vcap_csirxss1_in>;
				};
			};
			port@3 {
				reg = <3>;
				switch_out2: endpoint {
					remote-endpoint = <&vcap_csirxss2_in>;
				};
			};
			port@4 {
				reg = <4>;
				switch_out3: endpoint {
					remote-endpoint = <&vcap_csirxss3_in>;
				};
			};
		};

	};

For Control reg based routing, from 2 slave ports to 4 master ports

	axis_switch_0: axis_switch@a0050000 {
		compatible = "xlnx,axis-switch-1.1";
		reg = <0x0 0xa0050000 0x0 0x1000>;
		xlnx,routing-mode = <0x1>;
		xlnx,num-si-slots = <0x2>;
		xlnx,num-mi-slots = <0x4>;
		clocks = <&vid_stream_clk>, <&misc_clk_0>;
		clock-names = "aclk", "s_axi_ctl_clk;

		ports {
			#address-cells = <1>;
			#size-cells = <0>;
			port@0 {
				reg = <0>;
				switch_in0: endpoint {
					remote-endpoint = <&csirxss_out>;
				};
			};
			port@1 {
				reg = <1>;
				switch_in1: endpoint {
					remote-endpoint = <&tpg_out>;
				};
			};
			port@2 {
				reg = <2>;
				switch_out0: endpoint {
					remote-endpoint = <&vcap_csirxss0_in>;
				};
			};
			port@3 {
				reg = <3>;
				switch_out1: endpoint {
					remote-endpoint = <&vcap_csirxss1_in>;
				};
			};
			port@4 {
				reg = <4>;
				switch_out2: endpoint {
					remote-endpoint = <&vcap_csirxss2_in>;
				};
			};
			port@5 {
				reg = <5>;
				switch_out3: endpoint {
					remote-endpoint = <&vcap_csirxss3_in>;
				};
			};
		};

	};
```

## Documentation/devicetree/bindings/media/xilinx/xlnx,v-axi4s-switch.yaml
```yaml
# SPDX-License-Identifier: (GPL-2.0-only OR BSD-2-Clause)
%YAML 1.2
---
$id: http://devicetree.org/schemas/media/xilinx/xlnx,v-axi4s-switch.yaml#
$schema: http://devicetree.org/meta-schemas/core.yaml#

title: Xilinx AXI4S Switch IP.

maintainers:
  - Kunal Rane <kunal.rane@amd.com>

description:
  The AXI4-Stream Switch provides configurable routing between masters and slaves.
  It supports up to 16 masters/sources and 16 slaves/sinks and two routing options.
  There is at least one slave/sink port and two master/source ports.
  The two routing options available are TDEST routing and control register routing.
  The TDEST based routing uses design parameters and hence there no software control.
  Each port is mapped as a pad and has its own format specified.
  Control register routing introduces an AXI4-Lite interface to configure the
  routing table. There is one register for each of the master interfaces to
  control each of the selectors. This routing mode requires that there is
  precisely only one path between master and slave. When attempting to map the
  same slave interface to multiple master interfaces, only the lowest master
  interface is able to access the slave interface.
  Here only the slave/sink ports have formats as master/source ports will inherit
  the corresponding slave ports formats. A routing table is maintained in this case.
  Please refer to PG085 AXI4-Stream Infrastructure IP Suite v2.2 for more details.

properties:
  compatible:
    const: xlnx,v-axis-switch-1.1

  reg:
    maxItems: 1

  clocks:
    description: Reference to video core clock.
    maxItems: 1

  clock-names:
    deprecated: true
    maxItems: 1

  xlnx,num-mi-slots:
    description: Number of master/ output ports.
    $ref: /schemas/types.yaml#/definitions/uint32
    minimum: 1
    maximum: 16

  xlnx,num-si-slots:
    description: Number of slave/ Input ports.
    $ref: /schemas/types.yaml#/definitions/uint32
    minimum: 1
    maximum: 16

  xlnx,routing-mode:
    description: Can be 0 (TDEST routing) or 1 (Control reg routing)
    type: boolean

  ports:
    type: object

    properties:
      "#address-cells":
        const: 1

      "#size-cells":
        const: 0

      port@0:
        type: object
        description: Sink port.

        properties:
          reg:
            description: Input/sink port number.
            const: 0

          endpoint:
            type: object

            properties:
              remote-endpoint: true

            required:
              - remote-endpoint

            additionalProperties: false

        required:
          - reg
          - endpoint

        additionalProperties: false

    patternProperties:
      "^port@([1-9]|1[0-6])$":
        type: object
        description:
          Output/source port node, describing module connected to the
          output of AXI4-Stream Broadcaster.

        properties:
          reg:
            description:
              Output/source port number. It can have min 2 ports and
              max 16 ports, numbered from 1 to 16.
            items:
              minimum: 1
              maximum: 16

          endpoint:
            type: object

            properties:
              remote-endpoint: true

            required:
              - remote-endpoint

            additionalProperties: false

        required:
          - reg
          - endpoint

        additionalProperties: false

    required:
      - "#address-cells"
      - "#size-cells"
      - port@0
      - port@1
      - port@2

    additionalProperties: false

required:
  - reg
  - clocks
  - xlnx,num-mi-slots
  - xlnx,num-si-slots
  - xlnx,routing-mode
  - ports

additionalProperties: false

examples:
  - |
    axis_switch@0 {
        compatible = "xlnx,v-axis-switch-1.1";
        reg = <0xa0050000 0x1000>;
        clocks = <&vid_stream_clk>;
        xlnx,num-mi-slots = <2>;
        xlnx,num-si-slots = <1>;
        xlnx,routing-mode;
        ports {
            #address-cells = <1>;
            #size-cells = <0>;
            port@0 {
                reg = <0>;
                switch_in0: endpoint {
                    remote-endpoint = <&csirxss_out>;
                };
            };
            port@1 {
                reg = <1>;
                switch_out0: endpoint {
                    remote-endpoint = <&vcap_csirxss0_in>;
                };
            };
            port@2 {
                reg = <2>;
                switch_out1: endpoint {
                    remote-endpoint = <&vcap_csirxss1_in>;
                };
            };
        };
    };
```

## Documentation/devicetree/bindings/media/xilinx/xlnx,v-cfa.txt
```
Xilinx Color Filter Array (CFA)
-------------------------------

Required properties:

- compatible: Must be "xlnx,v-cfa-7.0".

- reg: Physical base address and length of the registers set for the device.

- clocks: Reference to the video core clock.

- ports: Video ports, using the DT bindings defined in ../video-interfaces.txt.
  The cfa has an input port (0) and an output port (1).

Required port properties:

- xlnx,video-format: Must be SENSOR_MONO for the input port (0), and RBG for
  the output port (1).

- xlnx,video-width: Video width as defined in video.txt

- xlnx, cfa-pattern: Must be one of "rggb", "grbg", "gbrg", and "bggr" for the
  input port (0). Must not be specified for the output port (1).

Example:

	cfa_0: cfa@400b0000 {
		compatible = "xlnx,v-cfa-7.0";
		reg = <0x400b0000 0x10000>;
		clocks = <&clkc 15>;

		ports {
			#address-cells = <1>;
			#size-cells = <0>;

			port@0 {
				reg = <0>;

				xlnx,video-format = <XVIP_VF_SENSOR_MONO>;
				xlnx,video-width = <8>;
				xlnx,cfa-pattern = "rggb";

				cfa0_in: endpoint {
					remote-endpoint = <&spc0_out>;
				};
			};
			port@1 {
				reg = <1>;

				xlnx,video-format = <XVIP_VF_RBG>;
				xlnx,video-width = <8>;

				cfa0_out: endpoint {
					remote-endpoint = <&ccm0_in>;
				};
			};
		};
	};
```

## Documentation/devicetree/bindings/media/xilinx/xlnx,v-cresample.txt
```
Xilinx Chroma Resampler (CRESAMPLE)
-----------------------------------

Required properties:

- compatible: Must be "xlnx,v-cresample-4.0".

- reg: Physical base address and length of the registers set for the device.

- clocks: Reference to the video core clock.

- ports: Video ports, using the DT bindings defined in ../video-interfaces.txt.
  The cresample as han input port (0) and an output port (1).

Required port properties:

- xlnx,video-format: Must be one of YUV_444, YUV_422 or YUV_420 for the input
  port (0), and one of YUV_422 or YUV_420 for the output port (1).

- xlnx,video-width: Video width as defined in video.txt

Example:

	cresample_0: cresample@40120000 {
		compatible = "xlnx,v-cresample-4.0";
		reg = <0x40120000 0x10000>;
		clocks = <&clkc 15>;

		ports {
			#address-cells = <1>;
			#size-cells = <0>;

			port@0 {
				reg = <0>;

				xlnx,input-video-format = <XVIP_VF_YUV_444>;
				xlnx,video-width = <8>;

				cresample0_in: endpoint {
					remote-endpoint = <&rgb2yuv0_out>;
				};
			};
			port@1 {
				reg = <1>;

				xlnx,output-video-format = <XVIP_VF_YUV_422>;
				xlnx,video-width = <8>;

				cresample0_out: endpoint {
					remote-endpoint = <&scaler0_in>;
				};
			};
		};
	};
```
