## Documentation/devicetree/bindings/media/xilinx/xlnx,v-multi-scaler.yaml
```yaml
# SPDX-License-Identifier: (GPL-2.0-only OR BSD-2-Clause)
%YAML 1.2
---
$id: http://devicetree.org/schemas/media/xilinx/xlnx,v-multi-scaler.yaml#
$schema: http://devicetree.org/meta-schemas/core.yaml#

title: Xilinx Multiscaler IP.

maintainers:
  - Kunal Rane <kunal.rane@amd.com>

description:
  The Xilinx mem2mem multi video scaler IP used to scale multiple videos at the same time.

properties:
  compatible:
    enum:
      - xlnx,v-multi-scaler-v1.0
      - xlnx,v-multi-scaler-v1.2

  reg:
    maxItems: 1

  clocks:
    description: Reference to video core clock.
    maxItems: 1

  interrupts:
    maxItems: 1

  reset-gpios:
    description: Should contain GPIO reset phandle
    maxItems: 1

  xlnx,dma-addr-width:
    description: Size of dma address pointer in IP
    $ref: /schemas/types.yaml#/definitions/uint32
    enum: [32, 64]

  xlnx,max-chan:
    description: Maximum number of supported scaling channels (1 - 8)
    $ref: /schemas/types.yaml#/definitions/uint32
    minimum: 1
    maximum: 8

  xlnx,max-height:
    description: Maximum number of lines.
    $ref: /schemas/types.yaml#/definitions/uint32
    minimum: 64
    maximum: 4320

  xlnx,max-width:
    description: Maximum number of pixels in a line.
    $ref: /schemas/types.yaml#/definitions/uint32
    minimum: 64
    maximum: 8192

  xlnx,num-taps:
    description: number of taps used by scaler algorithm
    $ref: /schemas/types.yaml#/definitions/uint32
    enum: [6, 8, 10, 12]

  xlnx,pixels-per-clock:
    description: Pixels per clock.
    $ref: /schemas/types.yaml#/definitions/uint32
    enum: [1, 2, 4, 8]

  xlnx,vid-formats:
    description: |
      The following table describes the legal string values to be used.
      To the left is the string value and the column to the
      right describes the format.

      IP FORMAT       DTS String     Details
      RGB8              bgr888       Packed RGB, 8 bits per component.
                                     Every RGB pixel in memory is represented with
                                     24 bits.
      RGBX8             xbgr8888     Packed RGB, 8 bits per component. Every RGB
                                     pixel in memory is represented with 32 bits.
                                     Bits[31:24] do not contain pixel information.
      BGRX8             xrgb8888     Packed BGR, 8 bits per component. Every BGR
                                     pixel in memory is represented with 32 bits.
                                     Bits[31:24] do not contain pixel information.
      RGBX10            xbgr2101010  Packed RGB, 10 bits per component. Every RGB
                                     pixel is represented with 32 bits. Bits[31:30]
                                     do not contain any pixel information.
      YUV8              vuy888       Packed YUV 4:4:4, 8 bits per component. Every
                                     YUV 4:4:4 pixel in memory is represented with
                                     24 bits.
      YUVX8             xvuy8888     Packed YUV 4:4:4, 8 bits per component.
                                     Every YUV 4:4:4 pixel in memory is represented
                                     with 32 bits. Bits[31:24] do not contain pixel
                                     information.
      YUYV8             yuyv         Packed YUV 4:2:2, 8 bits per component. Every
                                     two YUV 4:2:2 pixels in memory are represented
                                     with 32 bits.
      UYVY8             uyvy         Packed YUV 4:2:2, 8 bits per component.
                                     Every two YUV 4:2:2 pixels in memory are
                                     represented with 32 bits.
      YUVX10            yuvx2101010  Packed YUV 4:4:4, 10 bits per component.
                                     Every YUV 4:4:4 pixel is represented with 32 bits.
                                     Bits[31:30] do not contain any pixel information.
      Y8                y8           Packed Luma-Only, 8 bits per component. Every
                                     luma-only pixel in memory is represented with
                                     8 bits. Y8 is presented as YUV 4:4:4 on the
                                     AXI4-Stream interface.
      Y10               y10          Packed Luma-Only, 10 bits per component. Every
                                     three luma-only pixels in memory is represented
                                     with 32 bits. Y10 is presented as YUV 4:4:4 on
                                     the AXI4-Stream interface.
      Y_UV8             nv16         Semi-planar YUV 4:2:2 with 8 bits per component.
                                     Y and UV stored in separate planes.
      Y_UV8_420         nv12         Semi-planar YUV 4:2:0 with 8 bits per component.
                                     Y and UV stored in separate planes.
      Y_UV10            xv20         Semi-planar YUV 4:2:2 with 10 bits per component.
                                     Every 3 pixels is represented with 32 bits.
                                     Bits[31:30] do not contain any pixel information.
                                     Y and UV stored in separate planes.
      Y_UV10_420        xv15         Semi-planar YUV 4:2:0 with 10 bits per component.
                                     Every 3 pixels is represented with 32 bits.
                                     Bits[31:30] do not contain any pixel information.
                                     Y and UV stored in separate planes.
    $ref: /schemas/types.yaml#/definitions/non-unique-string-array
    uniqueItems: true

required:
  - reg
  - clocks
  - interrupts
  - reset-gpios
  - xlnx,dma-addr-width
  - xlnx,max-chan
  - xlnx,max-height
  - xlnx,max-width
  - xlnx,num-taps
  - xlnx,pixels-per-clock
  - xlnx,vid-formats

additionalProperties: false

examples:
  - |
    v_multi_scaler@a0000000 {
        compatible = "xlnx,v-multi-scaler-v1.0";
        reg = <0xa0000000 0x10000>;
        clocks = <&clk 71>;
        interrupts = <0 89 4>;
        reset-gpios = <&gpio 78 1>;
        xlnx,dma-addr-width = <32>;
        xlnx,max-chan = <1>;
        xlnx,max-height = <2160>;
        xlnx,max-width = <3840>;
        xlnx,num-taps = <6>;
        xlnx,pixels-per-clock = <2>;
        xlnx,vid-formats = "bgr888","vuy888";
    };
```

## Documentation/devicetree/bindings/media/xilinx/xlnx,v-remapper.txt
```
Xilinx Video Remapper
---------------------

The IP core remaps input pixel components to produce an output pixel with
less, more or the same number of components as the input pixel.

Required properties:

- compatible: Must be "xlnx,v-remapper".

- clocks: Reference to the video core clock.

- xlnx,video-width: Video pixel component width, as defined in video.txt.

- #xlnx,s-components: Number of components per pixel at the input port
  (between 1 and 4 inclusive).

- #xlnx,m-components: Number of components per pixel at the output port
  (between 1 and 4 inclusive).

- xlnx,component-maps: Remapping configuration represented as an array of
  integers. The array contains one entry per output component, in the low to
  high order. Each entry corresponds to the zero-based position of the
  corresponding input component, or the value 4 to drive a constant value on
  the output component. For example, to remap RGB to BGR use <2 1 0>, and to
  remap RBG to xRGB use <1 0 2 4>.

- ports: Video ports, using the DT bindings defined in ../video-interfaces.txt.
  The remapper as an input port (0) and and output port (1).

Example: RBG to xRGB remapper

	remapper_0: remapper {
		compatible = "xlnx,v-remapper";

		clocks = <&clkc 15>;

		xlnx,video-width = <8>;

		#xlnx,s-components = <3>;
		#xlnx,m-components = <4>;
		xlnx,component-maps = <1 0 2 4>;

		ports {
			#address-cells = <1>;
			#size-cells = <0>;

			port@0 {
				reg = <0>;
				remap0_in: endpoint {
					remote-endpoint = <&tpg0_out>;
				};
			};
			port@1 {
				reg = <1>;
				remap0_out: endpoint {
					remote-endpoint = <&sobel0_in>;
				};
			};
		};
	};
```
