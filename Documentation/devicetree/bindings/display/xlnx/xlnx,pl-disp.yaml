## Documentation/devicetree/bindings/dma/xilinx/ps-pcie-dma.txt
```
* Xilinx PS PCIe Root DMA

Required properties:
- compatible: Should be "xlnx,ps_pcie_dma-1.00.a"
- reg: Register offset for Root DMA channels
- reg-names: Name for the register. Should be "ps_pcie_regbase"
- interrupts: Interrupt pin for Root DMA
- interrupt-names: Name for the interrupt. Should be "ps_pcie_rootdma_intr"
- interrupt-parent: Should be gic in case of zynqmp
- rootdma: Indicates this platform device is root dma.
	This is required as the same platform driver will be invoked by pcie end points too
- dma_vendorid: 16 bit PCIe device vendor id.
	This can be later used by dma client for matching while using dma_request_channel
- dma_deviceid: 16 bit PCIe device id
	This can be later used by dma client for matching while using dma_request_channel
- numchannels: Indicates number of channels to be enabled for the device.
	Valid values are from 1 to 4 for zynqmp
- ps_pcie_channel : One for each channel to be enabled.
	This array contains channel specific properties.
	Index 0: Direction of channel
		Direction of channel can be either PCIe Memory to AXI memory i.e., Host to Card or
		AXI Memory to PCIe memory i.e., Card to Host
		PCIe to AXI Channel Direction is represented as 0x1
		AXI to PCIe Channel Direction is represented as 0x0
	Index 1: Number of Buffer Descriptors
		This number describes number of buffer descriptors to be allocated for a channel
	Index 2: Number of Queues
		Each Channel has four DMA Buffer Descriptor Queues.
		By default All four Queues will be managed by Root DMA driver.
		User may choose to have only two queues either Source and it's Status Queue or
			Destination and it's Status Queue to be handled by Driver.
		The other two queues need to be handled by user logic which will not be part of this driver.
		All Queues on Host is represented by 0x4
		Two Queues on Host is represented by 0x2
	Index 3: Coalesce Count
		This number indicates the number of transfers after which interrupt needs to
		be raised for the particular channel. The allowed range is from 0 to 255
	Index 4: Coalesce Count Timer frequency
		This property is used to control the frequency of poll timer. Poll timer is
		created for a channel whenever coalesce count value (>= 1) is programmed for the particular
		channel. This timer is helpful in draining out completed transactions even though interrupt is
		not generated.

Client Usage:
	DMA clients can request for these channels using dma_request_channel API


Xilinx PS PCIe Root DMA node Example
++++++++++++++++++++++++++++++++++++

	pci_rootdma: rootdma@fd0f0000 {
		compatible = "xlnx,ps_pcie_dma-1.00.a";
		reg = <0x0 0xfd0f0000 0x0 0x1000>;
		reg-names = "ps_pcie_regbase";
		interrupts = <0 117 4>;
		interrupt-names = "ps_pcie_rootdma_intr";
		interrupt-parent = <&gic>;
		rootdma;
		dma_vendorid = /bits/ 16 <0x10EE>;
		dma_deviceid = /bits/ 16 <0xD021>;
		numchannels = <0x4>;
		#size-cells = <0x5>;
		ps_pcie_channel0 = <0x1 0x7CF 0x4 0x0 0x3E8>;
		ps_pcie_channel1 = <0x0 0x7CF 0x4 0x0 0x3E8>;
		ps_pcie_channel2 = <0x1 0x7CF 0x4 0x0 0x3E8>;
		ps_pcie_channel3 = <0x0 0x7CF 0x4 0x0 0x3E8>;
    };
```

## Documentation/devicetree/bindings/dma/xilinx/vdmatest.txt
```
* Xilinx Video DMA Test client

Required properties:
- compatible: Should be "xlnx,axi-vdma-test"
- dmas: a list of <[Video DMA device phandle] [Channel ID]> pairs,
	where Channel ID is '0' for write/tx and '1' for read/rx
	channel.
- dma-names: a list of DMA channel names, one per "dmas" entry
- xlnx,num-fstores: Should be the number of framebuffers as configured in
	VDMA device node.

Example:
++++++++

vdmatest_0: vdmatest@0 {
	compatible ="xlnx,axi-vdma-test";
	dmas = <&axi_vdma_0 0
		&axi_vdma_0 1>;
	dma-names = "vdma0", "vdma1";
	xlnx,num-fstores = <0x8>;
} ;


Xilinx Video DMA Device Node Example
++++++++++++++++++++++++++++++++++++
axi_vdma_0: axivdma@44A40000 {
	compatible = "xlnx,axi-vdma";
	...
	dma-channel@44A40000 {
		...
		xlnx,num-fstores = <0x8>;
		...
	} ;
	dma-channel@44A40030 {
		...
		xlnx,num-fstores = <0x8>;
		...
	} ;
} ;
```

## Documentation/devicetree/bindings/dma/xilinx/xilinx_cdma.txt
```
Xilinx AXI CDMA engine, it does transfers between memory-mapped source
address and a memory-mapped destination address.

Required properties:
- compatible		: Should be "xlnx,axi-cdma-1.00.a"
- #dma-cells		: Should be <1>, see "dmas" property below
- reg			: Should contain cdma registers location and length.
- dma-channel child node: Should have only one channel

Optional properties:
- xlnx,include-sg	: Tells whether configured for Scatter-mode in
			  the hardware.

Required child node properties:
- interrupts		: Should contain per channel CDMA interrupts.
- xlnx,datawidth	: Should contain the stream data width, take values
			  {32,64...1024}.

Option child node properties:
- xlnx,has-dre		: Tells whether hardware is configured for Data
			  Realignment Engine.

Example:
++++++++

axi_cdma_0: axicdma@7e200000 {
       compatible = "xlnx,axi-cdma-1.00.a";
       #dma-cells = <1>;
       reg = < 0x7e200000 0x10000 >;
       dma-channel@7e200000 {
               compatible = "xlnx,axi-cdma-channel";
               interrupts = < 0 55 4 >;
               xlnx,datawidth = <0x40>;
       } ;
} ;


* DMA client

Required properties:
- dmas		: a list of <[Central DMA device phandle] [Channel ID]> pairs,
		  where Channel ID is '0' for write/tx and '1' for read/rx
                  channel.
- dma-names	: a list of DMA channel names, one per "dmas" entry

Example:
++++++++

cdmatest_0: cdmatest@0 {
       compatible ="xlnx,axi-cdma-test-1.00.a";
       dmas = <&axi_cdma_0 0>;
       dma-names = "cdma";
} ;
```

## Documentation/devicetree/bindings/dma/xilinx/xilinx_dpdma.txt
```
Device-Tree bindings for Xilinx ZynqMP DisplayPort Subsystem

The ZynqMP DisplayPort subsystem handles DMA channel buffer management,
blending, and audio mixing. The DisplayPort subsystem receives display
and audio frames from DPDMA and transmits output to the DisplayPort IP core.

Required properties:
 - compatible: Should be "xlnx,dpdma".
 - reg: Base address and size of the IP core.
 - interrupts: Interrupt number.
 - interrupts-parent: phandle for interrupt controller.
 - clocks: phandle for AXI clock
 - clock-names: The identification string, "axi_clk", is always required.

Required child node properties:
- compatible: Should be one of "xlnx,video0", "xlnx,video1", "xlnx,video2",
  "xlnx,graphics", "xlnx,audio0", or "xlnx,audio1".

Example:

	xlnx_dpdma: axidpdma@43c10000 {
		compatible = "xlnx,dpdma";
		reg = <0x43c10000 0x1000>;
		interrupts = <0 54 4>;
		interrupt-parent = <&intc>;
		clocks = <&clkc 16>;
		clock-names = "axi_clk";
		xlnx,axi-clock-freq = <200000000>;

		dma-channels = <6>;

		#dma-cells = <1>;
		dma-video0channel@43c10000 {
			compatible = "xlnx,video0";
		};
		dma-video1channel@43c10000 {
			compatible = "xlnx,video1";
		};
		dma-video2channel@43c10000 {
			compatible = "xlnx,video2";
		};
		dma-graphicschannel@43c10000 {
			compatible = "xlnx,graphics";
		};
		dma-audio0channel@43c10000 {
			compatible = "xlnx,audio0";
		};
		dma-audio1channel@43c10000 {
			compatible = "xlnx,audio1";
		};
	};

* DMA client

Required properties:
- dmas: a list of <[DPDMA device phandle] [Channel ID]> pairs. "Channel ID"
  is defined as video0 = 0, video1 = 1, video2 = 2, graphics = 3, audio0 = 4,
  and audio1 = 5.

Example:

	xilinx_drm {
		compatible = "xlnx,drm";
		xlnx,encoder-slave = <&xlnx_dp>;
		clocks = <&si570 0>;
		xlnx,connector-type = "DisplayPort";
		xlnx,dp-sub = <&xlnx_dp_sub>;
		planes {
			xlnx,pixel-format = "rgb565";
			plane0 {
				dmas = <&xlnx_dpdma 3>;
				dma-names = "dma";
			};
			plane1 {
				dmas = <&xlnx_dpdma 0>;
				dma-names = "dma";
			};
		};
	};

	xlnx_dp_snd_pcm0: dp_snd_pcm0 {
		compatible = "xlnx,dp-snd-pcm";
		dmas = <&xlnx_dpdma 4>;
		dma-names = "tx";
	};

	xlnx_dp_snd_pcm1: dp_snd_pcm1 {
		compatible = "xlnx,dp-snd-pcm";
		dmas = <&xlnx_dpdma 5>;
		dma-names = "tx";
	};
```

## Documentation/devicetree/bindings/dma/xilinx/xilinx_frmbuf.txt
```
The Xilinx framebuffer DMA engine supports two soft IP blocks: one IP
block is used for reading video frame data from memory (FB Read) to the device
and the other IP block is used for writing video frame data from the device
to memory (FB Write).  Both the FB Read/Write IP blocks are aware of the
format of the data being written to or read from memory including RGB and
YUV in packed, planar, and semi-planar formats.  Because the FB Read/Write
is format aware, only one buffer pointer is needed by the IP blocks even
when planar or semi-planar format are used.

FB Read Required propertie(s):
- compatible		: Should be "xlnx,axi-frmbuf-rd-v2.1" or
			  "xlnx,axi-frmbuf-rd-v2.2". Older string
			  "xlnx,axi-frmbuf-rd-v2" is now deprecated.

Note: Compatible string "xlnx,axi-frmbuf-rd" and the hardware it
represented is no longer supported.

FB Write Required propertie(s):
- compatible		: Should be "xlnx,axi-frmbuf-wr-v2.1" or
			  "xlnx,axi-frmbuf-wr-v2.2". Older string
			  "xlnx,axi-frmbuf-wr-v2" is now deprecated.

Note: Compatible string "xlnx,axi-frmbuf-wr" and the hardware it
represented is no longer supported.

Required Properties Common to both FB Read and FB Write:
- #dma-cells		: should be 1
- interrupt-parent	: Interrupt controller the interrupt is routed through
- interrupts		: Should contain DMA channel interrupt
- reset-gpios		: Should contain GPIO reset phandle
- reg			: Memory map for module access
- xlnx,dma-addr-width	: Size of dma address pointer in IP (either 32 or 64)
- xlnx,vid-formats	: A list of strings indicating what video memory
			  formats the IP has been configured to support.
			  See VIDEO FORMATS table below and examples.

Required Properties Common to both FB Read and FB Write for v2.1:
- xlnx,pixels-per-clock	: Pixels per clock set in IP (1, 2, 4 or 8)
- clocks: Reference to the AXI Streaming clock feeding the AP_CLK
- clock-names: Must have "ap_clk"
- xlnx,max-height	: Maximum number of lines.
			  Valid range from 64 to 8640.
- xlnx,max-width	: Maximum number of pixels in a line.
			  Valid range from 64 to 15360.

Optional Properties Common to both FB Read and FB Write for v2.1:
- xlnx,dma-align	: DMA alignment required in bytes.
			  If absent then dma alignment is calculated as
			  pixels per clock * 8.
			  If present it should be power of 2 and at least
			  pixels per clock * 8.
			  Minimum is 8, 16, 32 when pixels-per-clock is
			  1, 2 or 4.
- xlnx,fid		: Field ID enabled for interlaced video support.
			  Can be absent for progressive video.

VIDEO FORMATS
The following table describes the legal string values to be used for
the xlnx,vid-formats property.  To the left is the string value and the
two columns to the right describe how this is mapped to an equivalent V4L2
and DRM fourcc code---respectively---by the driver.

IP FORMAT	DTS String	V4L2 Fourcc		DRM Fourcc
-------------|----------------|----------------------|---------------------
RGB8		bgr888		V4L2_PIX_FMT_RGB24	DRM_FORMAT_BGR888
BGR8		rgb888		V4L2_PIX_FMT_BGR24	DRM_FORMAT_RGB888
RGBX8		xbgr8888	V4L2_PIX_FMT_BGRX32	DRM_FORMAT_XBGR8888
RGBA8		abgr8888	<not supported>		DRM_FORMAT_ABGR8888
BGRA8		argb8888	<not supported>		DRM_FORMAT_ARGB8888
BGRX8		xrgb8888	V4L2_PIX_FMT_XBGR32	DRM_FORMAT_XRGB8888
RGBX10		xbgr2101010	V4L2_PIX_FMT_XBGR30	DRM_FORMAT_XBGR2101010
RGBX12		xbgr2121212	V4L2_PIX_FMT_XBGR40	<not supported>
RGBX16		rgb16		V4L2_PIX_FMT_BGR40	<not supported>
YUV8		vuy888		V4L2_PIX_FMT_VUY24	DRM_FORMAT_VUY888
YUVX8		xvuy8888	V4L2_PIX_FMT_XVUY32	DRM_FORMAT_XVUY8888
Y_U_V8		y_u_v8		V4L2_PIX_FMT_YUV444M	DRM_FORMAT_YUV444
YUYV8		yuyv		V4L2_PIX_FMT_YUYV	DRM_FORMAT_YUYV
UYVY8		uyvy		V4L2_PIX_FMT_UYVY	DRM_FORMAT_UYVY
YUVA8		avuy8888	<not supported>		DRM_FORMAT_AVUY
YUVX10		yuvx2101010	V4L2_PIX_FMT_XVUY10	DRM_FORMAT_XVUY2101010
Y8		y8		V4L2_PIX_FMT_GREY	DRM_FORMAT_Y8
Y10		y10		V4L2_PIX_FMT_XY10	DRM_FORMAT_Y10
Y_UV8		nv16		V4L2_PIX_FMT_NV16	DRM_FORMAT_NV16
Y_UV8		nv16		V4L2_PIX_FMT_NV16M	DRM_FORMAT_NV16
Y_UV8_420	nv12		V4L2_PIX_FMT_NV12	DRM_FORMAT_NV12
Y_UV8_420	nv12		V4L2_PIX_FMT_NV12M	DRM_FORMAT_NV12
Y_UV10		xv20		V4L2_PIX_FMT_XV20M	DRM_FORMAT_XV20
Y_UV10		xv20		V4L2_PIX_FMT_XV20	<not supported>
Y_UV10_420	xv15		V4L2_PIX_FMT_XV15M	DRM_FORMAT_XV15
Y_UV10_420	xv15		V4L2_PIX_FMT_XV20	<not supported>

Examples:

FB Read Example:
++++++++
v_frmbuf_rd_0: v_frmbuf_rd@80000000 {
	#dma-cells = <1>;
	compatible = "xlnx,axi-frmbuf-rd-v2.1";
	interrupt-parent = <&gic>;
	interrupts = <0 92 4>;
	reset-gpios = <&gpio 80 1>;
	reg = <0x0 0x80000000 0x0 0x10000>;
	xlnx,dma-addr-width = <32>;
	xlnx,vid-formats = "bgr888","xbgr8888";
	xlnx,pixels-per-clock = <1>;
	xlnx,dma-align = <8>;
	clocks = <&vid_stream_clk>;
	clock-names = "ap_clk"
};

FB Write Example:
++++++++
v_frmbuf_wr_0: v_frmbuf_wr@80000000 {
	#dma-cells = <1>;
	compatible = "xlnx,axi-frmbuf-wr-v2.1";
	interrupt-parent = <&gic>;
	interrupts = <0 92 4>;
	reset-gpios = <&gpio 80 1>;
	reg = <0x0 0x80000000 0x0 0x10000>;
	xlnx,dma-addr-width = <64>;
	xlnx,vid-formats = "bgr888","yuyv","nv16","nv12";
	xlnx,pixels-per-clock = <2>;
	xlnx,dma-align = <16>;
	clocks = <&vid_stream_clk>;
	clock-names = "ap_clk"
};
```
