## Documentation/devicetree/bindings/dma/xilinx/xlnx,axi-frmbuf.yaml
```yaml
# SPDX-License-Identifier: (GPL-2.0-only OR BSD-2-Clause)
%YAML 1.2
---
$id: http://devicetree.org/schemas/dma/xilinx/xlnx,axi-frmbuf.yaml#
$schema: http://devicetree.org/meta-schemas/core.yaml#

title: Xilinx framebuffer read and write IP

maintainers:
  - Asif Ikbal <asif.ikbal@amd.com>

description:
  The Xilinx framebuffer DMA engine supports two soft IP blocks, one IP
  block is used for reading video frame data from memory (FB Read) to the device
  and the other IP block is used for writing video frame data from the device
  to memory (FB Write). Both the FB Read/Write IP blocks are aware of the
  format of the data being written to or read from memory including RGB and
  YUV in packed, planar, and semi-planar formats.  Because the FB Read/Write
  is format aware, only one buffer pointer is needed by the IP blocks even
  when planar or semi-planar format are used.

properties:
  compatible:
    enum:
      - xlnx,axi-frmbuf-wr-v2.1
      - xlnx,axi-frmbuf-wr-v2.2
      - xlnx,v-frmbuf-wr-v3.0
      - xlnx,axi-frmbuf-rd-v2.1
      - xlnx,axi-frmbuf-rd-v2.2
      - xlnx,v-frmbuf-rd-v3.0

  reg:
    maxItems: 1

  clocks:
    description: Reference to the AXI Streaming clock.
    maxItems: 1

  clock-names:
    deprecated: true
    maxItems: 1

  interrupts:
    maxItems: 1

  reset-gpios:
    description: Should contain GPIO reset phandle
    maxItems: 1

  xlnx,dma-addr-width:
    description: Size of dma address pointer in IP (either 32 or 64)
    $ref: /schemas/types.yaml#/definitions/uint32
    enum: [ 32, 64 ]

  xlnx,en-alpha:
    type: boolean
    description:
      Indicates that the IP hardware supports per-pixel alpha blending
      video formats.

  xlnx,vid-formats:
    description: |
      A list of strings indicating what video memory formats the IP has been
      configured to support.
      The following table describes the legal string values to be used for
      the xlnx,vid-formats property.  To the left is the string value and the
      two columns to the right describe how this is mapped to an equivalent V4L2
      and DRM fourcc code respectively by the driver.
      IP FORMAT	    DTS String	     V4L2 Fourcc	    DRM Fourcc
      -------------|----------------|----------------------|-------------------
      Video Formats with per-pixel Alpha
      RGBA8		abgr8888	<not supported>		DRM_FORMAT_ABGR8888
      BGRA8		argb8888	<not supported>		DRM_FORMAT_ARGB8888
      YUVA8		avuy8888	<not supported>		DRM_FORMAT_AVUY

      8 Bit Video Formats
      RGBX8		xbgr8888	V4L2_PIX_FMT_BGRX32	DRM_FORMAT_XBGR8888
      RGB8		bgr888		V4L2_PIX_FMT_RGB24	DRM_FORMAT_BGR888
      BGRX8		xrgb8888	V4L2_PIX_FMT_XBGR32	DRM_FORMAT_XRGB8888
      BGR8		rgb888		V4L2_PIX_FMT_BGR24	DRM_FORMAT_RGB888
      YUVX8		xvuy8888	V4L2_PIX_FMT_XVUY32	DRM_FORMAT_XVUY8888
      YUV8		vuy888		V4L2_PIX_FMT_VUY24	DRM_FORMAT_VUY888
      YUYV8		yuyv		V4L2_PIX_FMT_YUYV	DRM_FORMAT_YUYV
      UYVY8		uyvy		V4L2_PIX_FMT_UYVY	DRM_FORMAT_UYVY
      Y_U_V8		y_u_v8		V4L2_PIX_FMT_YUV444P	DRM_FORMAT_YUV444
      Y_U_V8		y_u_v8		V4L2_PIX_FMT_YUV444M	DRM_FORMAT_YUV444
      Y_UV8		nv16		V4L2_PIX_FMT_NV16	DRM_FORMAT_NV16
      Y_UV8		nv16		V4L2_PIX_FMT_NV16M	DRM_FORMAT_NV16
      Y_UV8_420	        nv12		V4L2_PIX_FMT_NV12	DRM_FORMAT_NV12
      Y_UV8_420	        nv12		V4L2_PIX_FMT_NV12M	DRM_FORMAT_NV12
      Y8		y8		V4L2_PIX_FMT_GREY	DRM_FORMAT_Y8
      Y_U_V8_420	y_u_v8_420	V4L2_PIX_FMT_YUV420	DRM_FORMAT_YUV420
      Y_U_V8_420	y_u_v8_420	V4L2_PIX_FMT_YUV420M	DRM_FORMAT_YUV420

      10 Bit Video Formats
      RGBX10		xbgr2101010	V4L2_PIX_FMT_XBGR30	DRM_FORMAT_XBGR2101010
      YUVX10		yuvx2101010	V4L2_PIX_FMT_XVUY10	DRM_FORMAT_XVUY2101010
      Y_U_V10		y_u_v10		V4L2_PIX_FMT_X403	DRM_FORMAT_X403
      Y_UV10		xv20		V4L2_PIX_FMT_XV20M	DRM_FORMAT_XV20
      Y_UV10		xv20		V4L2_PIX_FMT_XV20	<not supported>
      Y_UV10_420	xv15		V4L2_PIX_FMT_XV15M	DRM_FORMAT_XV15
      Y_UV10_420	xv15		V4L2_PIX_FMT_XV15	<not supported>
      Y10		y10		V4L2_PIX_FMT_XY10	DRM_FORMAT_Y10
      Y10_L16LE		ly10	<not supported>	<not supported>
      Y_UV10_420_L16LE	l010	<not supported>	<not supported>
      Y_UV10_L16LE	l210	<not supported>	<not supported>
      Y_U_V10_L16LE	l410	<not supported>	<not supported>
      Y10_M16LE		y010	<not supported>	<not supported>
      Y_UV10_420_M16LE	p010	V4L2_PIX_FMT_P010	DRM_FORMAT_P010
      Y_UV10_M16LE	p210	<not supported>	DRM_FORMAT_P210
      Y_U_V10_M16LE	q410	<not supported>	DRM_FORMAT_Q410

      12 Bit Video Formats
      RGBX12		xbgr4121212	V4L2_PIX_FMT_XBGR40	<not supported>
      YUVX12		yuvx4121212	<not supported>		<not supported>
      Y_U_V12		y_u_v12		V4L2_PIX_FMT_X423	DRM_FORMAT_X423
      Y_UV12		x212		V4L2_PIX_FMT_X212	<not supported>
      Y_UV12		x212		V4L2_PIX_FMT_X212M	<not supported>
      Y_UV12_420	x012		V4L2_PIX_FMT_X012	<not supported>
      Y_UV12_420	x012		V4L2_PIX_FMT_X012M	<not supported>
      Y12		y12		V4L2_PIX_FMT_XY12	<not supported>
      Y12_L16LE		ly12	<not supported>	<not supported>
      Y_UV12_420_L16LE	l012	<not supported>	<not supported>
      Y_UV12_L16LE	l212	<not supported>	<not supported>
      Y_U_V12_L16LE	l412	<not supported>	<not supported>
      Y12_M16LE		y012	V4L2_PIX_FMT_Y012	<not supported>
      Y_UV12_420_M16LE	p012	V4L2_PIX_FMT_P012	DRM_FORMAT_P012
      Y_UV12_M16LE	p212	<not supported>	<not supported>
      Y_U_V12_M16LE	q412	<not supported>	<not supported>

      16 Bit Video Formats
      RGBX16		rgb16		V4L2_PIX_FMT_BGR48	<not supported>
      YUV16		yuv16		<not supported>		<not supported>
      Y_UV16		x216		V4L2_PIX_FMT_X216	<not supported>
      Y_UV16		x216		V4L2_PIX_FMT_X216M	<not supported>
      Y_UV16_420	x016		V4L2_PIX_FMT_X016	DRM_FORMAT_P016
      Y_UV16_420	x016		V4L2_PIX_FMT_X016M	DRM_FORMAT_P016
      Y16		y16		V4L2_PIX_FMT_Y16	<not supported>

      Tiled video formats use a compact naming convention:
        Byte 0: 'T' - Tiled format indicator
        Byte 1: '5' = 32-byte tile, '6' = 64-byte tile
        Byte 2: 'M' = mono (Y-only), '0' = 4:2:0, '2' = 4:2:2, '4' = 4:4:4
        Byte 3: '8' = 8-bit, 'A' = 10-bit, 'C' = 12-bit

      IP FORMAT (Tiled)  DTS String   V4L2 Fourcc            DRM Fourcc
      ------------------|------------|----------------------|-------------------
      Y8 32T		T5M8		V4L2_PIX_FMT_T5M8	DRM_FORMAT_T5M8
      Y8 64T		T6M8		V4L2_PIX_FMT_T6M8	DRM_FORMAT_T6M8
      Y10 32T		T5MA		V4L2_PIX_FMT_T5MA	DRM_FORMAT_T5MA
      Y10 64T		T6MA		V4L2_PIX_FMT_T6MA	DRM_FORMAT_T6MA
      Y12 32T		T5MC		V4L2_PIX_FMT_T5MC	DRM_FORMAT_T5MC
      Y12 64T		T6MC		V4L2_PIX_FMT_T6MC	DRM_FORMAT_T6MC
      Y_UV8_420 32T	T508		V4L2_PIX_FMT_T508	DRM_FORMAT_T508
      Y_UV8_420 64T	T608		V4L2_PIX_FMT_T608	DRM_FORMAT_T608
      Y_UV10_420 32T	T50A		V4L2_PIX_FMT_T50A	DRM_FORMAT_T50A
      Y_UV10_420 64T	T60A		V4L2_PIX_FMT_T60A	DRM_FORMAT_T60A
      Y_UV12_420 32T	T50C		V4L2_PIX_FMT_T50C	DRM_FORMAT_T50C
      Y_UV12_420 64T	T60C		V4L2_PIX_FMT_T60C	DRM_FORMAT_T60C
      Y_UV8 32T		T528		V4L2_PIX_FMT_T528	DRM_FORMAT_T528
      Y_UV8 64T		T628		V4L2_PIX_FMT_T628	DRM_FORMAT_T628
      Y_UV10 32T	T52A		V4L2_PIX_FMT_T52A	DRM_FORMAT_T52A
      Y_UV10 64T	T62A		V4L2_PIX_FMT_T62A	DRM_FORMAT_T62A
      Y_UV12 32T	T52C		V4L2_PIX_FMT_T52C	DRM_FORMAT_T52C
      Y_UV12 64T	T62C		V4L2_PIX_FMT_T62C	DRM_FORMAT_T62C
      Y_U_V8 32T	T548		V4L2_PIX_FMT_T548	DRM_FORMAT_T548
      Y_U_V8 64T	T648		V4L2_PIX_FMT_T648	DRM_FORMAT_T648
      Y_U_V10 32T	T54A		V4L2_PIX_FMT_T54A	DRM_FORMAT_T54A
      Y_U_V10 64T	T64A		V4L2_PIX_FMT_T64A	DRM_FORMAT_T64A
      Y_U_V12 32T	T54C		V4L2_PIX_FMT_T54C	DRM_FORMAT_T54C
      Y_U_V12 64T	T64C		V4L2_PIX_FMT_T64C	DRM_FORMAT_T64C
    $ref: /schemas/types.yaml#/definitions/string-array

  xlnx,pixels-per-clock:
    description: Pixels per clock set in IP
    $ref: /schemas/types.yaml#/definitions/uint32
    enum: [1, 2, 4, 8]

  xlnx,tile-formats:
    type: boolean
    description:
      The IP is configured for tiled video formats.

  xlnx,dma-align:
    description:
      DMA alignment required in bytes.
      If absent then dma alignment is calculated as
      pixels per clock * 8.
      If present it should be power of 2 and at least
      pixels per clock * 8.
      Minimum is 8, 16, 32 when pixels-per-clock is
      1, 2 or 4.
    $ref: /schemas/types.yaml#/definitions/uint32
    enum: [8, 16, 32]

  xlnx,max-height:
    description: Maximum number pixels in a line.
    $ref: /schemas/types.yaml#/definitions/uint32
    minimum: 64
    maximum: 8640

  xlnx,max-width:
    description: Maximum number pixels in a line.
    $ref: /schemas/types.yaml#/definitions/uint32
    minimum: 64
    maximum: 15360

required:
  - reg
  - clocks
  - clock-names
  - interrupts
  - reset-gpios
  - xlnx,dma-addr-width
  - xlnx,vid-formats
  - xlnx,pixels-per-clock
  - xlnx,dma-align
  - xlnx,max-height
  - xlnx,max-width

allOf:
  # xlnx,tile-formats is only valid for v3.0 compatible strings
  - if:
      properties:
        compatible:
          enum:
            - xlnx,axi-frmbuf-wr-v2.1
            - xlnx,axi-frmbuf-wr-v2.2
            - xlnx,axi-frmbuf-rd-v2.1
            - xlnx,axi-frmbuf-rd-v2.2
    then:
      properties:
        xlnx,tile-formats: false

  # When tiled mode: only tiled format strings
  - if:
      required:
        - xlnx,tile-formats
    then:
      properties:
        xlnx,en-alpha: false
        xlnx,vid-formats:
          items:
            enum:
              - T5M8
              - T6M8
              - T5MA
              - T6MA
              - T5MC
              - T6MC
              - T508
              - T608
              - T50A
              - T60A
              - T50C
              - T60C
              - T528
              - T628
              - T52A
              - T62A
              - T52C
              - T62C
              - T548
              - T648
              - T54A
              - T64A
              - T54C
              - T64C
          minItems: 1
          maxItems: 24

  # When non-tiled mode with alpha enabled: only alpha formats
  - if:
      not:
        required:
          - xlnx,tile-formats
    then:
      if:
        required:
          - xlnx,en-alpha
      then:
        properties:
          xlnx,vid-formats:
            items:
              enum:
                - abgr8888
                - argb8888
                - avuy8888
            minItems: 1
            maxItems: 3
      else:
        properties:
          xlnx,vid-formats:
            items:
              enum:
                - xbgr8888
                - bgr888
                - xrgb8888
                - rgb888
                - xvuy8888
                - vuy888
                - yuyv
                - uyvy
                - y_u_v8
                - nv16
                - nv12
                - y8
                - y_u_v8_420
                - xbgr2101010
                - yuvx2101010
                - y_u_v10
                - xv20
                - xv15
                - y10
                - xbgr4121212
                - yuvx4121212
                - y_u_v12
                - x212
                - x012
                - y12
                - rgb16
                - yuv16
                - x216
                - x016
                - y16
                - ly10
                - l010
                - l210
                - l410
                - y010
                - p010
                - p210
                - q410
                - ly12
                - l012
                - l212
                - l412
                - y012
                - p012
                - p212
                - q412
            minItems: 1
            maxItems: 46

additionalProperties: false

examples:
  - |
    v-frmbuf-rd@a0060000 {
        compatible = "xlnx,v-frmbuf-rd-v3.0";
        reg = <0xa0060000 0x10000>;
        clocks = <&misc_clk_2>;
        clock-names = "ap_clk";
        interrupts = <0 106 4>;
        reset-gpios = <&gpio 5 1>;
        xlnx,dma-addr-width = <32>;
        xlnx,vid-formats = "bgr888";
        xlnx,pixels-per-clock = <2>;
        xlnx,dma-align = <16>;
        xlnx,max-height = <2160>;
        xlnx,max-width = <3840>;
    };

    v-frmbuf-wr@a0070000 {
        compatible = "xlnx,v-frmbuf-wr-v3.0";
        reg = <0xa0070000 0x10000>;
        clocks = <&misc_clk_2>;
        clock-names = "ap_clk";
        interrupts = <0 107 4>;
        reset-gpios = <&gpio 4 1>;
        xlnx,dma-addr-width = <32>;
        xlnx,vid-formats = "bgr888";
        xlnx,pixels-per-clock = <2>;
        xlnx,dma-align = <16>;
        xlnx,max-height = <2160>;
        xlnx,max-width = <3840>;
    };
```

## Documentation/devicetree/bindings/dma/xilinx/xlnx,axi-vdma-test.yaml
```yaml
# SPDX-License-Identifier: (GPL-2.0-only OR BSD-2-Clause)
%YAML 1.2
---
$id: http://devicetree.org/schemas/dma/xilinx/xlnx,axi-vdma-test.yaml#
$schema: http://devicetree.org/meta-schemas/core.yaml#

title: Xilinx Video DMA Test client

maintainers:
  - Radhey Shyam Pandey <radhey.shyam.pandey@amd.com>
  - Harini Katakam <harini.katakam@amd.com>

properties:
  compatible:
    const: xlnx,axi-vdma-test-1.00.a

  dmas:
    description:
      A list of <[DMA device phandle] [Channel ID]> pairs,
      where Channel ID is '0' for write/tx and '1' for read/rx
      channel.
    maxItems: 2

  dma-names:
    items:
      - const: vdma0
      - const: vdma1

  xlnx,num-fstores:
    description:
      Should be the number of framebuffers as configured in
      VDMA device node.
    $ref: /schemas/types.yaml#/definitions/uint32

required:
  - compatible
  - dmas
  - dma-names
  - xlnx,num-fstores

unevaluatedProperties: false

examples:
  - |
    vdmatest_0: vdmatest {
      compatible ="xlnx,axi-vdma-test-1.00.a";
      dmas = <&axi_vdma_0 0 &axi_vdma_0 1>;
      dma-names = "vdma0", "vdma1";
      xlnx,num-fstores = <0x8>;
    };
```

## Documentation/devicetree/bindings/dma/xilinx/xlnx,zynqmp_dma.yaml
```yaml
# SPDX-License-Identifier: (GPL-2.0-only OR BSD-2-Clause)
%YAML 1.2
---
$id: http://devicetree.org/schemas/dma/xilinx/xlnx,zynqmp_dma.yaml#
$schema: http://devicetree.org/meta-schemas/core.yaml#

title: Xilinx ZynqMP DMA Controller Device Tree Bindings

description:
  Xilinx ZynqMP DMA engine, it does support memory to memory transfers,
  memory to device and device to memory transfers. It also has flow
  control and rate control support for slave/peripheral dma access.

maintainers:
  - Harini Katakam <harini.katakam@xilinx.com>
  - Shravya Kumbham <shravya.kumbham@xilinx.com>

allOf:
  - $ref: "../dma-controller.yaml#"

properties:
  "#dma-cells":
    const: 1
    description:
      The cell is the DMA channel ID.

  compatible:
    const: xlnx,zynqmp-dma-1.0

  reg:
    description: Memory map for gdma/adma module access.
    maxItems: 1

  interrupts:
    description: Should contain DMA channel interrupt.
    maxItems: 1

  clocks:
    maxItems: 2

  clock-names:
    description: The main and apb clocks
    items:
      - const: clk_main
      - const: clk_apb

  xlnx,bus-width:
    description: Axi buswidth in bits. Should contain 128 or 64.
    allOf:
      - $ref: /schemas/types.yaml#/definitions/uint32
      - enum: [64, 128]

  dma-coherent: true

  iommus:
    maxItems: 1

  power-domains:
    maxItems: 1

required:
  - "#dma-cells"
  - compatible
  - reg
  - interrupts
  - clocks
  - clock-names
  - xlnx,bus-width

additionalProperties: false

examples:
  - |
    fpd_dma_chan1: dma-controller@fd500000 {
      #dma-cells = <1>;
      compatible = "xlnx,zynqmp-dma-1.0";
      reg = <0xFD500000 0x1000>;
      interrupt-parent = <&gic>;
      interrupts = <0 117 4>;
      clocks = <&dma_clk>, <&dma_clk>;
      clock-names = "clk_main", "clk_apb";
      xlnx,bus-width = <128>;
      dma-coherent;
    };

...
```
