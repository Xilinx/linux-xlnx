## Documentation/devicetree/bindings/display/xlnx/xlnx,pl-disp.yaml
```yaml
# SPDX-License-Identifier: (GPL-2.0-only OR BSD-2-Clause)
%YAML 1.2
---
$id: http://devicetree.org/schemas/display/xlnx/xlnx,pl-disp.yaml#
$schema: http://devicetree.org/meta-schemas/core.yaml#

title: Xilinx PL Display Controller

maintainers:
  - Vishal Sagar <vishal.sagar@amd.com>

description: |
  The PL Display controller is a logical device that completes the Xilinx
  display pipeline. It is used with VDMA and Framebuffer Read IP DMA engines
  to forward video frames from memory to a downstream display interface.

  A linear pipeline with multiple blocks:
  DMA --> PL_Display --> SDI

properties:
  compatible:
    const: xlnx,pl-disp

  dmas:
    maxItems: 1

  dma-names:
    items:
      - const: dma0

  memory-region:
    description:
      Phandle to /reserved-memory node.
      If memory is reserved for special use by PL Display, this node
      can be used to refer and use from this reserved memory region.
    maxItems: 1

  xlnx,bridge:
    description:
      Phandle to a VTC instance when it is connected as a bridge.
    $ref: /schemas/types.yaml#/definitions/phandle

  xlnx,vformat:
    description: Pixel format encoded as a four-character code.
    $ref: /schemas/types.yaml#/definitions/string
    enum:
      - AB24
      - AR24
      - AVUY
      - BG24
      - GREY
      - NV12
      - NV16
      - P010
      - P012
      - P210
      - RG24
      - T508
      - T50A
      - T50C
      - T528
      - T52A
      - T52C
      - T548
      - T54A
      - T54C
      - T5M8
      - T5MA
      - T5MC
      - T608
      - T60A
      - T60C
      - T628
      - T62A
      - T62C
      - T648
      - T64A
      - T64C
      - T6M8
      - T6MA
      - T6MC
      - UYVY
      - VU24
      - X403
      - X423
      - XB24
      - XB30
      - XR24
      - XV15
      - XV20
      - XV30
      - XVUY
      - "Y10 "
      - YU24
      - YUYV

  port:
    description:
      Output port connecting the PL display to a downstream sink.
    $ref: /schemas/graph.yaml#/properties/port

required:
  - compatible
  - dmas
  - dma-names
  - xlnx,vformat
  - port

additionalProperties: false

examples:
  - |
    pl-disp {
      compatible = "xlnx,pl-disp";
      dmas = <&axi_vdma_0 0>;
      dma-names = "dma0";
      xlnx,bridge = <&v_tc_0>;
      xlnx,vformat = "YUYV";

      port {
        pl_out_0: endpoint {
          remote-endpoint = <&sdi_port>;
        };
      };
    };

  # Example using a reserved-memory region
  - |
    bus {
      #address-cells = <1>;
      #size-cells = <1>;

      reserved-memory {
        #address-cells = <1>;
        #size-cells = <1>;
        ranges;
        psmem: memory@40000000 {
          compatible = "shared-dma-pool";
          reg = <0x40000000 0x20000000>;
          reusable;
        };
      };

      pl-disp {
        compatible = "xlnx,pl-disp";
        dmas = <&v_frmbuf_rd_0 0>;
        dma-names = "dma0";
        memory-region = <&psmem>;
        xlnx,vformat = "YUYV";

        port {
          pl_out_1: endpoint {
            remote-endpoint = <&sditx_port>;
          };
        };
      };
    };

  # 64-bit Shared CMA pool of 1792 MiB using external PL DDR
  - |
    bus {
      #address-cells = <2>;
      #size-cells = <2>;

      reserved-memory {
        #address-cells = <2>;
        #size-cells = <2>;
        ranges;
        plmem: memory@50000000000 {
          compatible = "shared-dma-pool";
          reg = <0x500 0x0 0x0 0x70000000>;
          no-map;
        };
      };

      pl-disp-plmem {
        compatible = "xlnx,pl-disp";
        dmas = <&v_frmbuf_rd_0 0>;
        dma-names = "dma0";
        memory-region = <&plmem>;
        xlnx,vformat = "YUYV";

        port {
          pl_out_2: endpoint {
            remote-endpoint = <&hdmitx_port>;
          };
        };
      };
    };
```

## Documentation/devicetree/bindings/display/xlnx/xlnx,psdpdc-av-pat-gen.yaml
```yaml
# SPDX-License-Identifier: (GPL-2.0-only OR BSD-2-Clause)
%YAML 1.2
---
$id: http://devicetree.org/schemas/display/xlnx/xlnx,psdpdc-av-pat-gen.yaml#
$schema: http://devicetree.org/meta-schemas/core.yaml#

title: AMD Versal Gen2 Audio / Video Pattern Generator

maintainers:
  - Anatoliy Klymenko <anatoliy.klymenko@amd.com>

description:
  AMD Versal Gen2 Audio / Video Pattern Generator is Logicore IP designed to
  generate AXI4-Stream video and audio test signals. Test video signal can be
  encoded in RGB or YCbCr422 format with 6, 8, 10, 12, or 16 bits per color
  component. IP can generate 1, 2 or 4 pixels per clock. Multiple test patterns
  are supported. This IP can be used as a minimalistic live video / audio signal
  source test harness.

properties:
  compatible:
    const: xlnx,psdpdc-av-pat-gen-2.0

  reg:
    maxItems: 1

  clocks:
    description: List of clock specifiers
    items:
      - description: Audio clock
      - description: Audio output AXI4-Stream clock
      - description: AXI bus clock
      - description: Video output AXI4-Stream clock

  clock-names:
    items:
      - const: aud_clk
      - const: aud_out_axi4s_aclk
      - const: av_axi_aclk
      - const: vid_out_axi4s_aclk

  clk-enable-gpios:
    description: IP sub-blocks clocks control GPIO
    minItems: 2

  xlnx,bridge:
    description: phandle to VTC (video timing controller) node
    $ref: /schemas/types.yaml#/definitions/phandle

  xlnx,ppc:
    description: Output pixels per clock
    $ref: /schemas/types.yaml#/definitions/uint32
    enum: [1, 2, 4]

  xlnx,bpc:
    description: Bits per color component
    $ref: /schemas/types.yaml#/definitions/uint32
    enum: [6, 8, 10, 12, 16]

  xlnx,video-format:
    description: Pixel color format (0 = RGB, 1 = YCbCr422)
    $ref: /schemas/types.yaml#/definitions/uint32
    enum: [0, 1]

  port:
    description: Video output connection port
    $ref: /schemas/graph.yaml#/properties/port

required:
  - compatible
  - reg
  - clocks
  - clock-names
  - clk-enable-gpios
  - xlnx,bridge
  - xlnx,ppc
  - xlnx,bpc
  - xlnx,video-format
  - port

additionalProperties: false

examples:
  - |
        avpg@B0010000 {
            compatible = "xlnx,psdpdc-av-pat-gen-2.0";
            reg = <0x80030000 0x10000>;
            clocks = <&misc_clk_0>, <&misc_clk_1>, <&misc_clk_2>, <&misc_clk_3>;
            clock-names = "aud_clk", "aud_out_axi4s_aclk", "av_axi_aclk", "vid_out_axi4s_aclk";
            clk-enable-gpios = <&axi_gpio_3 0 0>, <&axi_gpio_3 1 0>;
            xlnx,bridge = <&v_tc_0>;
            xlnx,ppc = <2>;
            xlnx,bpc = <12>;
            xlnx,video-format = <0>;
            port {
                avpg_out: endpoint {
                    remote-endpoint = <&dc_live_in>;
                };
            };
        };
```

## Documentation/devicetree/bindings/display/xlnx/xlnx,sdi-tx.txt
```
Device-Tree bindings for Xilinx SDI Tx subsystem

The IP core supports transmission of video data in SDI Tx protocol

Required properties:
 - compatible: Should be "xlnx,sdi-tx".
 - interrupts: Interrupt number.
 - interrupts-parent: phandle for interrupt controller.
 - reg: Base address and size of the IP core.
 - port: Logical block can be used / connected independently with
   external device. In the display controller port nodes, topology
   for entire pipeline should be described using the DT bindings defined in
   Documentation/devicetree/bindings/graph.txt.
   Minimum one port is required. At max, 2 ports are present.
   The reg index for AXI4 stream port is 0 and for ancillary data is 1.
 - clocks: List of phandles to AXI Lite, Video and SDI Tx Clock
 - clock-names: Must contain "s_axi_aclk", "video_in_clk" and "sdi_tx_clk"
   in same order as clocks listed in clocks property.
 - phy-reset-gpio: Specifier for a gpio that asserts GT phy

Optional properties:
 - xlnx,vpss: vpss phandle
   This handle is required only when VPSS is connected to SDI as bridge.
 - xlnx,tx-insert-c-str-st352: Insert ST352 payload in Chroma stream.
 - interrupt-names: Should be "sdi_tx_irq". This is only required when
   multiple interrupts are connected in the hardware design.
 - xlnx,qpll1enabled: boolean property present when the QPLL1 drives GT clock
   absent with QPLL0 drives GT clock
- xlnx,picxo_enabled: boolean property present when PICXO is present in design

Example:

	sdi_tx_subsystem@80000000 {
		compatible = "xlnx,sdi-tx";
		reg = <0x0 0x80000000 0x0 0x10000>;
		interrupt-parent = <&gic>;
		interrupts = <0 90 4>;
		interrupt-names = "sdi_tx_irq";
		#address-cells = <1>;
		#size-cells = <0>;
		xlnx,vpss = <&v_proc_ss_0>;
		clock-names = "s_axi_aclk", "video_in_clk", "sdi_tx_clk";
		clocks = <&misc_clk_0>, <&misc_clk_1>, <&misc_clk_2>;
		phy-reset-gpio = <&axi_gpio_0 0 0 0>;
		xlnx,qpll1enabled;
		ports {
			#address-cells = <1>;
			#size-cells = <0>;
			encoder_sdi_port: port@0 {
				reg = <0>;
				sdi_encoder: endpoint {
					remote-endpoint = <&pl_disp_crtc>;
				};
			};

			sdi_audio_port: port@1 {
				reg = <1>;
				sdi_audio_sink_port: endpoint {
					remote-endpoint = <&sditx_audio_embed_src_port>;
				};
			};
		};
	};
```

## Documentation/devicetree/bindings/display/xlnx/xlnx,sdi-tx.yaml
```yaml
# SPDX-License-Identifier: (GPL-2.0-only OR BSD-2-Clause)
%YAML 1.2
---
$id: http://devicetree.org/schemas/display/xlnx/xlnx,sdi-tx.yaml#
$schema: http://devicetree.org/meta-schemas/core.yaml#

title: Xilinx SDI Transmitter Subsystem

maintainers:
  - Katta Dhanunjanrao <katta.dhanunjanrao@amd.com>

description:
  The AMD SDI Tx Subsystem conatins several subcores to implement
  a SDI Transmitter and outputs video data using SDI protocol.
  For more details refer to PG289 SMPTE UHD-SDI transmitter subsystems.

properties:
  compatible:
    const: xlnx,sdi-tx

  reg:
    maxItems: 1

  interrupts:
    maxItems: 1

  clocks:
    description: List of phandles to AXI Lite, Video and SDI Tx Clock.
    items:
      - description: AXI4-Lite CPU clock.
      - description: Video input clock.
      - description: SMPTE UHD-SDI Tx core clock.

  clock-names:
    items:
      - const: s_axi_aclk
      - const: video_in_clk
      - const: sdi_tx_clk

  phy-reset-gpios:
    description: Specifier for a GPIO that asserts GT phy.

  xlnx,picxo-enabled:
    description: This property is present when PICXO is present in design.
    type: boolean

  xlnx,qpll1-enabled:
    description: The property is present when the QPLL1 drives GT clock
                 absent with QPLL0 drives GT clock.
    type: boolean

  xlnx,tx-insert-c-str-st352:
    description: Insert ST352 payload id in chroma stream.
    type: boolean

  xlnx,vpss:
    description: This is required only when VPSS is connected to SDI as bridge.
    $ref: /schemas/types.yaml#/definitions/phandle

  ports:
    type: object
    properties:
      "#address-cells":
        const: 1

      "#size-cells":
        const: 0

    patternProperties:
      "^port@[0-1]$":
        type: object
        description: port@0 is output. port@1 is input.

        properties:
          reg:
            enum: [0, 1]

          endpoint:
            type: object

            properties:
              remote-endpoint: true

            required:
              - remote-endpoint

            additionalProperties: false

        required:
          - reg
          - endpoint

        additionalProperties: false

    required:
      - "#address-cells"
      - "#size-cells"
      - port@0
      - port@1

    additionalProperties: false

required:
  - reg
  - clocks
  - clock-names
  - interrupts
  - ports

additionalProperties: false

examples:
  - |
    sdi-tx-subsystem@80000000 {
        compatible = "xlnx,sdi-tx";
        reg = <0x80000000 0x10000>;
        clocks = <&misc_clk_0>, <&misc_clk_1>, <&misc_clk_2>;
        clock-names = "s_axi_aclk", "video_in_clk", "sdi_tx_clk";
        interrupts = <0 90 4>;
        ports {
            #address-cells = <1>;
            #size-cells = <0>;
            port@0 {
                reg = <0>;
                endpoint {
                    remote-endpoint = <&pl_disp_crtc>;
                };
            };
            port@1 {
                reg = <1>;
                endpoint {
                    remote-endpoint = <&sditx_audio_embed_src_port>;
                };
            };
        };
    };
...
```

## Documentation/devicetree/bindings/display/xlnx/xlnx,vpss-csc.txt
```
Xllinx VPSS Color Space Converter
-----------------------------------------
The Xilinx VPSS Color Space Converter is a Video IP that supports
color space conversion from RGB to YUV 444/422/420 and vice versa.

Required properties:

- compatible: Must be "xlnx,vpss-csc".

- reg: Physical base address and length of registers set for the device.

- xlnx,video-width: This property qualifies the video format with sample
  width expressed as a number of bits per pixel component. Supported video
  width values are 8/10/12/16.

-reset-gpios: GPIO specifier to assert/de-assert the reset line.

- clocks: phandle to IP clock.

- xlnx,max-width: Maximum number of pixels in a line.
  Valid range from 64 to 8192.

- xlnx,max-height: Maximum number of lines in a frame.
  Valid range from 64 to 4320.

Example:
	csc@a0040000 {
		compatible = "xlnx,vpss-csc";
		reg = <0x0 0xa0040000 0x0 0x10000>;
		reset-gpios = <&gpio 0x0 GPIO_ACTIVE_LOW>;
		xlnx,video-width = <8>;
		clocks = <&misc_clk_0>;
		xlnx,max-width = <3840>;
		xlnx,max-height = <2160>;
	}
```

## Documentation/devicetree/bindings/display/xlnx/xlnx,vpss-csc.yaml
```yaml
# SPDX-License-Identifier: (GPL-2.0-only OR BSD-2-Clause)
%YAML 1.2
---
$id: http://devicetree.org/schemas/display/xlnx/xlnx,vpss-csc.yaml#
$schema: http://devicetree.org/meta-schemas/core.yaml#

title: Xilinx VPROC_SS IP.

maintainers:
  - Kunal Rane <kunal.rane@amd.com>

description:
  The Xilinx VPSS Color Space Converter is a Video IP that supports
  color space conversion from RGB to YUV 444/422/420 and vice versa.

properties:
  compatible:
    const: xlnx,vpss-csc

  reg:
    maxItems: 1

  clocks:
    description: Reference to video core clock.
    maxItems: 1

  reset-gpios:
    description: Should contain GPIO reset phandle
    maxItems: 1

  xlnx,max-height:
    description: Maximum number of lines.
    $ref: /schemas/types.yaml#/definitions/uint32
    minimum: 64
    maximum: 4320

  xlnx,max-width:
    description: Maximum number of pixels in a line.
    $ref: /schemas/types.yaml#/definitions/uint32
    minimum: 64
    maximum: 8192

  xlnx,video-width:
    description: Video width set for the IP.
    $ref: /schemas/types.yaml#/definitions/uint32
    enum: [8, 10, 12, 16]

required:
  - reg
  - clocks
  - reset-gpios
  - xlnx,max-width
  - xlnx,max-height
  - xlnx,video-width

additionalProperties: false

examples:
  - |
    csc@a0040000 {
        compatible = "xlnx,vpss-csc";
        reg = <0xa0040000 0x10000>;
        clocks = <&misc_clk_0>;
        reset-gpios = <&gpio 0 1>;
        xlnx,max-height = <2160>;
        xlnx,max-width = <3840>;
        xlnx,video-width = <8>;
    };
```
