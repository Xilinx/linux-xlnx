## Documentation/devicetree/bindings/display/xlnx/xlnx,vpss-scaler.txt
```
Xilinx VPSS Scaler
------------------
The Xilinx VPSS Scaler is a Video IP that supports up scaling,
down scaling and no scaling functionailty. This supports custom
resolution values between 0 to 4096.

Required properties:

- compatible: Must be "xlnx,vpss-scaler".

- reg: Physical base address and length of registers set for the device.

- xlnx,num-hori-taps: The number of horizontal taps for scaling filter
  supported tap values are 2/4/6/8/10/12.

- xlnx,num-vert-taps: The number of vertical taps for scaling filter
  supported tap values are 2/4/6/8/10/12.

  A value of 2 represents bilinear filters. A value of 4 represents bicubic.
  Values 6, 8, 10, 12 represent polyphase filters.

- xlnx,pix-per-clk : The pixels per clock property of the IP.
  supported values are 1 and 2.

- reset-gpios: GPIO specifier to assert/de-assert the reset line.

Example:
	scaler@a0040000 {
		compatible = "xlnx,vpss-scaler";
		reg = <0x0 0xa0000000 0x0 0x40000>;
		reset-gpios = <&gpio 0x0 GPIO_ACTIVE_LOW>;
		xlnx,num-hori-taps = <8>;
		xlnx,num-vert-taps = <8>;
		xlnx,pix-per-clk = <2>;
	}
```

## Documentation/devicetree/bindings/display/xlnx/xlnx,vpss-scaler.yaml
```yaml
# SPDX-License-Identifier: (GPL-2.0-only OR BSD-2-Clause)
%YAML 1.2
---
$id: http://devicetree.org/schemas/display/xlnx/xlnx,vpss-scaler.yaml#
$schema: http://devicetree.org/meta-schemas/core.yaml#

title: Xilinx VPROC_SS IP.

maintainers:
  - Kunal Rane <kunal.rane@amd.com>

description:
  The Xilinx VPSS Scaler is a Video IP that supports up scaling,
  down scaling and no scaling functionailty. This supports custom
  resolution values between 0 to 4096.

properties:
  compatible:
    const: xlnx,vpss-scaler

  reg:
    maxItems: 1

  clock-names:
    items:
      - const: aclk_ctrl
      - const: aclk_axis

  clocks:
    description: List of clock specifiers.
    items:
      - description: AXI Lite CPU clock
      - description: Video clock

  reset-gpios:
    description: Should contain GPIO reset phandle
    maxItems: 1

  xlnx,num-hori-taps:
    description: The number of horizontal taps for scaling filter.
      A value of 2 represents bilinear filters.
      A value of 4 represents bicubic. Values 6, 8, 10, 12 represent
      polyphase filters.
    $ref: /schemas/types.yaml#/definitions/uint32
    enum: [2, 4, 6, 8, 10, 12]

  xlnx,num-vert-taps:
    description: The number of vertical taps for scaling filter.
      A value of 2 represents bilinear filters.
      A value of 4 represents bicubic. Values 6, 8, 10, 12 represent
      polyphase filters.
    $ref: /schemas/types.yaml#/definitions/uint32
    enum: [2, 4, 6, 8, 10, 12]

  xlnx,max-height:
    description: Maximum number of lines.
    $ref: /schemas/types.yaml#/definitions/uint32
    minimum: 64
    maximum: 4320

  xlnx,max-width:
    description: Maximum number of pixels in a line.
    $ref: /schemas/types.yaml#/definitions/uint32
    minimum: 64
    maximum: 8192

  xlnx,pix-per-clk:
    description: The pixels per clock property of the IP.
    $ref: /schemas/types.yaml#/definitions/uint32
    enum: [1, 2, 4, 8]

required:
  - reg
  - clock-names
  - clocks
  - reset-gpios
  - xlnx,num-hori-taps
  - xlnx,num-vert-taps
  - xlnx,max-height
  - xlnx,max-width
  - xlnx,pix-per-clk

additionalProperties: false

examples:
  - |
    scaler@a0040000 {
        compatible = "xlnx,vpss-scaler";
        reg = <0xa0000000 0x40000>;
        clock-names = "aclk_ctrl", "aclk_axis";
        clocks = <&misc_clk_0>, <&misc_clk_1>;
        reset-gpios = <&gpio 0 1>;
        xlnx,num-hori-taps = <8>;
        xlnx,num-vert-taps = <8>;
        xlnx,max-height = <2160>;
        xlnx,max-width = <3840>;
        xlnx,pix-per-clk = <2>;
    };
```

## Documentation/devicetree/bindings/display/xlnx/xlnx,vtc.txt
```
Device-Tree bindings for Xilinx Video Timing Controller(VTC)

Xilinx VTC is a general purpose video timing generator and detector.
The input side of this core automatically detects horizontal and
vertical synchronization, pulses, polarity, blanking timing and active pixels.
While on the output, it generates the horizontal and vertical blanking and
synchronization pulses used with a standard video system including support
for programmable pulse polarity.

The core is commonly used with Video in to AXI4-Stream core to detect the
format and timing of incoming video data or with AXI4-Stream to Video out core
to generate outgoing video timing for downstream sinks like a video monitor.

For details please refer to
https://www.xilinx.com/support/documentation/ip_documentation/v_tc/v6_1/pg016_v_tc.pdf

Required properties:
 - compatible: value should be "xlnx,bridge-v-tc-6.1"
 - reg: base address and size of the VTC IP
 - xlnx,pixels-per-clock: Pixels per clock of the stream. Can be 1, 2 or 4.
 - clocks: List of phandles for AXI Lite and Video Clock
 - clock-names: Must contain "s_axi_aclk" and "clk" in same order as clocks listed
   in clocks property.

Example:
	v_tc_0: v_tc@80030000 {
			compatible = "xlnx,bridge-v-tc-6.1";
			reg = <0x0 0x80030000 0x0 0x10000>;
			xlnx,pixels-per-clock = <2>;
			clock-names = "s_axi_aclk", "clk";
			clocks = <&misc_clk_0>, <&misc_clk_1>;
	};
```

## Documentation/devicetree/bindings/display/xlnx/xlnx,zynqmp-dpsub.txt
```
Xilinx ZynqMP DisplayPort subsystem
-----------------------------------

Required properties:

- compatible: Must be "xlnx,zynqmp-dpsub-1.7".

- reg: Physical base address and length of the registers set for the device.
- reg-names: Must be "dp", "blend", "av_buf", and "aud" to map logical register
  partitions.

- interrupts: Interrupt number.
- interrupts-parent: phandle for interrupt controller.

- clocks: phandles for axi, audio, non-live video, and live video clocks.
  axi clock is required. Audio clock is optional. If not present, audio will
  be disabled. One of non-live or live video clock should be present.
- clock-names: The identification strings are required. "aclk" for axi clock.
  "dp_aud_clk" for audio clock. "dp_vtc_pixel_clk_in" for non-live video clock.
  "dp_live_video_in_clk" for live video clock (clock from programmable logic).

- phys: phandles for phy specifier. The number of lanes is configurable
  between 1 and 2. The number of phandles should be 1 or 2.
- phy-names: The identifier strings. "dp-phy" followed by index, 0 or 1.
  For single lane, only "dp-phy0" is required. For dual lane, both "dp-phy0"
  and "dp-phy1" are required where "dp-phy0" is the primary lane.

- power-domains: phandle for the corresponding power domain

- vid-layer, gfx-layer: Required to represent available layers

Required layer properties

- dmas: phandles for DMA channels as defined in
  Documentation/devicetree/bindings/dma/dma.txt.
- dma-names: The identifier strings are required. "gfx0" for graphics layer
  dma channel. "vid" followed by index (0 - 2) for video layer dma channels.

Optional child node

- The driver populates any child device node in this node. This can be used,
  for example, to populate the sound device from the DisplayPort subsystem
  driver.

Example:
	zynqmp-display-subsystem@fd4a0000 {
		compatible = "xlnx,zynqmp-dpsub-1.7";
		reg = <0x0 0xfd4a0000 0x0 0x1000>,
		      <0x0 0xfd4aa000 0x0 0x1000>,
		      <0x0 0xfd4ab000 0x0 0x1000>,
		      <0x0 0xfd4ac000 0x0 0x1000>;
		reg-names = "dp", "blend", "av_buf", "aud";
		interrupts = <0 119 4>;
		interrupt-parent = <&gic>;

		clock-names = "dp_apb_clk", "dp_aud_clk", "dp_live_video_in_clk";
		clocks = <&dp_aclk>, <&clkc 17>, <&si570_1>;

		phys = <&lane1>, <&lane0>;
		phy-names = "dp-phy0", "dp-phy1";

		power-domains = <&pd_dp>;

		vid-layer {
			dma-names = "vid0", "vid1", "vid2";
			dmas = <&xlnx_dpdma 0>,
			       <&xlnx_dpdma 1>,
			       <&xlnx_dpdma 2>;
		};

		gfx-layer {
			dma-names = "gfx0";
			dmas = <&xlnx_dpdma 3>;
		};

		dma-names = "vid0", "vid1", "vid2", "gfx0";
		dmas = <&xlnx_dpdma 0>,
		       <&xlnx_dpdma 1>,
		       <&xlnx_dpdma 2>,
		       <&xlnx_dpdma 3>;
	};
};
```

## Documentation/devicetree/bindings/dma/xilinx/amd,mmi-dcdma-1.0.yaml
```yaml
# SPDX-License-Identifier: (GPL-2.0-only OR BSD-2-Clause)
%YAML 1.2
---
$id: http://devicetree.org/schemas/dma/xilinx/amd,mmi-dcdma-1.0.yaml#
$schema: http://devicetree.org/meta-schemas/core.yaml#

title: AMD Multimedia Integrated Display Controller DMA Engine

description:
  The AMD Multimedia Integrated Display Controller DMA engine supports memory
  to device transfers, providing 8 host to card DMA channels. First 6 channels
  are dedicated to 2 independent multi-planar video streams, 7th channel
  provides path through interface for a single audio stream, and 8th channel is
  dedicated to hardware cursor plane.

maintainers:
  - Anatoliy Klymenko <anatoliy.klymenko@amd.com>

allOf:
  - $ref: ../dma-controller.yaml#

properties:
  compatible:
    const: amd,mmi-dcdma-1.0

  "#dma-cells":
    const: 1

  reg:
    description: mmi dcdma ip register space
    maxItems: 1

  interrupts:
    description: DMA engine interrupt
    maxItems: 1

  clocks:
    description: AXI clocks
    maxItems: 1

required:
  - "#dma-cells"
  - reg
  - interrupts
  - clocks

additionalProperties: false

examples:
  - |
    dma-controller@edd10000 {
      compatible = "amd,mmi-dcdma-1.0";
      #dma-cells = <1>;
      reg = <0xedd10000 0x1000>;
      interrupts = <0 179 4>;
      clocks = <&axi_clk>;
    };
```

## Documentation/devicetree/bindings/dma/xilinx/axi-cdma.txt
```
* Xilinx AXI CDMA Test client

Required properties:
- compatible: Should be "xlnx,axi-cdma-test-1.00.a"
- dmas: a list of <[CDMA device phandle] [Channel ID]> pairs,
	where Channel ID is '0' for write/tx and '1' for read/rx
	channel.
- dma-names: a list of CDMA channel names, one per "dmas" entry

Example:
++++++++

cdmatest_0: cdmatest@0 {
       compatible ="xlnx,axi-cdma-test-1.00.a";
       dmas = <&axi_cdma_0 0>;
       dma-names = "cdma";
} ;

Xilinx AXI CDMA Device Node Example
++++++++++++++++++++++++++++++++++++

axi_cdma_0: axicdma@7e200000 {
       compatible = "xlnx,axi-cdma-1.00.a";
       #dma-cells = <1>;
       reg = < 0x7e200000 0x10000 >;
       dma-channel@7e200000 {
               compatible = "xlnx,axi-cdma-channel";
               interrupts = < 0 55 4 >;
               xlnx,datawidth = <0x40>;
       } ;
} ;
```

## Documentation/devicetree/bindings/dma/xilinx/axi-dma.txt
```
* Xilinx AXI DMA Test client

Required properties:
- compatible: Should be "xlnx,axi-dma-test-1.00.a"
- dmas: a list of <[DMA device phandle] [Channel ID]> pairs,
	where Channel ID is '0' for write/tx and '1' for read/rx
	channel.
- dma-names: a list of DMA channel names, one per "dmas" entry

Example:
++++++++

dmatest_0: dmatest@0 {
	compatible ="xlnx,axi-dma-test-1.00.a";
	dmas = <&axi_dma_0 0
		&axi_dma_0 1>;
	dma-names = "axidma0", "axidma1";
} ;
```

## Documentation/devicetree/bindings/dma/xilinx/axi-vdma.txt
```
Xilinx AXI VDMA engine, it does transfers between memory and video devices.
It can be configured to have one channel or two channels. If configured
as two channels, one is to transmit to the video device and another is
to receive from the video device.

Required properties:
- compatible: Should be "xlnx,axi-vdma"
- #dma-cells: Should be <1>, see "dmas" property below
- reg: Should contain VDMA registers location and length.
- interrupts: Should contain per channel VDMA interrupts.
- compatible (child node): It should be either "xlnx,axi-vdma-mm2s-channel" or
	"xlnx,axi-vdma-s2mm-channel". It depends on the hardware design and it
	can also have both channels.
- xlnx,device-id: Should contain device number in each channel. It should be
	{0,1,2...so on} to the number of VDMA devices configured in hardware.
- xlnx,num-fstores: Should be the number of framebuffers as configured in h/w.
- xlnx,data-width: Should contain the stream data width, takes {32,64...so on}.
- xlnx,flush-fsync: (Optional) Tells whether which channel to Flush on Fsync.
	It takes following values:
	{1}, flush both channels
	{2}, flush mm2s channel
	{3}, flush s2mm channel
- xlnx,include-sg: (Optional) Tells whether configured for Scatter-mode in
	the hardware.
- xlnx,include-dre: (Optional) Tells whether hardware is configured for Data
	Realignment Engine.
- xlnx,genlock-mode: (Optional) Tells whether Genlock synchornisation is
	enabled/disabled in hardware.

Example:
++++++++

axi_vdma_0: axivdma@40030000 {
	compatible = "xlnx,axi-vdma";
	#dma_cells = <1>;
	reg = < 0x40030000 0x10000 >;
	xlnx,flush-fsync = <0x1>;
	dma-channel@40030000 {
		compatible = "xlnx,axi-vdma-mm2s-channel";
		interrupts = < 0 54 4 >;
		xlnx,num-fstores = <0x8>;
		xlnx,device-id = <0x0>;
		xlnx,datawidth = <0x40>;
	} ;
	dma-channel@40030030 {
		compatible = "xlnx,axi-vdma-s2mm-channel";
		interrupts = < 0 53 4 >;
		xlnx,num-fstores = <0x8>;
		xlnx,device-id = <0x0>;
		xlnx,datawidth = <0x40>;
	} ;
} ;


* Xilinx Video DMA client

Required properties:
- dmas: a list of <[Video DMA device phandle] [Channel ID]> pairs,
	where Channel ID is '0' for write/tx and '1' for read/rx
	channel.
- dma-names: a list of DMA channel names, one per "dmas" entry

VDMA Test Client Example:
+++++++++++++++++++++++++

vdmatest_0: vdmatest@0 {
	compatible ="xlnx,axi-vdma-test";
	dmas = <&axi_vdma_0 0
		&axi_vdma_0 1>;
	dma-names = "vdma0", "vdma1";
} ;
```
