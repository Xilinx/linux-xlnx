## Documentation/devicetree/bindings/mailbox/xlnx,zynqmp-ipi-mailbox.txt
```
Xilinx IPI Mailbox Controller
========================================

The Xilinx IPI(Inter Processor Interrupt) mailbox controller is to manage
messaging between two Xilinx Zynq UltraScale+ MPSoC IPI agents. Each IPI
agent owns registers used for notification and buffers for message.

               +-------------------------------------+
               | Xilinx ZynqMP IPI Controller        |
               +-------------------------------------+
    +--------------------------------------------------+
ATF                    |                     |
                       |                     |
                       |                     |
    +--------------------------+             |
                       |                     |
                       |                     |
    +--------------------------------------------------+
            +------------------------------------------+
            |  +----------------+   +----------------+ |
Hardware    |  |  IPI Agent     |   |  IPI Buffers   | |
            |  |  Registers     |   |                | |
            |  |                |   |                | |
            |  +----------------+   +----------------+ |
            |                                          |
            | Xilinx IPI Agent Block                   |
            +------------------------------------------+


Controller Device Node:
===========================
Required properties:
--------------------
- compatible:		Shall be: "xlnx,zynqmp-ipi-mailbox"
- reg:			IPI buffers address ranges
- reg-names:		Names of the reg resources. It should have:
			* local_request_region
			  - IPI request msg buffer written by local and read
			    by remote
			* local_response_region
			  - IPI response msg buffer written by local and read
			    by remote
			* remote_request_region
			  - IPI request msg buffer written by remote and read
			    by local
			* remote_response_region
			  - IPI response msg buffer written by remote and read
			    by local
- #mbox-cells:		Shall be 1. It contains:
			* tx(0) or rx(1) channel
- xlnx,ipi-ids:		Xilinx IPI agent IDs of the two peers of the
			Xilinx IPI communication channel.
- interrupt-parent:	Phandle for the interrupt controller
- interrupts:		Interrupt information corresponding to the
			interrupt-names property.

Optional properties:
--------------------
- method:              The method of accessing the IPI agent registers.
                       Permitted values are: "smc" and "hvc". Default is
                       "smc".

Example:
===========================
	/* APU<->RPU0 IPI mailbox controller */
	ipi_mailbox_rpu0: mailbox@ff90400 {
		compatible = "xlnx,zynqmp-ipi-mailbox";
		reg = <0x0 0xff990400 0x0 0x20>,
		      <0x0 0xff990420 0x0 0x20>,
		      <0x0 0xff990080 0x0 0x20>,
		      <0x0 0xff9900a0 0x0 0x20>;
		reg-names = "local_request_region", "local_response_region",
			    "remote_request_region", "remote_response_region";
		#mbox-cells = <1>;
		xlnx,ipi-ids = <0 1>;
		interrupt-parent = <&gic>;
		interrupts = <0 35 4>;
	};
	/* APU<->RPU1 IPI mailbox controller */
	ipi_mailbox_rpu1: mailbox@ff990440 {
		compatible = "xlnx,zynqmp-ipi-mailbox";
		reg = <0x0 0xff990440 0x0 0x20>,
		      <0x0 0xff990460 0x0 0x20>,
		      <0x0 0xff990280 0x0 0x20>,
		      <0x0 0xff9902a0 0x0 0x20>;
		reg-names = "local_request_region", "local_response_region",
			    "remote_request_region", "remote_response_region";
		#mbox-cells = <1>;
		xlnx,ipi-ids = <0 2>;
		interrupt-parent = <&gic>;
		interrupts = <0 35 4>;
	};
	rpu0 {
		...
		mboxes = <&ipi_mailbox_rpu0 0>,
			 <&ipi_mailbox_rpu0 1>;
		mbox-names = "tx", "rx";
	};
	rpu1 {
		...
		mboxes = <&ipi_mailbox_rpu1 0>,
			 <&ipi_mailbox_rpu1 1>;
		mbox-names = "tx", "rx";
	};
```

## Documentation/devicetree/bindings/mailbox/xlnx,zynqmp-ipi-mailbox.yaml
```yaml
# SPDX-License-Identifier: (GPL-2.0-only OR BSD-2-Clause)
%YAML 1.2
---
$id: "http://devicetree.org/schemas/mailbox/xlnx,zynqmp-ipi-mailbox.yaml#"
$schema: "http://devicetree.org/meta-schemas/core.yaml#"

title: Xilinx IPI(Inter Processor Interrupt) mailbox controller

description: |
  The Xilinx IPI(Inter Processor Interrupt) mailbox controller is to manage
  messaging between two Xilinx Zynq UltraScale+ MPSoC IPI agents. Each IPI
  agent owns registers used for notification and buffers for message.

               +-------------------------------------+
               | Xilinx ZynqMP IPI Controller        |
               +-------------------------------------+
    +--------------------------------------------------+
  ATF                    |                     |
                         |                     |
                         |                     |
      +--------------------------+             |
                         |                     |
                         |                     |
       +--------------------------------------------------+
              +------------------------------------------+
              |  +----------------+   +----------------+ |
  Hardware    |  |  IPI Agent     |   |  IPI Buffers   | |
              |  |  Registers     |   |                | |
              |  |                |   |                | |
              |  +----------------+   +----------------+ |
              |                                          |
              | Xilinx IPI Agent Block                   |
              +------------------------------------------+

maintainers:
  - Shubhrajyoti Datta <shubhrajyoti.datta@xilinx.com>

properties:
  compatible:
    const: xlnx,zynqmp-ipi-mailbox

  method:
    description: |
                 The method of calling the PM-API firmware layer.
                 Permitted values are.
                 - "smc" : SMC #0, following the SMCCC
                 - "hvc" : HVC #0, following the SMCCC
                 Default is smc.

  '#address-cells':
    const: 2

  '#size-cells':
    const: 2

  xlnx,ipi-id:
    allOf:
      - $ref: /schemas/types.yaml#/definitions/uint32
    description:
      Remote Xilinx IPI agent ID of which the mailbox is connected to.

  interrupts:
    maxItems: 1

  child-node:
    description: Internal ipi mailbox node
    type: object  # DT nodes are json objects
    properties:
      xlnx,ipi-id:
        allOf:
          - $ref: /schemas/types.yaml#/definitions/uint32
        description:
          Remote Xilinx IPI agent ID of which the mailbox is connected to.

      "#mbox-cells":
        const: 1
        description:
          It contains  tx(0) or rx(1) channel IPI id number.

      reg:
        maxItems: 4

      reg-names:
        items:
          - const: local_request_region
          - const: local_response_region
          - const: remote_request_region
          - const: remote_response_region

required:
  - compatible
  - interrupts
  - '#address-cells'
  - '#size-cells'

additionalProperties: true

examples:
  - |
    zynqmp_ipi {
      compatible = "xlnx,zynqmp-ipi-mailbox";
      interrupts = <0 29 4>;
      xlnx,ipi-id = <0>;
      #address-cells = <2>;
      #size-cells = <2>;

      ipi_mailbox_rpu0: mailbox@ff9905c0 {
        reg = <0x0 0xff9905c0 0x0 0x20>,
              <0x0 0xff9905e0 0x0 0x20>,
              <0x0 0xff990e80 0x0 0x20>,
              <0x0 0xff990ea0 0x0 0x20>;
        reg-names = "local_request_region",
              "local_response_region",
              "remote_request_region",
              "remote_response_region";
        #mbox-cells = <1>;
        xlnx,ipi-id = <4>;
      };
    };

    rpu0 {
      mboxes = <&ipi_mailbox_rpu0 0>,
               <&ipi_mailbox_rpu0 1>;
      mbox-names = "tx", "rx";
    };
...
```

## Documentation/devicetree/bindings/media/i2c/adv7604.txt
```
* Analog Devices ADV7604/11 video decoder with HDMI receiver

The ADV7604 and ADV7611 are multiformat video decoders with an integrated HDMI
receiver. The ADV7604 has four multiplexed HDMI inputs and one analog input,
and the ADV7611 has one HDMI input and no analog input.

Required Properties:

  - compatible: Must contain one of the following
    - "adi,adv7604" for the ADV7604
    - "adi,adv7611" for the ADV7611

  - reg: I2C slave address

  - hpd-gpios: References to the GPIOs that control the HDMI hot-plug
    detection pins, one per HDMI input. The active flag indicates the GPIO
    level that enables hot-plug detection.

Optional Properties:

  - reset-gpios: Reference to the GPIO connected to the device's reset pin.

  - adi,default-input: Index of the input to be configured as default. Valid
    values are 0..5 for the ADV7604 and 0 for the ADV7611.

  - adi,disable-power-down: Boolean property. When set forces the device to
    ignore the power-down pin. The property is valid for the ADV7604 only as
    the ADV7611 has no power-down pin.

  - adi,disable-cable-reset: Boolean property. When set disables the HDMI
    receiver automatic reset when the HDMI cable is unplugged.

Example:

	hdmi_receiver@4c {
		compatible = "adi,adv7611";
		reg = <0x4c>;

		reset-gpios = <&ioexp 0 GPIO_ACTIVE_LOW>;
		hpd-gpios = <&ioexp 2 GPIO_ACTIVE_HIGH>;

		adi,default-input = <0>;

		#address-cells = <1>;
		#size-cells = <0>;

		port@0 {
			reg = <0>;
		};
		port@1 {
			reg = <1>;
			hdmi_in: endpoint {
				remote-endpoint = <&ccdc_in>;
			};
		};
	};
```

## Documentation/devicetree/bindings/media/i2c/onnn,ap1302.yaml
```yaml
# SPDX-License-Identifier: (GPL-2.0-only OR BSD-2-Clause)
%YAML 1.2
---
$id: http://devicetree.org/schemas/media/i2c/onnn,ap1302.yaml#
$schema: http://devicetree.org/meta-schemas/core.yaml#

title: ON Semiconductor AP1302 Advanced Image Coprocessor

maintainers:
  - Laurent Pinchart <laurent.pinchart@ideasonboard.com>
  - Anil Kumar M <anil.mamidala@xilinx.com>

description: |-
  The AP1302 is a standalone ISP for ON Semiconductor sensors. It interfaces to
  up to two RAW CMOS sensors over MIPI CSI-2 connections, processes the two
  video streams and outputs YUV frames to the host over a MIPI CSI-2 interface.
  Frames are output side by side or on two virtual channels.

  The sensors must be identical. They are connected to the AP1302 on dedicated
  I2C buses, and are controlled by the AP1302 firmware. They are not accessible
  from the host.

properties:
  compatible:
    const: onnn,ap1302

  reg:
    description: I2C device address.
    maxItems: 1

  clocks:
    description: Reference to the CLK clock.
    maxItems: 1

  reset-gpios:
    description: Reference to the GPIO connected to the RST pin (active low).
    maxItems: 1

  standby-gpios:
    description:
      Reference to the GPIO connected to the STANDBY pin (active high).
    maxItems: 1

  port:
    $ref: /schemas/graph.yaml#/$defs/port-base
    unevaluatedProperties: false
    description: MIPI CSI-2 output interface to the host.

    properties:
      endpoint:
        $ref: /schemas/graph.yaml#/$defs/endpoint-base
        unevaluatedProperties: false

        properties:
          clock-noncontinuous:
            type: boolean

          data-lanes:
            oneOf:
              - items:
                  - const: 1
              - items:
                  - const: 1
                  - const: 2
              - items:
                  - const: 1
                  - const: 2
                  - const: 3
                  - const: 4

        required:
          - data-lanes

  sensors:
    type: object
    description: List of connected sensors

    properties:
      "#address-cells":
        const: 1

      "#size-cells":
        const: 0

      onnn,model:
        $ref: "/schemas/types.yaml#/definitions/string"
        description: |
          Model of the connected sensors. Must be a valid compatible string.

          If no sensor is connected, this property must no be specified, and
          the AP1302 can be used with it's internal test pattern generator.

    patternProperties:
      "^sensor@[01]":
        type: object
        description: |
          Sensors connected to the first and second input, with one node per
          sensor.

        properties:
          reg:
            description: AP1302 input port number
            maxItems: 1

        patternProperties:
          ".*-supply":
            description: Power supplies for the sensor

        required:
          - reg

        additionalProperties: false

    required:
      - "#address-cells"
      - "#size-cells"

    # How can we express that onnn,model requires one sensor object to be set ?

    additionalProperties: false

required:
  - compatible
  - reg
  - clocks
  - port
  - sensors

additionalProperties: false

examples:
  - |
    #include <dt-bindings/gpio/gpio.h>

    i2c {
        #address-cells = <1>;
        #size-cells = <0>;

        camera@3c {
            compatible = "onnn,ap1302";
            reg = <0x3c>;

            clocks = <&clk24mhz>;

            reset-gpios = <&pio 102 GPIO_ACTIVE_LOW>;
            standby-gpios = <&pio 40 GPIO_ACTIVE_HIGH>;

            port {
                isp1_out: endpoint {
                    remote-endpoint = <&seninf_in1>;
                    data-lanes = <1 2 3 4>;
                };
            };

            sensors {
                #address-cells = <1>;
                #size-cells = <0>;

                onnn,model = "onnn,ar0144";

                sensor@0 {
                    reg = <0>;

                    vdd-supply = <&mt6358_vcamd_reg>;
                    vaa-supply = <&mt6358_vcama1_reg>;
                    vddio-supply = <&reg_1p8v_ext>;
                };
            };
        };
    };

  - |
    #include <dt-bindings/gpio/gpio.h>

    i2c {
        #address-cells = <1>;
        #size-cells = <0>;

        camera@3c {
            compatible = "onnn,ap1302";
            reg = <0x3c>;

            clocks = <&topckgen 0>;

            reset-gpios = <&pio 102 GPIO_ACTIVE_LOW>;
            standby-gpios = <&pio 40 GPIO_ACTIVE_HIGH>;

            port {
                isp2_out: endpoint {
                    remote-endpoint = <&seninf_in1>;
                    data-lanes = <1 2>;
                };
            };

            sensors {
                #address-cells = <1>;
                #size-cells = <0>;
            };
        };
    };

...
```
