## Documentation/devicetree/bindings/media/xilinx/video.txt
```
DT bindings for Xilinx video IP cores
-------------------------------------

Xilinx video IP cores process video streams by acting as video sinks and/or
sources. They are connected by links through their input and output ports,
creating a video pipeline.

Each video IP core is represented by an AMBA bus child node in the device
tree using bindings documented in this directory. Connections between the IP
cores are represented as defined in ../video-interfaces.txt.

Common properties
-----------------

The following properties are common to all Xilinx video IP cores.

- xlnx,axi-video-format: This property represents a video format transmitted
  on an AXI bus between video IP cores. How the format relates to the IP core
  is decribed in the IP core bindings documentation. The following formats are
  supported.

	rbg
	xrgb
	yuv422
	yuv444
	rggb
	grbg
	gbrg
	bggr

- xlnx,axi-video-width: This property qualifies the video format with the
  sample width expressed as a number of bits per pixel component. All components
  must use the same width.

The following table lists the supported formats and widths combinations, along
with the corresponding media bus pixel code.

----------------+-------+-------------------------------------------------------
Format		| Width	| Media bus code
----------------+-------+-------------------------------------------------------
rbg		| 8	| V4L2_MBUS_FMT_RBG888_1X24
xrgb		| 8	| V4L2_MBUS_FMT_RGB888_1X32_PADHI
yuv422		| 8	| V4L2_MBUS_FMT_UYVY8_1X16
yuv444		| 8	| V4L2_MBUS_FMT_VUY888_1X24
rggb		| 8	| V4L2_MBUS_FMT_SRGGB8_1X8
grbg		| 8	| V4L2_MBUS_FMT_SGRBG8_1X8
gbrg		| 8	| V4L2_MBUS_FMT_SGBRG8_1X8
bggr		| 8	| V4L2_MBUS_FMT_SBGGR8_1X8
----------------+-------+-------------------------------------------------------
```

## Documentation/devicetree/bindings/media/xilinx/xlnx,axi-cfa.txt
```
Xilinx Color Filter Array (CFA)
-------------------------------

Required properties:

- compatible: Must be "xlnx,axi-cfa-7.0".

- reg: Physical base address and length of the registers set for the device.

- ports: Video ports, using the DT bindings defined in ../video-interfaces.txt.
  The cfa has an input port (0) and an output port (1).

Required port properties:

- xlnx,axi-video-format: Must be one of "rggb", "grbg", "gbrg", and "bggr" for
  the input port (0), and "rbg" for the output port (1).

- xlnx,axi-video-width: Video width as defined in video.txt

Example:

	axi_cfa_0: axi_cfa {
		compatible = "xlnx,axi-cfa-7.0";
		reg = <0x400b0000 0x10000>;


		ports {
			#address-cells = <1>;
			#size-cells = <0>;

			port@0 {
				reg = <0>;

				xlnx,axi-video-format = "rggb";
				xlnx,axi-video-width = <8>;

				cfa0_in: endpoint {
					remote-endpoint = <&spc0_out>;
				};
			};
			port@1 {
				reg = <1>;

				xlnx,axi-video-format = "rbg";
				xlnx,axi-video-width = <8>;

				cfa0_out: endpoint {
					remote-endpoint = <&ccm0_in>;
				};
			};
		};
	};
```

## Documentation/devicetree/bindings/media/xilinx/xlnx,axi-cresample.txt
```
Xilinx Chroma Resampler (CRESAMPLE)
-----------------------------------

Required properties:

- compatible: Must be "xlnx,axi-cresample-4.0".

- reg: Physical base address and length of the registers set for the device.

- ports: Video ports, using the DT bindings defined in ../video-interfaces.txt.
  The cresample as han input port (0) and an output port (1).

Required port properties:

- xlnx,axi-video-format: Must be one of "yuv444", "yuv422", and "yuv420" for
  the input port (0), and one of "yuv422" and "yuv420" for the output port (1).

- xlnx,axi-video-width: Video width as defined in video.txt

Example:

	axi_cresample_0: axi_cresample {
		compatible = "xlnx,axi-cresample-4.0";
		reg = <0x40120000 0x10000>;

		ports {
			#address-cells = <1>;
			#size-cells = <0>;

			port@0 {
				reg = <0>;

				xlnx,axi-input-video-format = "yuv444";
				xlnx,axi-video-width = <8>;

				cresample0_in: endpoint {
					remote-endpoint = <&rgb2yuv0_out>;
				};
			};
			port@1 {
				reg = <1>;

				xlnx,axi-output-video-format = "yuv422";
				xlnx,axi-video-width = <8>;

				cresample0_out: endpoint {
					remote-endpoint = <&scaler0_in>;
				};
			};
		};
	};
```

## Documentation/devicetree/bindings/media/xilinx/xlnx,axi-hls.txt
```
Xilinx High-Level Synthesis Core (HLS)
--------------------------------------

High-Level Synthesis cores are synthesized from a high-level function
description developed by the user. As such their functions vary widely, but
they all share a set of common characteristics that allow them to be described
by common bindings.


Required properties:

- compatible: This property must contain "xlnx,axi-hls" to indicate that the
  core is compatible with the generic Xilinx HLS DT bindings. It can also
  contain a more specific string to identify the HLS core implementation. The
  value of those implementation-specific strings is out of scope for these DT
  bindings.

- reg: Physical base address and length of the registers sets for the device.
  The HLS core has two registers sets, the first one contains the core
  standard registers and the second one contains the custom user registers.

- ports: Video ports, using the DT bindings defined in ../video-interfaces.txt.
  The HLS core has one input port (0) and one output port (1).

Required port properties:

- xlnx,axi-video-format: Video format as defined in video.txt.
- xlnx,axi-video-width: Video width as defined in video.txt.

Example:

	axi_hls_0: axi_hls@43c00000 {
		compatible = "xlnx,axi-hls-sobel", "xlnx,axi-hls";
		reg = <0x43c00000 0x24>, <0x43c00024 0xa0>;

		ports {
			#address-cells = <1>;
			#size-cells = <0>;

			port@0 {
				reg = <0>;

				xlnx,axi-video-format = "yuv422";
				xlnx,axi-video-width = <8>;

				hls0_in: endpoint {
					remote-endpoint = <&vdma_out>;
				};
			};
			port@1 {
				reg = <1>;

				xlnx,axi-video-format = "yuv422";
				xlnx,axi-video-width = <8>;

				hls0_out: endpoint {
					remote-endpoint = <&vdma_in>;
				};
			};
		};
	};
```

## Documentation/devicetree/bindings/media/xilinx/xlnx,axi-rgb2yuv.txt
```
Xilinx RGB to YUV (RGB2YUV)
---------------------------

Required properties:

- compatible: Must be "xlnx,axi-rgb2yuv-7.1".

- reg: Physical base address and length of the registers set for the device.

- ports: Video ports, using the DT bindings defined in ../video-interfaces.txt.
  The rgb2yuv has an input port (0) and an output port (1).

Required port properties:

- xlnx,axi-video-format: Must be 'rbg' for the input port (0) and 'yuv444' for
  the output port (1).

- xlnx,axi-video-width: Video width as defined in video.txt

Example:

	axi_rgb2yuv_0: axi_rgb2yuv {
		compatible = "xlnx,axi-rgb2yuv-7.1";
		reg = <0x40100000 0x10000>;

		ports {
			#address-cells = <1>;
			#size-cells = <0>;

			port@0 {
				reg = <0>;

				xlnx,axi-video-format = "rbg";
				xlnx,axi-video-width = <8>;

				rgb2yuv0_in: endpoint {
					remote-endpoint = <&gamma0_out>;
				};
			};
			port@1 {
				reg = <1>;

				xlnx,axi-video-format = "yuv444";
				xlnx,axi-video-width = <8>;

				rgb2yuv0_out: endpoint {
					remote-endpoint = <&cresample0_in>;
				};
			};
		};
	};
```

## Documentation/devicetree/bindings/media/xilinx/xlnx,axi-tpg.txt
```
Xilinx Video Test Pattern Generator (TPG)
-----------------------------------------

Required properties:

- compatible: Must be "xlnx,axi-tpg-5.0".

- reg: Physical base address and length of the registers set for the device.

- xlnx,axi-video-format, xlnx,axi-video-width: Video format and width, as
  defined in video.txt.

- port: Video port, using the DT bindings defined in ../video-interfaces.txt.
  The TPG has a single output port numbered 0.

Optional properties:

- xlnx,vtc: A phandle referencing the Video Timing Controller that generates
  video timings for the TPG test patterns.

- timing-gpios: Specifier for a GPIO that controls the timing mux at the TPG
  input. The GPIO active level corresponds to the selection of VTC-generated
  video timings.

The xlnx,vtc and timing-gpios properties are mandatory when the TPG is
synthesized with two ports and forbidden when synthesized with one port.

Example:

	axi_tpg_0: axi_tpg@40050000 {
		compatible = "xlnx,axi-tpg-5.0";
		reg = <0x40050000 0x10000>;

		xlnx,vtc = <&vtc_3>;
		timing-gpios = <&ps7_gpio_0 55 GPIO_ACTIVE_LOW>;

		ports {
			#address-cells = <1>;
			#size-cells = <0>;

			port@0 {
				reg = <0>;

				xlnx,axi-video-format = "yuv422";
				xlnx,axi-video-width = <8>;

				tpg_in: endpoint {
					remote-endpoint = <&adv7611_out>;
				};
			};
			port@1 {
				reg = <1>;

				xlnx,axi-video-format = "yuv422";
				xlnx,axi-video-width = <8>;

				tpg1_out: endpoint {
					remote-endpoint = <&switch_in0>;
				};
			}:
		};
	};
```
