## Documentation/devicetree/bindings/fpga/xlnx,afi-fpga.txt
```
Xilinx ZynqMp AFI interface Manager

The Zynq UltraScale+ MPSoC Processing System core provides access from PL
masters to PS internal peripherals, and memory through AXI FIFO interface
(AFI) interfaces.

Required properties:
-compatible:		Should contain "xlnx,afi-fpga"
-config-afi:		Pairs of  <regid value >

The possible values of regid and values are
 regid:		Regids of the register to be written possible values
		0- AFIFM0_RDCTRL
		1- AFIFM0_WRCTRL
		2- AFIFM1_RDCTRL
		3- AFIFM1_WRCTRL
		4- AFIFM2_RDCTRL
		5- AFIFM2_WRCTRL
		6- AFIFM3_RDCTRL
		7- AFIFM3_WRCTRL
		8- AFIFM4_RDCTRL
		9- AFIFM4_WRCTRL
		10- AFIFM5_RDCTRL
		11- AFIFM5_WRCTRL
		12- AFIFM6_RDCTRL
		13- AFIFM6_WRCTRL
		14- AFIFS
		15- AFIFS_SS2
- value:	Array of values to be written.
		for FM0_RDCTRL(0) the valid values-fabric width   2: 32-bit,1 : 64-bit ,0: 128-bit enabled
		for FM0_WRCTRL(1) the valid values-fabric width   2: 32-bit,1 : 64-bit ,0: 128-bit enabled
		for FM1_RDCTRL(2) the valid values-fabric width   2: 32-bit,1 : 64-bit ,0: 128-bit enabled
		for FM1_WRCTRL(3) the valid values-fabric width   2: 32-bit,1 : 64-bit ,0: 128-bit enabled
		for FM2_RDCTRL(4) the valid values-fabric width   2: 32-bit,1 : 64-bit ,0: 128-bit enabled
		for FM2_WRCTRL(5) the valid values-fabric width   2: 32-bit,1 : 64-bit ,0: 128-bit enabled
		for FM3_RDCTRL(6) the valid values-fabric width   2: 32-bit,1 : 64-bit ,0: 128-bit enabled
		for FM3_WRCTRL(7) the valid values-fabric width   2: 32-bit,1 : 64-bit ,0: 128-bit enabled
		for FM4_RDCTRL(8) the valid values-fabric width   2: 32-bit,1 : 64-bit ,0: 128-bit enabled
		for FM4_WRCTRL(9) the valid values-fabric width   2: 32-bit,1 : 64-bit ,0: 128-bit enabled
		for FM5_RDCTRL(10) the valid values-fabric width   2: 32-bit,1 : 64-bit ,0: 128-bit enabled
		for FM5_WRCTRL(11) the valid values-fabric width   2: 32-bit,1 : 64-bit ,0: 128-bit enabled
		for FM6_RDCTRL(12) the valid values-fabric width   2: 32-bit,1 : 64-bit ,0: 128-bit enabled
		for FM6_WRCTRL(13) the valid values-fabric width   2: 32-bit,1 : 64-bit ,0: 128-bit enabled
		for AFI_FA(14)
			dw_ss1_sel	bits (11:10)
			dw_ss0_sel	bits (9:8)
				0x0: 32-bit AXI data width),
				0x1: 64-bit AXI data width,
				0x2: 128-bit AXI data
		All other bits are 0 write ignored.

		for AFI_FA(15)  selects for ss2AXI data width valid values
					0x000: 32-bit AXI data width),
					0x100: 64-bit AXI data width,
					0x200: 128-bit AXI data

Example:
afi0: afi0 {
	compatible = "xlnx,afi-fpga";
	config-afi = <0 2>, <1 1>, <2 1>;
};
```

## Documentation/devicetree/bindings/fpga/xlnx,afi-fpga.yaml
```yaml
# SPDX-License-Identifier: (GPL-2.0 OR BSD-2-Clause)
%YAML 1.2
---
$id: http://devicetree.org/schemas/fpga/xlnx,afi-fpga.yaml#
$schema: http://devicetree.org/meta-schemas/core.yaml#

title: Xilinx Zynq UltraScale+ MPSoC AFI Interface Manager

maintainers:
  - Nava kishore Manne <nava.kishore.manne@amd.com>

description:
  The Zynq UltraScale+ MPSoC Processing System core provides access from PL
  masters to PS internal peripherals, and memory through AXI FIFO interface
  (AFI) interfaces.

properties:
  compatible:
    const: xlnx,afi-fpga

  config-afi:
    $ref: /schemas/types.yaml#/definitions/uint32-matrix
    description:
      Pairs of <regid value> defining AFI register configurations.
    minItems: 1
    maxItems: 16
    items:
      items:
        - description:
            Register ID of the AFI register to be written.
          minimum: 0
          maximum: 15
        - description: |
            Value to be written to the register.
            For regid 0-13 (FMx_RDCTRL/WRCTRL), the value sets the
            fabric width: 0 (128-bit), 1 (64-bit), 2 (32-bit).
            For regid 14 (AFIFS), the value encodes dw_ss1_sel
            (bits 11:10) and dw_ss0_sel (bits 9:8), where each
            2-bit field accepts 0x0 (32-bit AXI data width),
            0x1 (64-bit AXI data width), or 0x2 (128-bit AXI data
            width). All other bits are ignored.
            For regid 15 (AFIFS_SS2), the value selects the SS2 AXI
            data width: 0x000 (32-bit), 0x100 (64-bit), 0x200 (128-bit).

  resets:
    description: Phandle and reset specifier for the PS-PL resets.
    maxItems: 4

required:
  - compatible
  - config-afi

additionalProperties: false

examples:
  - |
    afi0 {
        compatible = "xlnx,afi-fpga";
        config-afi = <0 2>, <1 1>, <2 1>;
        resets = <&zynqmp_reset 116>, <&zynqmp_reset 117>,
                 <&zynqmp_reset 118>, <&zynqmp_reset 119>;
    };
```

## Documentation/devicetree/bindings/fpga/xlnx,versal-fpga.txt
```
Device Tree versal-fpga bindings for the Versal SOC, Controlled
using Versal SoC firmware interface.

Required properties:
- compatible: should contain "xlnx,versal-fpga"

Example:
	versal_fpga: fpga {
		compatible = "xlnx,versal-fpga";
	};
```

## Documentation/devicetree/bindings/fpga/xlnx,zynq-afi-fpga.txt
```
Xilinx Zynq AFI interface Manager

The Zynq Processing System core provides access from PL masters to PS
internal peripherals, and memory through AXI FIFO interface
(AFI) interfaces.

Required properties:
-compatible:	Should contain "xlnx,zynq-afi-fpga"
-reg:	Physical base address and size of the controller's register area.
-xlnx,afi-buswidth :	Size of the afi bus width.
			0: 64-bit AXI data width,
			1: 32-bit AXI data width,

Example:
afi0: afi0 {
	compatible = "xlnx,zynq-afi-fpga";
	reg = <0xf8008000 0x1000>;
	xlnx,afi-buswidth = <1>;
};
```

## Documentation/devicetree/bindings/fpga/xlnx,zynq-afi-fpga.yaml
```yaml
# SPDX-License-Identifier: (GPL-2.0 OR BSD-2-Clause)
%YAML 1.2
---
$id: http://devicetree.org/schemas/fpga/xlnx,zynq-afi-fpga.yaml#
$schema: http://devicetree.org/meta-schemas/core.yaml#

title: Xilinx Zynq AFI Interface Manager

maintainers:
  - Nava kishore Manne <nava.kishore.manne@amd.com>

description:
  The Zynq Processing System core provides access from PL masters to PS
  internal peripherals and memory through AXI FIFO interface (AFI) interfaces.

properties:
  compatible:
    const: "xlnx,zynq-afi-fpga"

  reg:
    maxItems: 1

  xlnx,afi-buswidth:
    description: |
      Size of the AFI bus width.
      0: 64-bit AXI data width,
      1: 32-bit AXI data width.
    $ref: /schemas/types.yaml#/definitions/uint32
    enum: [0, 1]

required:
  - reg
  - xlnx,afi-buswidth

unevaluatedProperties: false

examples:
  - |
    afi0@f8008000 {
      compatible = "xlnx,zynq-afi-fpga";
      reg = <0xf8008000 0x1000>;
      xlnx,afi-buswidth = <1>;
    };
```

## Documentation/devicetree/bindings/fpga/xlnx,zynqmp-pcap-fpga.txt
```
Device Tree zynqmp-fpga bindings for the Zynq Ultrascale+ MPSoC controlled
using ZynqMP SoC firmware interface
For Bitstream configuration on ZynqMp Soc uses processor configuration
port(PCAP) to configure the programmable logic(PL) through PS by using
FW interface.

Required properties:
- compatible: should contain "xlnx,zynqmp-pcap-fpga"

Example:
	zynqmp_pcap: pcap {
		compatible = "xlnx,zynqmp-pcap-fpga";
	};
```

## Documentation/devicetree/bindings/gpio/gpio-slg7xl45106.yaml
```yaml
# SPDX-License-Identifier: (GPL-2.0-only OR BSD-2-Clause)
%YAML 1.2
---
$id: http://devicetree.org/schemas/gpio/gpio-slg7xl45106.yaml#
$schema: http://devicetree.org/meta-schemas/core.yaml#

title: slg7xl45106 I2C GPO expander

maintainers:
  - Raviteja Narayanam <raviteja.narayanam@xilinx.com>

properties:
  compatible:
    enum:
      - dlg,slg7xl45106

  reg:
    maxItems: 1

  gpio-controller: true

  '#gpio-cells':
    const: 2

required:
  - compatible
  - reg
  - gpio-controller
  - "#gpio-cells"

additionalProperties: false

examples:
  - |
    i2c0 {
        #address-cells = <1>;
        #size-cells = <0>;

        gpio@10 {
            compatible = "dlg,slg7xl45106";
            reg = <0x10>;
            gpio-controller;
            #gpio-cells = <2>;
        };
    };

...
```

## Documentation/devicetree/bindings/gpio/gpio-xilinx.txt
```
Xilinx plb/axi GPIO controller

Dual channel GPIO controller with configurable number of pins
(from 1 to 32 per channel). Every pin can be configured as
input/output/tristate. Both channels share the same global IRQ but
local interrupts can be enabled on channel basis.

Required properties:
- compatible : Should be "xlnx,xps-gpio-1.00.a"
- reg : Address and length of the register set for the device
- #gpio-cells : Should be two or three. The first cell is the pin number,
  The second cell is used to specify channel offset:
		0 - first channel
		8 - second channel
  The third cell is optional and used to specify flags. Use the macros
  defined in include/dt-bindings/gpio/gpio.h
- gpio-controller : Marks the device node as a GPIO controller.

Optional properties:
- clock-names : Should be "s_axi_aclk"
- clocks: Input clock specifier. Refer to common clock bindings.
- interrupts : Interrupt mapping for GPIO IRQ.
- interrupt-parent : Phandle for the interrupt controller that
  services interrupts for this device.
- xlnx,all-inputs : if n-th bit is setup, GPIO-n is input
- xlnx,dout-default : if n-th bit is 1, GPIO-n default value is 1
- xlnx,gpio-width : gpio width
- xlnx,tri-default : if n-th bit is 1, GPIO-n is in tristate mode
- xlnx,is-dual : if 1, controller also uses the second channel
- xlnx,all-inputs-2 : as above but for the second channel
- xlnx,dout-default-2 : as above but the second channel
- xlnx,gpio2-width : as above but for the second channel
- xlnx,tri-default-2 : as above but for the second channel


Example:
gpio: gpio@40000000 {
	#gpio-cells = <2>;
	compatible = "xlnx,xps-gpio-1.00.a";
	gpio-controller ;
	clock-names = "s_axi_aclk";
	clocks = <&clkc 71>;
	interrupt-parent = <&microblaze_0_intc>;
	interrupts = < 6 2 >;
	reg = < 0x40000000 0x10000 >;
	xlnx,all-inputs = <0x0>;
	xlnx,all-inputs-2 = <0x0>;
	xlnx,dout-default = <0x0>;
	xlnx,dout-default-2 = <0x0>;
	xlnx,gpio-width = <0x2>;
	xlnx,gpio2-width = <0x2>;
	xlnx,interrupt-present = <0x1>;
	xlnx,is-dual = <0x1>;
	xlnx,tri-default = <0xffffffff>;
	xlnx,tri-default-2 = <0xffffffff>;
} ;

Example to demonstrate how reset-gpios property is used in drivers:

driver: driver@80000000 {
	compatible = "xlnx,driver";
	reset-gpios = <&gpio 0 0 GPIO_ACTIVE_LOW>; /* gpio phandle, gpio pin-number, channel offset, flag state */
	reg = <0x0 0x80000000 0x0 0x10000>;
};
```

## Documentation/devicetree/bindings/gpio/gpio-zynq.txt
```
Xilinx Zynq GPIO controller Device Tree Bindings
-------------------------------------------

Required properties:
- #gpio-cells 		: Should be two. First cell is used to mention
			  pin number.
- compatible		: Should be "xlnx,zynq-gpio-1.0"
- clocks		: Clock phandles (see clock bindings for details)
- gpio-controller	: Marks the device node as a GPIO controller.
- interrupts		: Property with a value describing the interrupt
			  number.
- interrupt-parent	: Must be core interrupt controller
- reg			: Address and length of the register set for the device

Example:
		gpio@e000a000 {
			#gpio-cells = <2>;
			compatible = "xlnx,zynq-gpio-1.0";
			clocks = <&clkc 42>;
			gpio-controller ;
			interrupt-parent = <&intc>;
			interrupts = <0 20 4>;
			reg = <0xe000a000 0x1000>;
		} ;
```

## Documentation/devicetree/bindings/hwmon/tps544.txt
```
TPS544B25 power regulator

This power regulator driver supports voltage read/write and
current calibration and readback.

Required properties:
- compatible: should be "ti,tps544"
- reg: I2C slave address

Example:
tps544@24 {
	compatible = "ti,tps544";
	reg = <0x24>;
};
```

## Documentation/devicetree/bindings/i2c/i2c-cadence.txt
```
Binding for the Cadence I2C controller

Required properties:
  compatible: Compatibility string. Must be 'cdns,i2c-r1p10'.
  clocks: From common clock bindings. Phandle to input clock.

Optional properties:
  clock-frequency: Desired operating frequency, in Hz, of the bus (actual may
		   be lower). Defaults to 400000 if not specified.

Example:

	i2c0: cdns-i2c@e0004000 {
		compatible = "cdns,i2c-r1p10";
		clocks = <&clkc 38>;
		interrupt-parent = <&intc>;
		interrupts = <0 25 4>;
		reg = <0xE0004000 0x1000>;
		clock-frequency = <400000>;
		#address-cells = <1>;
		#size-cells = <0>;
	};
```

## Documentation/devicetree/bindings/iio/adc/ti,ina260.yaml
```yaml
# SPDX-License-Identifier: GPL-2.0-or-later
%YAML 1.2
---
$id: http://devicetree.org/schemas/iio/adc/ti,ina260.yaml#
$schema: http://devicetree.org/meta-schemas/core.yaml#

title: Texas Instruments INA260 power monitor

maintainers:
  - Shubhrajyoti Datta <shubhrajyoti.datta@xilinx.com>

description: |
  The INA260 is a digital-output, current, power and voltage monitor
  with an I2C and SMBUS compatible interface with an integrated shunt
  resistor. It features up to 16 programmable addresses on I2C compatible
  interface. Datasheet - https://www.ti.com/lit/ds/symlink/ina260.pdf?ts=1608607288391

properties:
  compatible:
    enum:
      - ti,ina260

  reg:
    description: |
      The 7-bits long I2c address of the device

  "#io-channel-cells":
    const: 1

  interrupts:
    description: |
      IRQ line for the device

  label:
    description: |
      A symbolic name for the device

required:
  - compatible
  - reg
  - "#io-channel-cells"

additionalProperties: false

examples:
  - |
    i2c {
      #address-cells = <1>;
      #size-cells = <0>;

      ina260@40 {
        compatible = "ti,ina260";
        reg = <0x40>;
        #io-channel-cells = <1>;
      };
    };
...
```
