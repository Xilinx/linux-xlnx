## Documentation/devicetree/bindings/iio/adc/xilinx-ams.txt
```
Xilinx AMS device driver

The AMS includes an ADC as well as on-chip sensors that can be used to
sample external voltages and monitor on-die operating conditions, such as
temperature and supply voltage levels. The AMS has two SYSMON blocks.
PL-SYSMON block is capable of monitoring off chip voltage and temperature.
PL-SYSMON block has DRP, JTAG and I2C interface to enable monitoring from
external master. Out of this interface currenlty only DRP is supported.
Other block PS-SYSMON is memory mapped to PS. Both of block has built-in
alarm generation logic that is used to interrupt the processor based on
condition set.

All designs should have AMS register, but PS and PL are optional depending on
the design. The driver can work with only PS, only PL and both PS and PL
configurations. Please specify registers according to your design. DTS file
should always have AMS module property. Providing PS & PL module is optional.

Required properties:
	- compatible: Should be "xlnx,zynqmp-ams"
	- reg:  Should specify AMS register space
	- interrupts: Interrupt number for the AMS control interface
	- interrupt-names: Interrupt name, must be "ams-irq"
	- clocks: Should contain a clock specifier for the device
	- ranges: keep the property empty to map child address space
	          (for PS and/or PL) nodes 1:1 onto the parent address
	          space

AMS device tree subnode:
	- compatible: Should be "xlnx,zynqmp-ams-ps" or "xlnx,zynqmp-ams-pl"
	- reg:  Register space for PS or PL

Optional properties:

Following optional property only valid for PL.
	- xlnx,ext-channels: List of external channels that are connected to the
	                     AMS PL module.

	  The child nodes of this node represent the external channels which are
	  connected to the AMS Module. If the property is not present
	  no external channels will be assumed to be connected.

	  Each child node represents one channel and has the following
	  properties:
		Required properties:
			* reg: Pair of pins the channel is connected to.
				0: VP/VN
				1: VUSER0
				2: VUSER1
				3: VUSER3
				4: VUSER4
				5: VAUXP[0]/VAUXN[0]
				6: VAUXP[1]/VAUXN[1]
				...
				20: VAUXP[15]/VAUXN[15]
			  Note each channel number should only be used at most
			  once.
		Optional properties:
			* xlnx,bipolar: If set the channel is used in bipolar
			  mode.


Example:
	xilinx_ams: ams@ffa50000 {
		compatible = "xlnx,zynqmp-ams";
		interrupt-parent = <&gic>;
		interrupts = <0 56 4>;
		interrupt-names = "ams-irq";
		clocks = <&clkc 70>;
		reg = <0x0 0xffa50000 0x0 0x800>;
		reg-names = "ams-base";
		#address-cells = <2>;
		#size-cells = <2>;
		ranges;

		ams_ps: ams_ps@ffa50800 {
			compatible = "xlnx,zynqmp-ams-ps";
			reg = <0x0 0xffa50800 0x0 0x400>;
		};

		ams_pl: ams_pl@ffa50c00 {
			compatible = "xlnx,zynqmp-ams-pl";
			reg = <0x0 0xffa50c00 0x0 0x400>;
			xlnx,ext-channels {
				#address-cells = <1>;
				#size-cells = <0>;
				channel@0 {
					reg = <0>;
					xlnx,bipolar;
				};
				channel@1 {
					reg = <1>;
				};
				channel@8 {
					reg = <8>;
					xlnx,bipolar;
				};
			};
		};
	};

AMS Channels Details:

Sysmon Block	|Channel|			Details					|Measurement
		 Number									 Type
---------------------------------------------------------------------------------------------------------
AMS CTRL	|0	|System PLLs voltage measurement, VCC_PSPLL.			|Voltage
		|1	|Battery voltage measurement, VCC_PSBATT.			|Voltage
		|2	|PL Internal voltage measurement, VCCINT.			|Voltage
		|3	|Block RAM voltage measurement, VCCBRAM.			|Voltage
		|4	|PL Aux voltage measurement, VCCAUX.				|Voltage
		|5	|Voltage measurement for six DDR I/O PLLs, VCC_PSDDR_PLL.	|Voltage
		|6	|VCC_PSINTFP_DDR voltage measurement.				|Voltage
---------------------------------------------------------------------------------------------------------
PS Sysmon	|7	|LPD temperature measurement.					|Temperature
		|8	|FPD Temperature Measurment (REMOTE).				|Temperature
		|9	|VCC PS LPD voltage measurement (supply1).			|Voltage
		|10	|VCC PS FPD voltage measurement (supply2).			|Voltage
		|11	|PS Aux voltage reference (supply3).				|Voltage
		|12	|DDR I/O VCC voltage measurement.				|Voltage
		|13	|PS IO Bank 503 voltage measurement (supply5).			|Voltage
		|14	|PS IO Bank 500 voltage measurement (supply6).			|Voltage
		|15	|VCCO_PSIO1 voltage measurement.				|Voltage
		|16	|VCCO_PSIO2 voltage measurement.				|Voltage
		|17	|VCC_PS_GTR voltage measurement (VPS_MGTRAVCC).			|Voltage
		|18	|VTT_PS_GTR voltage measurement (VPS_MGTRAVTT).			|Voltage
		|19	|VCC_PSADC voltage measurement.					|Voltage
---------------------------------------------------------------------------------------------------------
PL Sysmon	|20	|PL Temperature measurement.					|Temperature
		|21	|PL Internal Voltage Voltage measurement, VCCINT.		|Voltage
		|22	|PL Auxiliary Voltage measurement, VCCAUX.			|Voltage
		|23	|ADC Reference P+ Voltage measurement.				|Voltage
		|24	|ADC Reference N- Voltage measurement.				|Voltage
		|25	|PL Block RAM Voltage measurement, VCCBRAM.			|Voltage
		|26	|LPD Internal Voltage measurement, VCC_PSINTLP (supply4).	|Voltage
		|27	|FPD Internal Voltage measurement, VCC_PSINTFP (supply5).	|Voltage
		|28	|PS Auxiliary Voltage measurement (supply6).			|Voltage
		|29	|PL VCCADC Voltage measurement (vccams).			|Voltage
		|30	|Differencial analog input signal Voltage measurment.		|Voltage
		|31	|VUser0 Voltage measurement (supply7).				|Voltage
		|32	|VUser1 Voltage measurement (supply8).				|Voltage
		|33	|VUser2 Voltage measurement (supply9).				|Voltage
		|34	|VUser3 Voltage measurement (supply10).				|Voltage
		|35	|Auxiliary ch 0 Voltage measurement (VAux0).			|Voltage
		|36	|Auxiliary ch 1 Voltage measurement (VAux1).			|Voltage
		|37	|Auxiliary ch 2 Voltage measurement (VAux2).			|Voltage
		|38	|Auxiliary ch 3 Voltage measurement (VAux3).			|Voltage
		|39	|Auxiliary ch 4 Voltage measurement (VAux4).			|Voltage
		|40	|Auxiliary ch 5 Voltage measurement (VAux5).			|Voltage
		|41	|Auxiliary ch 6 Voltage measurement (VAux6).			|Voltage
		|42	|Auxiliary ch 7 Voltage measurement (VAux7).			|Voltage
		|43	|Auxiliary ch 8 Voltage measurement (VAux8).			|Voltage
		|44	|Auxiliary ch 9 Voltage measurement (VAux9).			|Voltage
		|45	|Auxiliary ch 10 Voltage measurement (VAux10).			|Voltage
		|46	|Auxiliary ch 11 Voltage measurement (VAux11).			|Voltage
		|47	|Auxiliary ch 12 Voltage measurement (VAux12).			|Voltage
		|48	|Auxiliary ch 13 Voltage measurement (VAux13).			|Voltage
		|49	|Auxiliary ch 14 Voltage measurement (VAux14).			|Voltage
		|50	|Auxiliary ch 15 Voltage measurement (VAux15).			|Voltage
---------------------------------------------------------------------------------------------------------
```

## Documentation/devicetree/bindings/iio/adc/xlnx,versal-sysmon.yaml
```yaml
# SPDX-License-Identifier: (GPL-2.0-only OR BSD-2-Clause)
# Copyright 2019 - 2020 Xilinx Inc.
%YAML 1.2
---
$id: http://devicetree.org/schemas/iio/adc/xlnx,versal-sysmon.yaml#
$schema: http://devicetree.org/meta-schemas/core.yaml#

title: Xilinx Versal Sysmon Linux Driver

maintainers:
  - Salih Erim <salih.erim@amd.com>

description: |
  Sysmon Driver uses Linux IIO framework which was used to abstract the supply
  voltages and temperatures across the chip as Voltage and Temperature
  Channels in the framework. Since there are only 160 supply voltage registers
  and 184 measurement points, there is no constant mapping of supply voltage
  registers and the measurement points. User has to select the voltages to
  monitor in design tool. Depending on the selection, a voltage supply gets
  mapped to one of the supply registers. So, this mapping information is
  provided to the driver via a device tree. Depending on the number of supplies
  enabled in the design, the device tree will contain the information of name
  of the supply enabled and the supply register it maps to.

properties:
  compatible:
    items:
      - enum:
          - xlnx,versal-sysmon

  reg:
    description: Sysmon Registers
    maxItems: 1

  interrupts:
    description: interrupt line for Sysmon
    maxItems: 1

  '#address-cells':
    const: 1

  '#size-cells':
    const: 0

  '#io-channel-cells':
    const: 1

  xlnx,numchannels:
    $ref: /schemas/types.yaml#/definitions/uint8
    description: |
      Number of supply channels enabled in the design.
      Possible values 0 - 160. Based on this value, child supply nodes will
      be created

  xlnx,nodeid:
    $ref: /schemas/types.yaml#/definitions/uint32
    description: |
      PLM specified sysmon node id.

  xlnx,hbm:
    description: |
      Exists if node refers to a HBM SLR.
    type: boolean

patternProperties:
  "^supply@([0-9]{1,2}|1[0-5][0-9])$":
    type: object
    description: |
      Represents the supplies configured in the design.

    properties:
      reg:
        minimum: 0
        maximum: 159
        description:
          The supply number associated with the voltage.

      xlnx,name:
        $ref: /schemas/types.yaml#/definitions/string
        description:
          Name of the supply enabled

      xlnx,bipolar:
        $ref: /schemas/types.yaml#/definitions/flag
        description:
          If the supply has a bipolar type and the output will be signed

    required:
      - reg
      - xlnx,name

    additionalProperties: false

  "^temp@([1-9]|[1-5][0-9]|6[0-4])$":
    type: object
    description:
      Represents the sysmon temperature satellites.

    properties:
      reg:
        minimum: 1
        maximum: 64
        description:
          The sysmon temperature satellite number.

      xlnx,name:
        $ref: /schemas/types.yaml#/definitions/string
        description:
          Name of temperature satellite exposed

      xlnx,aie-temp:
        $ref: /schemas/types.yaml#/definitions/flag
        description:
          If present it indicates the temperature satellite is in
          close proximity with AI Engine

    required:
      - reg
      - xlnx,name

    additionalProperties: false

required:
  - compatible
  - reg
  - xlnx,numchannels

additionalProperties: false

examples:
  - |
    #include <dt-bindings/power/xlnx-versal-regnode.h>
    bus {
        #address-cells = <2>;
        #size-cells = <2>;

        sysmon@f1270000 {
            compatible = "xlnx,versal-sysmon";
            reg = <0 0xf1270000 0 0x4000>;
            interrupts = <0 0x90 0x4>;
            xlnx,numchannels = /bits/8 <8>;
            xlnx,nodeid = <PM_REGNODE_SYSMON_ROOT_0>;
            #address-cells = <1>;
            #size-cells = <0>;
            supply@0 {
                    reg = <0>;
                    xlnx,name = "vccint";
            };

            supply@31 {
                    reg = <31>;
                    xlnx,name = "vccsoc";
            };

            supply@32 {
                    reg = <32>;
                    xlnx,bipolar;
                    xlnx,name = "vccram";
            };

            supply@63 {
                    reg = <63>;
                    xlnx,bipolar;
                    xlnx,name = "vccaux";
            };

            supply@64 {
                    reg = <64>;
                    xlnx,name = "vccbram";
            };

            supply@95 {
                    reg = <95>;
                    xlnx,name = "gt_avaux";
            };

            supply@96 {
                    reg = <96>;
                    xlnx,name = "gt_vccaux";
            };

            supply@159 {
                    reg = <159>;
                    xlnx,name = "vccint_ir";
            };

            temp@7 {
              xlnx,aie-temp;
              reg = <7>;
              xlnx,name = "aie-temp-ch0";
            };

            temp@8 {
              xlnx,aie-temp;
              reg = <8>;
              xlnx,name = "aie-temp-ch1";
            };

            temp@14 {
              xlnx,aie-temp;
              reg = <14>;
              xlnx,name = "aie-temp-ch2";
            };

            temp@15 {
              xlnx,aie-temp;
              reg = <15>;
              xlnx,name = "aie-temp-ch3";
            };

            temp@16 {
              xlnx,aie-temp;
              reg = <16>;
              xlnx,name = "aie-temp-ch4";
            };

            temp@30 {
              xlnx,aie-temp;
              reg = <30>;
              xlnx,name = "aie-temp-ch5";
            };

            temp@33 {
              xlnx,aie-temp;
              reg = <33>;
              xlnx,name = "aie-temp-ch6";
            };

            temp@34 {
              xlnx,aie-temp;
              reg = <34>;
              xlnx,name = "aie-temp-ch7";
            };
        };
    };
```

## Documentation/devicetree/bindings/interrupt-controller/xilinx,intc.txt
```
Xilinx Interrupt Controller

The controller is a soft IP core that is configured at build time for the
number of interrupts and the type of each interrupt. These details cannot
be changed at run time.

Required properties:

- compatible : should be "xlnx,xps-intc-1.00.a"
- reg : Specifies base physical address and size of the registers.
- interrupt-controller : Identifies the node as an interrupt controller
- #interrupt-cells : Specifies the number of cells needed to encode an
		     interrupt source. The value shall be a minimum of 1.
		     The Xilinx device trees typically use 2 but the 2nd value
		     is not used.
- xlnx,kind-of-intr : A 32 bit value specifying the interrupt type for each
		      possible interrupt (1 = edge, 0 = level). The interrupt
		      type typically comes in thru the device tree node of
		      the interrupt generating device, but in this case
		      the interrupt type is determined by the interrupt
		      controller based on how it was implemented.
- xlnx,num-intr-inputs: Specifies the number of interrupts supported
		        by the specific implementation of the controller (1-32).

Optional properties:
- interrupt-parent : Specifies an interrupt controller from which it is
		     chained (cascaded).
- interrupts : Specifies the interrupt of the parent controller from which
	       it is chained.

Example:

axi_intc_0: interrupt-controller@41800000 {
	#interrupt-cells = <2>;
	compatible = "xlnx,xps-intc-1.00.a";
	interrupt-controller;
	reg = <0x41800000 0x10000>;
	xlnx,kind-of-intr = <0x1>;
	xlnx,num-intr-inputs = <0x1>;
};

Chained Example:

The interrupt is chained to hardware interrupt 61 (29 + 32) of the GIC
for Zynq.

axi_intc_0: interrupt-controller@41800000 {
	#interrupt-cells = <2>;
	compatible = "xlnx,xps-intc-1.00.a";
	interrupt-controller;
	interrupt-parent = <&ps7_scugic_0>;
	interrupts = <0 29 4>;
	reg = <0x41800000 0x10000>;
	xlnx,kind-of-intr = <0x1>;
	xlnx,num-intr-inputs = <0x1>;
};
```
