## Documentation/devicetree/bindings/arm/zynq/xlnx,zynq-ocm.txt
```
Device tree bindings for Zynq's OCM

The OCM is divided to 4 64kB segments which can be separately configured
to low or high location. Location is controlled via SLCR.

Required properties:
 compatible: Compatibility string. Must be "xlnx,zynq-ocm-1.0".
 reg: Specify the base and size of the OCM registers in the memory map.
      E.g.: reg = <0xf800c000 0x1000>;

Example:
ocmc: ocmc@f800c000 {
	compatible = "xlnx,zynq-ocm-1.0";
	interrupt-parent = <&intc>;
	interrupts = <0 3 4>;
	reg = <0xf800c000 0x1000>;
} ;
```

## Documentation/devicetree/bindings/arm/zynq/xlnx,zynq-smc.txt
```
Device tree bindings for Zynq's SMC (PL353)

The SMC supports NAND, NOR and SRAM memory. The SMC driver handles generic
tasks, while children drivers handle memory type specifics.

Required properties:
 compatible: Compatibility string. Must be "xlnx,zynq-smc-1.00.a".
 reg: Specify the base and size of the SMC registers in the memory map.
      E.g.: reg = <0xe000e000 0x1000>;
 #address-cells: Address cells, must be 1.
 #size-cells: Size cells. Must be 1.
 ranges

Child nodes:
 For NAND the "xlnx,zynq-nand-1.00.a" and for NOR the "cfi-flash" drivers are supported
 as child nodes.

Example:
	zynq_smc_0: zynq-smc@e000e000 {
		compatible = "xlnx,zynq-smc-1.00.a";
		reg = <0xe000e000 0x1000>;
		#address-cells = <1>;
		#size-cells = <1>;
		ranges;

		zynq_nand_0: zynq-nand@e1000000 {
			compatible = "xlnx,zynq-nand-1.00.a";
			(...)
		};
	};
```

## Documentation/devicetree/bindings/arm/zynq/zynq-efuse.txt
```
Device tree bindings for Zynq's eFuse Controller

The Zynq eFuse controller provides the access to the chip efuses which contain
information about device DNA, security settings and also device status.

Required properties:
 compatible: Compatibility string. Must be "xlnx,zynq-efuse".
 reg: Specify the base and size of the EFUSE controller registers
      in the memory map. E.g.: reg = <0xf800d000 0x20>;

Example:
efuse: efuse@f800d000 {
	compatible = "xlnx,zynq-efuse";
	reg = <0xf800d000 0x20>;
};
```

## Documentation/devicetree/bindings/clock/idt,idt8t49n24x.txt
```
Binding for IDT 8T49N24x Universal Frequency Translator

The 8T49N241 has one fractional-feedback PLL that can be used as a
jitter attenuator and frequency translator. It is equipped with one
integer and three fractional output dividers, allowing the generation
of up to four different output frequencies, ranging from 8kHz to 1GHz.
These frequencies are completely independent of each other, the input
reference frequencies and the crystal reference frequency. The device
places virtually no constraints on input to output frequency conversion,
supporting all FEC rates, including the new revision of ITU-T
Recommendation G.709 (2009), most with 0ppm conversion error.
The outputs may select among LVPECL, LVDS, HCSL or LVCMOS output levels.

The driver can read a full register map from the DT, and will use that
register map to initialize the attached part (via I2C) when the system
boots. Any configuration not supported by the common clock framework
must be done via the full register map, including optimized settings.

The 8T49N241 accepts up to two differential or single-ended input clocks
and a fundamental-mode crystal input. The internal PLL can lock to either
of the input reference clocks or just to the crystal to behave as a
frequency synthesizer. The PLL can use the second input for redundant
backup of the primary input reference, but in this case, both input clock
references must be related in frequency.

All outputs are currently assumed to be LVDS, unless overridden in the
full register map in the DT.

==I2C device node==

Required properties:
- compatible:	shall be one of "idt,idt8t49n241"
- reg:		i2c device address, shall be one of 0x7C, 0x6C, 0x7D, 0x6D,
		0x7E, 0x6E, 0x7F, 0x6F.
- #clock-cells: From common clock bindings: Shall be 1.

- clocks:	from common clock binding; input clock handle. Required.
- clock-names:	from common clock binding; clock input names, shall be
		one of "input-clk0", "input-clk1", "input-xtal". Required.

==Mapping between clock specifier and physical pins==

When referencing the provided clock in the DT using phandle and
clock specifier, the following mapping applies:

8T49N241:
	0 -- Q0
	1 -- Q1
	2 -- Q2
	3 -- Q3

==Example==

/* Example1: 25MHz input clock (via CLK0) */

ref25: ref25m {
	compatible = "fixed-clock";
	#clock-cells = <0>;
	clock-frequency = <25000000>;
};

i2c-master-node {

	/* IDT 8T49N241 i2c universal frequency translator */
	i2c241: clock-generator@6a {
		compatible = "idt,idt8t49n241";
		reg = <0x6c>;
		#clock-cells = <1>;

		/* Connect input-clk0 to 25MHz reference */
		clocks = <&ref25m>;
		clock-names = "input-clk0";
	};
};

/* Consumer referencing the 8T49N241 pin Q1 */
consumer {
	...
	clocks = <&i2c241 1>;
	...
}

/* Example2: 40MHz xtal frequency, specify all settings */

ref40: ref40m {
	compatible = "fixed-clock";
	#clock-cells = <0>;
	clock-frequency = <40000000>;
};

i2c-master-node {

	/* IDT 8T49N241 i2c universal frequency translator */
	i2c241: clock-generator@6a {
		compatible = "idt,idt8t49n241";
		reg = <0x6c>;
		#clock-cells = <1>;

		/* Connect input-xtal to 40MHz reference */
		clocks = <&ref40m>;
		clock-names = "input-xtal";

		settings=[
09 50 00 60 67 C5 6C FF 03 00 30 00 00 01 00 00
01 07 00 00 07 00 00 77 6D 06 00 00 00 00 00 FF
FF FF FF 00 3F 00 2A 00 16 33 33 00 01 00 00 D0
00 00 00 00 00 00 00 00 00 04 00 00 00 02 00 00
00 00 00 00 00 00 00 17 00 00 00 00 00 00 00 00
00 00 00 00 00 00 00 00 00 00 00 00 00 00 00 00
00 00 00 00 00 00 00 00 D7 0A 2B 20 00 00 00 0B
00 00 00 00 00 00 00 00 00 00 27 00 00 00 00 00
00 00 00 00 00 00 00 00 00 00 00 00 00 00 00 00
00 00 00 00 00 00 00 00 00 00 00 00 00 00 00 00
00 00 00 00 00 00 00 00 00 00 00 00 00 00 00 00
00 00 00 00 00 00 00 00 00 00 00 00 00 00 00 00
00 00 00 00 00 00 00 00 00 00 00 00 00 00 00 00
00 00 00 00 00 00 00 00 00 00 00 00 00 00 00 00
00 00 00 00 00 00 00 00 00 00 00 00 00 00 00 00
00 00 00 00 00 00 00 00 00 00 00 00 00 00 00 00
00 00 00 00 00 00 00 00 00 00 00 00 00 00 00 00
00 00 00 00 00 00 00 00 00 00 00 00 00 00 00 00
00 00 00 00 00 00 00 00 00 00 00 00 00 00 00 00
00 00 00 00 00 00 00 00 00 00 00 00 00 00 00 00
00 00 00 00 00 00 00 00 00 00 00 00 00 00 00 00
00 00 00 00 00 00 00 00 00 00 00 00 00 00 00 00
00 00 00 00 00 00 00 00 00 00 00 00 00 00 00 00
00 00 00 00 00 00 00 00 00 00 00 00 00 00 00 00
00 00 00 00 00 00 00 00 00 00 00 00 00 00 00 00
00 00 00 00 00 00 00 00 00 00 00 00 00 00 00 00
00 00 00 00 00 00 00 00 00 00 00 00 00 00 00 00
00 00 00 00 00 00 00 00 00 00 00 00 00 00 00 00
00 00 00 00 00 00 00 00 00 00 00 00 00 00 00 00
00 00 00 00 00 00 00 00 00 00 00 00 00 00 00 00
00 00 00 00 00 00 00 00 00 00 00 00 00 00 00 00
00 00 00 00 00 00 00 00 00 00 00 00 00 00 00 00
C3 00 08 01 00 00 00 00 00 00 00 00 00 30 00 00
00 0A 00 00 00 00 00 00 00 00 00 00 00 00 00 00
00 00 00 00 00 00 00 00 00 00 00 00 00 00 00 00
00 00 00 00 00 00 00 00 00 00 00 00 00 00 00 00
00 00 00 00 00 00 00 00 00 00 00 00 00 00 00 00
00 00 00 00 00 00 00 00 00 00 00 00 00 00 00 00
00 00 00 00 00 00 00 00 00 00 00 00 00 00 00 00
00 00 00 00 00 00 00 00 00 00 00 00 00 00 00 00
00 00 00 00 00 00 00 00 00 00 00 00 00 00 00 00
00 00 00 00 00 00 00 00 00 00 00 00 00 00 00 00
00 00 00 00 00 00 00 00 00 00 00 00 00 00 00 00
00 00 00 00 00 00 00 00 00 00 00 00 00 00 00 00
00 00 00 00 00 00 00 00 00 00 00 00 00 00 00 00
00 00 00 00 00 00 00 00 00 00 00 00 00 00 00 00
00 00 00 00 00 00 00 00 00 00 00 00 00 00 00 00
00 00 00 00 00 00 00 00 00 00 00 00 00 00 00 00
00 00 00 00 85 00 00 9C 01 D4 02 71 07 00 00 00
00 83 00 10 02 08 8C
];
	};
};
```

## Documentation/devicetree/bindings/clock/renesas,proxo.yaml
```yaml
# SPDX-License-Identifier: (GPL-2.0-only OR BSD-2-Clause)
%YAML 1.2
---
$id: http://devicetree.org/schemas/clock/renesas,proxo.yaml#
$schema: http://devicetree.org/meta-schemas/core.yaml#

title: Renesas ProXO Oscillator Device Tree Bindings

maintainers:
  - Alex Helms <alexander.helms.jy@renesas.com>

description:
  Renesas ProXO is a family of programmable ultra-low phase noise
  quartz-based oscillators.

properties:
  '#clock-cells':
    const: 0

  compatible:
    enum:
      - renesas,proxo-xp

  reg:
    maxItems: 1

  renesas,crystal-frequency:
    description: Internal crystal frequency, default is 50000000 (50MHz)
    $ref: /schemas/types.yaml#/definitions/uint32

required:
  - '#clock-cells'
  - compatible
  - reg

additionalProperties: false

examples:
  - |
    i2c {
      #address-cells = <1>;
      #size-cells = <0>;

      proxo: clock-controller@55 {
        compatible = "renesas,proxo-xp";
        reg = <0x55>;
        #clock-cells = <0>;
      };
    };
```

## Documentation/devicetree/bindings/clock/silabs,si5324.txt
```
Binding for Silicon Labs si5324, si5328 and si5319 programmable
I2C clock generator.

Reference
This binding uses the common clock binding[1].
The si5324 is programmable i2c low-bandwidth, jitter-attenuating, precision
clock multiplier with up to 2 output clocks. The internal structure can be
found in [2].
The internal pin structure of si5328 and si5319 can be found in [3].

[1] Documentation/devicetree/bindings/clock/clock-bindings.txt
[2] Si5324 Data Sheet
	http://www.silabs.com/Support%20Documents/TechnicalDocs/Si5324.pdf
[3] Si53xx Reference Manual
	http://www.silabs.com/Support%20Documents/TechnicalDocs/
	Si53xxReferenceManual.pdf

==I2C device node==

Required properties:
- compatible: should be one of
	"silabs,si5324"
	"silabs,si5319"
	"silabs,si5328"
- reg: i2c device address.
- #clock-cells: from common clock binding; shall be set to 1.
- clocks: from common clock binding; list of parent clock
  handles, clock name should be one of
	"xtal"
	"clkin1"
	"clkin2"
- #address-cells: shall be set to 1.
- #size-cells: shall be set to 0.

Optional properties:
- silabs,pll-source: pair of (number, source) for each pll. Allows
  to overwrite clock source of pll.

==Child nodes==

Each of the clock outputs can be overwritten individually by
using a child node to the I2C device node. If a child node for a clock
output is not set, the eeprom configuration is not overwritten.

Required child node properties:
- reg: number of clock output.
- clock-frequency: default output frequency at power on

Optional child node properties:
- silabs,drive-strength: output drive strength in mA, shall be one of {2,4,6,8}.

Example:
Following example describes the ZCU102 board with hdmi design which
uses si5319 as clock generator. XTAL is hard-wired on the board to act
as input clock with a frequency of 114.285MHz.

refhdmi: refhdmi {
	compatible = "fixed-clock";
	#clock-cells = <0>;
	clock-frequency = <114285000>;
};

/* Si5319 i2c clock generator */
si5319: clock-generator@68 {
	status = "okay";
	compatible = "silabs,si5319";
	reg = <0x68>;
	#address-cells = <1>;
	#size-cells = <0>;
	#clock-cells = <1>;
	clocks = <&refhdmi>;
	clock-names = "xtal";

	clk0 {
		reg = <0>;
		clock-frequency = <27000000>;
	};
};
```

## Documentation/devicetree/bindings/clock/xlnx,fclk.yaml
```yaml
# SPDX-License-Identifier: (GPL-2.0-only OR BSD-2-Clause)
%YAML 1.2
---
$id: http://devicetree.org/schemas/clock/xlnx,fclk.yaml#
$schema: http://devicetree.org/meta-schemas/core.yaml#

title: Xilinx PL clocks

maintainers:
  - Shubhrajyoti Datta <shubhrajyoti.datta@amd.com>

description:
  The clock consumer driver used for handle clocks between PS/PL but also
  provide a way to control clock from System Controller to DUT.

properties:
  compatible:
    const: xlnx,fclk

  clocks:
    maxItems: 1

required:
  - clocks

additionalProperties: false

examples:
  -
    clk {
      compatible = "xlnx,fclk";
      clocks = <&clkc 71>;
    };
```

## Documentation/devicetree/bindings/clock/xlnx,vcu.txt
```
LogicoreIP designed compatible with Xilinx ZYNQ family.
-------------------------------------------------------

General concept
---------------

LogicoreIP design to provide the isolation between processing system
and programmable logic. Also provides the list of register set to configure
the frequency.

Required properties:
- compatible: shall be one of:
	"xlnx,vcu"
	"xlnx,vcu-logicoreip-1.0"
- reg : The base offset and size of the VCU_PL_SLCR register space.
- clocks: phandle for aclk and pll_ref clocksource
- clock-names: The identification string, "aclk", is always required for
   the axi clock. "pll_ref" is required for pll.

Optional properties:
- reset-gpios : The GPIO used to reset the VCU, if available. Need use this
		reset gpio when in design 'vcu_resetn' is driven by gpio. See
		Documentation/devicetree/bindings/gpio/gpio.txt for details.

Example:

	xlnx_vcu: vcu@a0040000 {
		compatible = "xlnx,vcu-logicoreip-1.0";
		reg = <0x0 0xa0040000 0x0 0x1000>;
		reset-gpios = <&gpio 0x4e GPIO_ACTIVE_HIGH>;t
		clocks = <&si570_1>, <&clkc 71>;
		clock-names = "pll_ref", "aclk";
	};
```

## Documentation/devicetree/bindings/clock/xlnx,versal-clk.txt
```
--------------------------------------------------------------------------
Device Tree Clock bindings for the Xilinx Versal
--------------------------------------------------------------------------
The clock controller is a h/w block of Xilinx versal clock tree. It reads
required input clock frequencies from the devicetree and acts as clock provider
for all clock consumers of PS clocks.

See clock_bindings.txt for more information on the generic clock bindings.

Required properties:
 - #clock-cells:	Must be 1
 - compatible:		Must contain:	"xlnx,versal-clk"
 - clocks:		List of clock specifiers which are external input
			clocks to the given clock controller. Please refer
			the next section to find the input clocks for a
			given controller.
 - clock-names:		List of clock names which are exteral input clocks
			to the given clock controller. Please refer to the
			clock bindings for more details.

Input clocks for Xilinx Versal clock controller:

The Xilinx Versal has one primary and two alternative reference clock inputs.
These required clock inputs are:
 - ref_clk
 - alt_ref_clk
 - pl_alt_ref_clk

Output clocks are registered based on clock information received
from firmware. Output clocks indexes are mentioned in
include/dt-bindings/clock/xlnx-versal-clk.h.

-------
Example
-------

firmware {
	zynqmp_firmware: zynqmp-firmware {
		compatible = "xlnx,zynqmp-firmware";
		method = "smc";
		versal_clk: clock-controller {
			#clock-cells = <1>;
			compatible = "xlnx,versal-clk";
			clocks = <&ref_clk>, <&alt_ref_clk>, <&pl_alt_ref_clk>;
			clock-names = "ref_clk", "alt_ref_clk", "pl_alt_ref_clk";
		};
	};
};
```
