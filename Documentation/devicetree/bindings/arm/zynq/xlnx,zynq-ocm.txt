## Documentation/devicetree/bindings/display/xlnx/xlnx,dsi.txt
```
Device-Tree bindings for Xilinx MIPI DSI Tx IP core

The IP core supports transmission of video data in MIPI DSI protocol.

Required properties:
 - compatible: Should be "xlnx,dsi".

 - reg: Base address and size of the IP core.

 - xlnx,dsi-datatype: Color format. The value should be one of "MIPI_DSI_FMT_RGB888",
  "MIPI_DSI_FMT_RGB666", "MIPI_DSI_FMT_RGB666_PACKED" or "MIPI_DSI_FMT_RGB565".

 - simple_panel: The subnode for connected panel. This represents the
   DSI peripheral connected to the DSI host node. Please refer to
   Documentation/devicetree/bindings/display/mipi-dsi-bus.txt. The
   simple-panel driver has auo,b101uan01 panel timing parameters added along
   with other existing panels. DSI driver derive the required Tx IP controller
   timing values from the panel timing parameters.

 - port: Logical block can be used / connected independently with
   external device. In the display controller port nodes, topology
   for entire pipeline should be described using the DT bindings defined in
   Documentation/devicetree/bindings/graph.txt.

 - xlnx,dsi-num-lanes: Possible number of DSI lanes for the Tx controller.
   The values should be 1, 2, 3 or 4. Based on xlnx,dsi-num-lanes and
   line rate for the MIPI D-PHY core in Mbps, the AXI4-stream received by
   Xilinx MIPI DSI Tx IP core adds markers as per DSI protocol and the packet
   thus framed is convered to serial data by MIPI D-PHY core. Please refer
   Xilinx pg238 for more details. This value should be equal to the number
   of lanes supported by the connected DSI panel. Panel has to support this
   value or has to be programmed to the same value that DSI Tx controller is
   configured to.

Required simple_panel properties:
 - compatible: Value should be one of the panel names in
   Documentation/devicetree/bindings/display/panel/. e.g. "auo,b101uan01".
   For available panel compatible strings, please refer to bindings in
   Documentation/devicetree/bindings/display/panel/

Optional properties:
 - xlnx,vpss: vpss phandle
   This handle is required only when VPSS is connected to DSI as bridge.

Example:

#include <dt-bindings/drm/mipi-dsi.h>
	mipi_dsi_tx_subsystem@80000000 {
		compatible = "xlnx,dsi";
		reg = <0x0 0x80000000 0x0 0x10000>;
		xlnx,dsi-num-lanes = <4>;
		xlnx,dsi-data-type = <MIPI_DSI_FMT_RGB888>;
		#address-cells = <1>;
		#size-cells = <0>;
		xlnx,vpss = <&v_proc_ss_0>;
		encoder_dsi_port: port@0 {
			reg = <0>;
			dsi_encoder: endpoint {
				remote-endpoint = <&xyz_port>;
			};
		};
		simple_panel: simple-panel@0 {
			compatible = "auo,b101uan01";
			reg = <0>;
			};
		};
```

## Documentation/devicetree/bindings/display/xlnx/xlnx,dsi.yaml
```yaml
# SPDX-License-Identifier: (GPL-2.0-only OR BSD-2-Clause)
%YAML 1.2
---
$id: http://devicetree.org/schemas/display/xlnx/xlnx,dsi.yaml#
$schema: http://devicetree.org/meta-schemas/core.yaml#

title: Xilinx MIPI DSI Tx Subsystem

maintainers:
  - Katta Dhanunjanrao <katta.dhanunjanrao@amd.com>

description:
  The Xilinx MIPI DSI Tx Subsystem is used to display MIPI DSI-2
  traffic received in the form of AXI4 Stream video data.
  The subsystem consists of a MIPI D-PHY in master mode which receives the
  data packets from the MIPI DSI-2 Tx IP which encapsulates the
  packet data.
  For more details, please refer to PG238 Xilinx MIPI DSI-2 Tx Subsystem.

properties:
  compatible:
    const: xlnx,dsi

  reg:
    maxItems: 1

  interrupts:
    maxItems: 1

  clocks:
    description: List of clock specifiers
    items:
      - description: Video clock
      - description: AXIS Lite clock

  clock-names:
    items:
      - const: dphy_clk_200M
      - const: s_axis_aclk

  xlnx,dsi-data-type:
    description: |
      This denotes the CSI Data type selected in hw design.
      Packets other than this data type (except for RAW8 and
      User defined data types) will be filtered out.
      Possible values are as below:
      0 : RGB888
      1 : RGB666
      2 : RGB666_PACKED
      3 : RGB565
    $ref: /schemas/types.yaml#/definitions/uint32
    minimum: 0
    maximum: 3

  xlnx,dsi-num-lanes:
    description: |
      Possible number of DSI lanes for the Tx controller.
      Based on xlnx,dsi-num-lanes and line rate for the MIPI
      D-PHY core in Mbps, the AXI4-stream received by MIPI DSI
      Tx IP core adds markers as per DSI protocol and the packet
      thus frame is convered to serial data by MIPI D-PHY core.
      The possible values are:
      1       - For 1 lane enabled in IP.
      1 2     - For 2 lanes enabled in IP.
      1 2 3   - For 3 lanes enabled in IP.
      1 2 3 4 - For 4 lanes enabled in IP.
    $ref: /schemas/types.yaml#/definitions/uint32
    minimum: 1
    maximum: 4

  xlnx,dsi-cmd-mode:
    description: Denotes command mode enable.
    type: boolean

  xlnx,vpss:
    description: VPSS handle when its connected to DSI as bridge.
    maxItems: 1

  simple-panel:
    type: object
    description: Panel node that's connected to DSI-2 TX.
    allOf:
      - $ref: ../panel/panel-simple.yaml#
    required:
      - compatible
    unevaluatedProperties: false

  ports:
    type: object
    properties:
      "#address-cells":
        const: 1

      "#size-cells":
        const: 0

      port@0:
        type: object
        $ref: /schemas/graph.yaml#/properties/port
        description: Input / sink port node, single endpoint describing
                     the DSI-2 TX IP receiver.
        properties:
          reg:
            const: 0

          endpoint:
            type: object

            properties:
              remote-endpoint: true

            required:
              - remote-endpoint

            additionalProperties: false

        required:
          - reg
          - endpoint

        additionalProperties: false

    required:
      - "#address-cells"
      - "#size-cells"
      - port@0

    additionalProperties: false

required:
  - reg
  - clocks
  - clock-names
  - xlnx,dsi-num-lanes
  - xlnx,dsi-data-type
  - interrupts
  - simple-panel
  - ports

additionalProperties: false

examples:
  - |
    mipi_dsi_tx_subsystem@80000000 {
        compatible = "xlnx,dsi";
        reg = <0x80000000 0x10000>;
        clocks = <&misc_clk_0>, <&misc_clk_1>;
        clock-names = "dphy_clk_200M", "s_axis_aclk";
        xlnx,dsi-num-lanes = <4>;
        xlnx,dsi-data-type = <0>;
        xlnx,vpss = <&v_proc_ss_0>;
        interrupts = <0 108 4>;
        simple_panel: simple-panel {
            compatible = "auo,b101uan01";
            power-supply = <&vcc_lcd_reg>;
        };
        ports {
            #address-cells = <1>;
            #size-cells = <0>;
            port@0 {
               reg = <0>;
               dsi_encoder: endpoint {
                   remote-endpoint = <&xyz_port>;
               };
            };
        };
    };
```

## Documentation/devicetree/bindings/display/xlnx/xlnx,mixer.txt
```
Device-Tree bindings for Xilinx Video Mixer IP core

The IP core provides a flexible video processing block for alpha blending
and compositing multiple video and/or graphics layers.
Support for up to sixteen layers based on IP version, with an optional logo
layer, using a combination of video inputs from either frame buffer or
streaming video cores (through AXI4-Stream interfaces) is provided.
The Video Mixer always has one streaming input layer, known as master layer.

Required properties:
 - compatible: Must contain atleast one of
	"xlnx,mixer-5.0" (MIXER 5.0 version)
	"xlnx,mixer-4.0" (MIXER 4.0 version)
	"xlnx,mixer-3.0" (MIXER 3.0 version)
 - reg: Base address and size of the IP core.
 - interrupts: Interrupt number.
 - interrupts-parent: phandle for interrupt controller.
 - reset-gpio: gpio to reset the mixer IP
 - xlnx,enable-csc-coefficient-register: denotes colorimetry
   coefficients can be programmed, valid for mixer 5.0 version only.
 - xlnx,dma-addr-width: dma address width, valid values are 32 and 64
 - xlnx,bpc: bits per component for mixer
 - xlnx,ppc: pixel per clock for mixer
 - xlnx,num-layers: Total number of layers (excluding logo)
   Value ranges from 1-9 for compatible string xlnx,mixer-3.0 and
   Value ranges from 1-17 for comptaible string xlnx,mixer-4.0 and above
 - layer_[x]: node for [x] layer
 - xlnx,layer-id: layer identifier number
 - xlnx,vformat: video format for layer. See list of supported formats below.
 - xlnx,layer-max-width: max layer width, mandatory for master layer
   for overlay layers if scaling is alowed then this is mandatory otherwise
   not required for overlay layers. Valid range is 64 to 8192
 - xlnx,layer-max-height: max layer height, mandatory for master layer
   Not required for overlay layers. Valid range is 64 to 4320
 - xlnx,layer-primary: denotes the primary layer, should be mentioned in node
   of layer which is expected to be constructing the primary plane

Optional properties:
 - dmas: dma attach to layer, mandatory for master layer
   for rest other layers its optional
 - dma-names: Should be "dma0", for more details on DMA identifier string
   refer Documentation/devicetree/bindings/dma/dma.txt
 - xlnx,layer-streaming: denotes layer can be streaming,
   mandatory for master layer. Streaming layers need external dma, where
   as non streaming layers read directly from memory.
 - xlnx,layer-alpha: denotes layer can do alpha compositing
 - xlnx,layer-scale: denotes layer can be scale to 2x and 4x
 - xlnx,logo-layer: denotes logo layer is enable
 - logo: logo layer
 - xlnx,bridge: phandle to bridge node.
   This handle is required only when VTC is connected as bridge.

Supported Formats:
	Mixer IP Format		Driver supported Format String
	 BGR888			"RG24"
	 RGB888			"BG24"
	 XBGR2101010		"XB30"
	 XRGB8888		"XR24"
	 RGBA8888		"RA24"
	 ABGR8888		"AB24"
	 ARGB8888		"AR24"
	 XBGR8888		"XB24"
	 YUYV			"YUYV"
	 UYVY			"UYVY"
	 AYUV			"AYUV"
	 NV12			"NV12"
	 NV16			"NV16"
	 Y8			"GREY"
	 Y10			"Y10 " (Note: Space included)
	 XVUY2101010		"XV30"
	 VUY888			"VU24"
	 XVUY8888		"XV24"
	 XV15			"XV15"
	 XV20			"XV20"
Note : Format strings are case sensitive.

Example:
	v_mix_0: v_mix@80100000 {
		compatible = "xlnx,mixer-3.0";
		interrupt-parent = <&gic>;
		interrupts = <0 93 4>;
		reg = <0x0 0x80100000 0x0 0x80000>;

		xlnx,dma-addr-width=<32>;
		reset-gpios = <&gpio 1 1>;

		xlnx,bpc = <8>;
		xlnx,ppc = <2>;
		xlnx,num-layers = <8>;
		xlnx,logo-layer;
		xlnx,bridge = <&v_tc_0>;

		mixer_port: mixer_port@0 {
			reg = <0>;
			mixer_crtc: endpoint {
				remote-endpoint = <&sdi_encoder>;
			};
		};
		xv_mix_master: layer_0 {
			xlnx,layer-id = <0>;
			xlnx,vformat = "YUYV";
			xlnx,layer-max-width = <4096>;
			xlnx,layer-height = <2160>;
			dmas = <&axi_vdma_0 0>;
			dma-names = "dma0";
			xlnx,layer-streaming;
			xlnx,layer-primary;
		};
		xv_mix_overlay_1: layer_1 {
			xlnx,layer-id = <1>;
			xlnx,vformat = "NV16";
			xlnx,layer-alpha;
			xlnx,layer-scale;
			xlnx,layer-max-width=<1920>;
		};
		xv_mix_overlay_2: layer_2 {
			xlnx,layer-id = <2>;
			xlnx,vformat = "YUYV";
			xlnx,layer-alpha;
			xlnx,layer-scale;
			xlnx,layer-max-width=<1920>;
		};
		xv_mix_overlay_3: layer_3 {
			xlnx,layer-id = <3>;
			xlnx,vformat = "AYUV";
			xlnx,layer-alpha;
			xlnx,layer-scale;
			xlnx,layer-max-width=<1920>;
		};
		xv_mix_overlay_4: layer_4 {
			xlnx,layer-id = <4>;
			xlnx,vformat = "GREY";
			dmas = <&scaler_v_frmbuf_rd_0 0>;
			dma-names = "dma0";
			xlnx,layer-streaming;
			xlnx,layer-alpha;
			xlnx,layer-scale;
			xlnx,layer-max-width=<1920>;
		};
		xv_mix_overlay_5: layer_5 {
			xlnx,layer-id = <5>;
			xlnx,vformat = "AB24";
			xlnx,layer-alpha;
			xlnx,layer-scale;
			xlnx,layer-max-width=<1920>;
		};
		xv_mix_overlay_6: layer_6 {
			xlnx,layer-id = <6>;
			xlnx,vformat = "XB24";
			xlnx,layer-alpha;
			xlnx,layer-scale;
			xlnx,layer-max-width=<1920>;
			};
		xv_mix_overlay_7: layer_7 {
			xlnx,layer-id = <7>;
			xlnx,vformat = "BG24";
			xlnx,layer-alpha;
			xlnx,layer-scale;
			xlnx,layer-max-width=<1920>;
		};
		xv_mix_logo: logo {
			xlnx,layer-id = <8>;
			xlnx,logo-height = <64>;
			xlnx,logo-width = <64>;
		};
	};
```
