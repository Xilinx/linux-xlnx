## Documentation/devicetree/bindings/sound/xlnx,v-uhdsdi-audio.yaml
```yaml
# SPDX-License-Identifier: (GPL-2.0-only OR BSD-2-Clause)
# %YAML 1.2
---
$id: http://devicetree.org/schemas/sound/xlnx,v-uhdsdi-audio.yaml#
$schema: http://devicetree.org/meta-schemas/core.yaml#

title: Xilinx UHD SDI Playback/Capture audio system

maintainers:
  - Katta Dhanunjanrao <katta.dhanunjanrao@amd.com>

description:
  The IP core supports UHD SDI Embed/Extract of audio in SDI Tx and Rx protocol respectively.
  Please note that v1.0 (xlnx,v-uhdsdi-audio-1.0) is deprecated and driver no longer supports it.
  Mandatory to upgrade to v2.0.
  Refer to the documentation -
  https://www.xilinx.com/support/documentation/ip_documentation/v_uhdsdi_audio/v1_0/pg309-v-uhdsdi-audio.pdf

properties:
  compatible:
    const: xlnx,v-uhdsdi-audio-2.0

  reg:
    maxItems: 1

  interrupts:
    maxItems: 1

  clocks:
    description: List of phandles to AXI lite, sdi embed  and axi stream clock.
    items:
      - description: AXI lite clock.
      - description: AXI stream clock.
          - s_axis_clk is clock for audio embed.
          - m_axis_clk is clock for audio extract.
      - description: SDI embed/extract clock.
          - sdi_embed_clk is used for embedding the audio into SDI stream(Tx).
          - sdi_extract_clk is used for extracting the audio from SDI stream(Rx).

  clock-names:
    items:
      - const: s_axi_aclk
      - enum: [s_axis_clk, m_axis_clk]
      - enum: [sdi_embed_clk, sdi_extract_clk]

  xlnx,snd-pcm:
    description: Reference to audio formatter block.
    $ref: /schemas/types.yaml#/definitions/phandle

  ports:
    type: object

    properties:
      "#address-cells":
        const: 1

      "#size-cells":
        const: 0

      port@0:
        type: object
        description: Output / source port node, endpoint describing modules
                     connected the SDI Audio Embed.
        properties:
          reg:
            const: 0

          endpoint:
            type: object

            properties:
              remote-endpoint: true

            required:
              - remote-endpoint

            additionalProperties: false

        additionalProperties: false

    additionalProperties: false

required:
  - reg
  - clock-names
  - clocks
  - interrupts
  - xlnx,snd-pcm

allOf:
  - if:
      properties:
        clock-names:
          contains:
            const: s_axis_clk
    then:
      properties:
        clock-names:
          contains:
            const: sdi_embed_clk

      required:
        - ports
    else:
      properties:
        clock-names:
          contains:
            const: sdi_extract_clk

additionalProperties: false

examples:
  - |
    v-uhdsdi-audio@80090000 {
        compatible = "xlnx,v-uhdsdi-audio-2.0";
        reg = <0x80090000 0x10000>;
        clock-names = "s_axi_aclk", "s_axis_clk", "sdi_embed_clk";
        clocks = <&misc_clk_0>, <&misc_clk_0>, <&misc_clk_1>;
        interrupts = <0 107 4>;
        xlnx,snd-pcm = <&audio_formatter>;
        ports {
            #address-cells = <1>;
            #size-cells = <0>;
            port@0 {
                reg = <0>;
                endpoint {
                    remote-endpoint = <&sdi_audio_sink_port>;
                };
            };
        };
    };
    v-uhdsdi-audio@80080000 {
        compatible = "xlnx,v-uhdsdi-audio-2.0";
        reg = <0x80080000 0x10000>;
        clock-names = "s_axi_aclk", "m_axis_clk", "sdi_extract_clk";
        clocks = <&misc_clk_0>, <&misc_clk_0>, <&misc_clk_1>;
        interrupts = <0 106 4>;
        xlnx,snd-pcm = <&audio_formatter>;
    };
...
```

## Documentation/devicetree/bindings/spi/spi-cadence.txt
```
Cadence SPI controller Device Tree Bindings
-------------------------------------------

Required properties:
- compatible		: Should be "cdns,spi-r1p6".
- reg			: Physical base address and size of SPI registers map.
- interrupts		: Property with a value describing the interrupt
			  number.
- interrupt-parent	: Must be core interrupt controller
- clock-names		: List of input clock names - "ref_clk", "pclk"
			  (See clock bindings for details).
- clocks		: Clock phandles (see clock bindings for details).
- num-chip-select	: Number of chip selects used.

Example:

	spi_1: spi@e0007000 {
		clock-names = "ref_clk", "pclk";
		clocks = <&clkc 26>, <&clkc 35>;
		compatible = "cdns,spi-r1p6";
		interrupt-parent = <&intc>;
		interrupts = <0 49 4>;
		num-chip-select = <4>;
		reg = <0xe0007000 0x1000>;
	} ;
```

## Documentation/devicetree/bindings/spi/spi-xilinx.txt
```
Xilinx SPI controller Device Tree Bindings
-------------------------------------------------

Required properties:
- compatible		: Should be "xlnx,xps-spi-2.00.a", "xlnx,xps-spi-2.00.b" or "xlnx,axi-quad-spi-1.00.a"
- reg			: Physical base address and size of SPI registers map.
- interrupts		: Property with a value describing the interrupt
			  number.
- fifo-size		: Depth of TX/RX Fifos

Optional properties:
- num-cs		: Number of chip selects used.
- bits-per-word		: Number of bits per word.
- clock-names		: Can be one or more strings from "axi_clk", "axi4_clk"
			  and "spi_clk" depending on IP configurations.
- clocks		: Input clock specifier. Refer to common clock bindings.
- xlnx,startup-block	: Indicates whether startup block is enabled or disabled.

Example:
	axi_quad_spi@41e00000 {
			compatible = "xlnx,xps-spi-2.00.a";
			clock-names = "axi_clk", "axi4_clk", "spi_clk";
			clocks = <&clkc 71>, <&clkc 72>, <&clkc 73>;
			interrupt-parent = <&intc>;
			interrupts = <0 31 1>;
			reg = <0x41e00000 0x10000>;
			num-cs = <0x1>;
			fifo-size = <256>;
			bits-per-word = <8>;
			xlnx,startup-block;
	};
```

## Documentation/devicetree/bindings/spi/spi-zynqmp-qspi.txt
```
Xilinx Zynq UltraScale+ MPSoC GQSPI controller Device Tree Bindings
-------------------------------------------------------------------

Required properties:
- compatible		: Should be "xlnx,zynqmp-qspi-1.0" for zynqmp or
			  "xlnx,versal-qspi-1.0" for versal.
- reg			: Physical base address and size of GQSPI registers map.
- interrupts		: Property with a value describing the interrupt
			  number.
- clock-names		: List of input clock names - "ref_clk", "pclk"
			  (See clock bindings for details).
- clocks		: Clock phandles (see clock bindings for details).

Optional properties:
- num-cs		: Number of chip selects used.
- has-io-mode		: boolean property describes the controller operating
			  mode. if exists controller will operate in IO mode
			  else dma mode.
- is-dual		: zynqmp qspi support for dual-parallel mode configuration
			  value should be 1.
- is-stacked		: zynqmp qspi support for stacked mode configuration.
			  to enable this mode, is-dual should be 0 and is-stacked
			  should be 1.

Example:
	qspi: spi@ff0f0000 {
		compatible = "xlnx,zynqmp-qspi-1.0";
		clock-names = "ref_clk", "pclk";
		clocks = <&misc_clk &misc_clk>;
		interrupts = <0 15 4>;
		interrupt-parent = <&gic>;
		num-cs = <1>;
		reg = <0x0 0xff0f0000 0x1000>,<0x0 0xc0000000 0x8000000>;
	};
```

## Documentation/devicetree/bindings/spi/xlnx,zynq-qspi.yaml
```yaml
# SPDX-License-Identifier: (GPL-2.0-only OR BSD-2-Clause)
%YAML 1.2
---
$id: http://devicetree.org/schemas/spi/xlnx,zynq-qspi.yaml#
$schema: http://devicetree.org/meta-schemas/core.yaml#

title: Xilinx Zynq QSPI controller

description:
  The Xilinx Zynq QSPI controller is used to access multi-bit serial flash
  memory devices.

allOf:
  - $ref: "spi-controller.yaml#"

maintainers:
  - Michal Simek <michal.simek@xilinx.com>

# Everything else is described in the common file
properties:
  compatible:
    const: xlnx,zynq-qspi-1.0

  reg:
    maxItems: 1

  interrupts:
    maxItems: 1

  clocks:
    items:
      - description: reference clock
      - description: peripheral clock

  clock-names:
    items:
      - const: ref_clk
      - const: pclk

  is-dual:
    $ref: /schemas/types.yaml#/definitions/uint32
    description:
      The flash devices are connected in parallel,
      and value should be 1.

  is-stacked:
    $ref: /schemas/types.yaml#/definitions/uint32
    description:
      The flash devices are connected in stacked,
      to enable this mode, is-dual should be 0
      and is-stacked should be 1.

required:
  - compatible
  - reg
  - interrupts
  - clocks
  - clock-names

unevaluatedProperties: false

examples:
  - |
    spi@e000d000 {
        compatible = "xlnx,zynq-qspi-1.0";
        reg = <0xe000d000 0x1000>;
        interrupt-parent = <&intc>;
        interrupts = <0 19 4>;
        clock-names = "ref_clk", "pclk";
        clocks = <&clkc 10>, <&clkc 43>;
        num-cs = <1>;
        is-dual = <0x00>;
        is-stacked = <0x01>;
    };
```

## Documentation/devicetree/bindings/staging/display/amd,mmi-dptx.yaml
```yaml
# SPDX-License-Identifier: (GPL-2.0-only OR BSD-2-Clause)
%YAML 1.2
---
$id: http://devicetree.org/schemas/staging/display/amd,mmi-dptx.yaml#
$schema: http://devicetree.org/meta-schemas/core.yaml#

title: AMD Multimedia Integrated Display Port Transmitter.

description:
  The AMD Multimedia Integrated DisplayPort Tx subsystem block implements the
  DisplayPort transmitter and outputs video data using DisplayPort protocol.

maintainers:
  - Vishal Sagar <vishal.sagar@amd.com>

properties:
  compatible:
    const: amd,mmi-dptx-1.0

  reg:
    items:
      - description: dptx registers
      - description: hdcp registers

  reg-names:
    items:
      - const: dp
      - const: hdcp

  interrupts:
    items:
      - description: DP Tx event
      - description: HDCP event

  interrupt-names:
    items:
      - const: dptx
      - const: hdcp

  clocks:
    items:
      - description: APB Clock
      - description: Video pixel clock
      - description: Audio i2s clock

  clock-names:
    items:
      - const: apb_clk
      - const: pixel_clk
      - const: i2s_clk

  xlnx,hdcp-1x:
    type: boolean
    description: boolean present when HDCP version is 1.3.

  xlnx,hdcp-2x:
    type: boolean
    description: boolean present when HDCP version is 2.3.

  xlnx,dptx-streams:
    description: number of input streams to DP Tx
    $ref: /schemas/types.yaml#/definitions/uint32
    enum: [1, 2, 4]

  xlnx,dptx-pixel-mode:
    description: Pixels per clock
    $ref: /schemas/types.yaml#/definitions/uint32
    enum: [1, 2, 4]

  xlnx,dp-lanes:
    description: Number of lanes for DP
    $ref: /schemas/types.yaml#/definitions/uint32
    enum: [1, 2, 4]

  ports:
    $ref: /schemas/graph.yaml#/properties/ports
    description:
      Connections to the Display Controller(DC) and DP monitor. Each port
      shall have a single endpoint. Initial 4 are gets input from DC.
      Next 1 is output port connected to DP monitor.

    properties:
      "#address-cells":
        const: 1

      "#size-cells":
        const: 0

    patternProperties:
      "^port@([0-3])$":
        type: object
        description:
          Input port number, describing input coming from DC.
          port 0 is blended video output from DisplayPort Tx
          port 1-3 are connected in bypass / MST mode only.

        properties:
          reg:
            enum: [0, 1, 2, 3]

          endpoint:
            type: object

            properties:
              remote-endpoint: true

            required:
              - remote-endpoint

            additionalProperties: false

        required:
          - reg
          - endpoint

        additionalProperties: false

    required:
      - "#address-cells"
      - "#size-cells"
      - port@0

required:
  - compatible
  - reg
  - reg-names
  - interrupts
  - interrupt-names
  - ports

additionalProperties: false

examples:
  - |
    axi {
        #address-cells = <2>;
        #size-cells = <2>;

        mmi_dptx@ede00000 {
            compatible = "amd,mmi-dptx-1.0";
            reg = <0x0 0xede00000 0x0 0x40000>, <0x0 0xedeb0000 0x0 0x100>;
            reg-names = "dp", "hdcp";
            interrupts = <0 178 4>, <0 167 4>;
            interrupt-names = "dptx", "hdcp";
            interrupt-parent = <&imux>;
            clocks = <&mmi_apb_clk>, <&mmi_pixel_clk>, <&mmi_i2s_clk>;
            clock-names = "apb_clk", "pixel_clk", "i2s_clk";

            xlnx,dp-lanes = <2>;

            ports {
                #address-cells = <1>;
                #size-cells = <0>;

                port@0 {
                    reg = <0>;
                    dptx_in_0: endpoint {
                        remote-endpoint = <&dc_out_0>;
                    };
                };
                port@1 {
                    reg = <1>;
                    dptx_in_1: endpoint {
                        remote-endpoint = <&dc_out_1>;
                    };
                };
                port@2 {
                    reg = <2>;
                    dptx_in_2: endpoint {
                        remote-endpoint = <&dc_out_2>;
                    };
                };
                port@3 {
                    reg = <3>;
                    dptx_in_3: endpoint {
                        remote-endpoint = <&dc_out_3>;
                    };
                };
            };
        };
    };
...
```

## Documentation/devicetree/bindings/staging/net/xilinx-tsn-ethernet.txt
```
Xilinx TSN (time sensitive networking) TEMAC axi ethernet driver (xilinx_axienet)
-----------------------------------------------------------------------

Required properties:
- compatible		: Should be "xlnx,tsn-ethernet-1.00.a".
- reg			: Physical base address and size of the TSN registers map.
- interrupts		: Property with a value describing the interrupt
			  number.
- interrupts-names	: Property denotes the interrupt names.
- interrupt-parent	: Must be core interrupt controller.
- phy-handle		: See ethernet.txt file [1].
- local-mac-address	: See ethernet.txt file [1].
- phy-mode		: see ethernet.txt file [1].

Optional properties:
- xlnx,tsn		: Denotes a ethernet with TSN capabilities.
- xlnx,tsn-slave	: Denotes a TSN slave port.
- xlnx,txcsum		: Tx checksum mode (Full, Partial and None).
- xlnx,rxcsum		: Rx checksum mode (Full, Partial and None).
- xlnx,phy-type		: Xilinx phy device type. See xilinx-phy.txt [2].
- xlnx,eth-hasnobuf	: Used when 1G MAC is configured in non-processor mode.
- xlnx,num-queue	: Number of queue supported in current design, range is
			  2 to 5 and default value is 5.
- xlnx,num-tc		: Number of traffic class supported in current design,
			  range is 2,3 and default value is 3. It denotes
			  the traffic classes based on VLAN-PCP value.
- xlnx,qbv-addr		: Denotes mac scheduler physical base address.
- xlnx,qbv-size		: Denotes mac scheduler address space size.

[1] Documentation/devicetree/bindings/net/ethernet.txt
[2] Documentation/devicetree/bindings/net/xilinx-phy.txt

Example:

	tsn_emac_0: tsn_mac@80040000 {
		compatible = "xlnx,tsn-ethernet-1.00.a";
		interrupt-parent = <&gic>;
		interrupts = <0 104 4 0 106 4 0 91 4 0 110 4>;
		interrupt-names = "interrupt_ptp_rx_1", "interrupt_ptp_tx_1", "mac_irq_1", "interrupt_ptp_timer";
		local-mac-address = [ 00 0A 35 00 01 0e ];
		phy-mode = "rgmii";
		reg = <0x0 0x80040000 0x0 0x14000>;
		tsn,endpoint = <&tsn_ep>;
		xlnx,tsn;
		xlnx,tsn-slave;
		xlnx,phy-type = <0x3>;
		xlnx,eth-hasnobuf;
		xlnx,num-queue = <0x2>;
		xlnx,num-tc = <0x3>;
		xlnx,qbv-addr = <0x80054000>;
		xlnx,qbv-size = <0x2000>;
		xlnx,txsum = <0>;
		xlnx,rxsum = <0>;
	};
```
