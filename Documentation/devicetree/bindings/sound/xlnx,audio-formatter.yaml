## Documentation/devicetree/bindings/staging/net/xilinx_tsn_ep.txt
```
Xilinx TSN (time sensitive networking) EndPoint Driver (xilinx_tsn_ep)
-------------------------------------------------------------------------------

Required properties:
- compatible		: Should be "xlnx,tsn-ep"
- reg			: Physical base address and size of the TSN Endpoint
				registers map
- interrupts		: Property with a value describing the interrupt
- interrupts-names	: Property denotes the interrupt names.
- interrupt-parent	: Must be core interrupt controller.
- xlnx,tsn-tx-config	: Multiple TX Queue parameters. Phandle to a node that
			  implements the 'tx-queues-config'.
- xlnx,num-tc		: Number of traffic class supported in current design,
			  range is [2, 8]. It denotes the traffic classes based
			  on VLAN-PCP value.

Optional properties:
- xlnx,channel-ids 	: Queue Identifier associated with the MCDMA Channel, range
			  is Tx: "1 to 2" and Rx: "2 to 5", default value is "1 to 5".
- xlnx,eth-hasnobuf	: Used when 1G MAC is configured in non processor mode.
- axistream-connected-rx	: Reference to another node which contains the
				  resources for the MCDMA controller used by
				  this device. The MCDMA related resources
				  (registers and interrupts) will be used from
				  this node.

Required TX Queues config properties:
- xlnx,num-tx-queues	: Number of TX queues to be used and it should match with
			  the number of traffic classes supported.
- xlnx,dma-channel-num	: DMA channel id connected to the TX queue.

Optional TX Queues config properties:
- xlnx,is-tadma		: Defined when the TX queue is connected with TADMA channel.

Optional TADMA properties:
- xlnx,num-buffers-per-stream	: Number of TADMA buffers per stream in design. Default is 64.
- xlnx,num-streams		: Number of streams. Default is 8.
- xlnx,num-fetch-entries	: Maximum number of entries that can be programmed to be
				  fetched by TADMA. Default is 8.
- axistream-connected-tx	: Reference to another node which contains the
				  resources for the TADMA controller used by
				  this device. The TADMA-related resources
				  (registers and interrupts) will be used from
				  this node.

Optional MCDMA properties:
- xlnx,num-mm2s-channels	: Number of MM2S(read) channels in MCDMA
- xlnx,num-s2mm-channels	: Number of S2MM(write) channels in MCDMA

[1] Documentation/devicetree/bindings/net/ethernet.txt

Example:

	tsn_ep: tsn_ep@80056000 {
		compatible = "xlnx,tsn-ep";
		reg = <0x0 0x80056000 0x0 0xA000>;
		xlnx,num-tc = <0x3>;
		interrupt-names = "tsn_ep_scheduler_irq";
		interrupt-parent = <&gic>;
		interrupts = <0 111 4>;
		local-mac-address = [00 0A 35 00 01 10];
		xlnx,channel-ids = "1","2","3","4","5";
		xlnx,eth-hasnobuf ;
		xlnx,tsn-tx-config = <&tsn_tx_config>;
	};

	tsn_tx_config: tx-queues-config {
		xlnx,num-tx-queues = <0x8>;
		queue0 {
			xlnx,dma-channel-num = <0x6>;
		};
		queue1 {
			xlnx,dma-channel-num = <0x5>;
		};
		queue2 {
			xlnx,dma-channel-num = <0x4>;
		};
		queue3 {
			xlnx,dma-channel-num = <0x3>;
		};
		queue4 {
			xlnx,dma-channel-num = <0x2>;
		};
		queue5 {
			xlnx,dma-channel-num = <0x1>;
		};
		queue6 {
			xlnx,is-tadma;
			xlnx,dma-channel-num = <0x1>;
		};
		queue7 {
			xlnx,is-tadma;
			xlnx,dma-channel-num = <0x0>;
		};
	};
```

## Documentation/devicetree/bindings/staging/net/xilinx_tsn_ep_ex.txt
```
Xilinx TSN (time sensitive networking) Extended EndPoint Driver (xilinx_tsn_ep_ex)
-------------------------------------------------------------------------------

Required properties:
- compatible		: Should be "xlnx,tsn-ex-ep"
- reg			: Physical base address and size of the TSN Endpoint
				registers map
- local-mac-address	: See ethernet.txt [1].

Optional properties:
- packet-switch		: set to 1 when packet switching on ex-ep is
			  enabled in the design.
			  This property deprecated.
			  To identify the packet switching feature is enabled
			  or not in the design, please use the
			  xlnx, packet-switch property from the switch node
			  instead of packet-switch property.
- tsn,endpoint		: This is a handle to the endpoint node.
			  The necessary ep resource details are obtained
			  from this reference.

[1] Documentation/devicetree/bindings/net/ethernet.txt

Example:

	tsn_ep_ex: tsn_ep_ex@80056000 {
		compatible = "xlnx,tsn-ex-ep";
		reg = <0x0 0x80056000 0x0 0xA000>;
		local-mac-address = [00 0A 35 00 01 20];
		tsn,endpoint = <&tsn_ep>;
	};
```

## Documentation/devicetree/bindings/thermal/xlnx,versal-thermal.yaml
```yaml
# SPDX-License-Identifier: (GPL-2.0-only OR BSD-2-Clause)
# Copyright 2024 Advanced Micro Devices Inc.
%YAML 1.2
---
$id: http://devicetree.org/schemas/thermal/xlnx,versal-thermal.yaml#
$schema: http://devicetree.org/meta-schemas/core.yaml#

title: Xilinx Versal Thermal

maintainers:
  - Salih Erim <salih.erim@amd.com>

description:
  Versal Thermal uses Versal Sysmon hardware for temperature reading
  It works as sensor interface to be defined in thermal zones.
  IIO binding channel through Sysmon required to use as temperature
  sensor. It takes temperature values from versal processing system
  sysmon and satellite sysmon sensors close to AI Engine through IIO
  channels. Exposed temperature value is converted to millicelcius scale.

properties:
  compatible:
    const: xlnx,versal-thermal

  '#thermal-sensor-cells':
    const: 1

  io-channels:
    maxItems: 1

  io-channel-names:
    const: sysmon-temp-channel

required:
  - compatible
  - '#thermal-sensor-cells'
  - io-channels
  - io-channel-names

additionalProperties: false

examples:
  - |
    thermal-sensor {
        compatible = "xlnx,versal-thermal";
        #thermal-sensor-cells = <1>;
        io-channels = <&sysmon0 15>, <&sysmon0 7>, <&sysmon0 8>,
                      <&sysmon0 9>, <&sysmon0 10>, <&sysmon0 11>,
                      <&sysmon0 12>, <&sysmon0 13>, <&sysmon0 14>;
        io-channel-names = "sysmon-temp-channel", "aie-temp-ch1",
                           "aie-temp-ch2", "aie-temp-ch3", "aie-temp-ch4",
                           "aie-temp-ch5", "aie-temp-ch6", "aie-temp-ch7",
                           "aie-temp-ch8";
    };
...
```

## Documentation/devicetree/bindings/ufs/amd,versal2-ufs.yaml
```yaml
# SPDX-License-Identifier: (GPL-2.0-only OR BSD-2-Clause)
%YAML 1.2
---
$id: http://devicetree.org/schemas/ufs/amd,versal2-ufs.yaml#
$schema: http://devicetree.org/meta-schemas/core.yaml#

title: AMD Versal Gen 2 UFS Host Controller

maintainers:
  - Sai Krishna Potthuri <sai.krishna.potthuri@amd.com>

allOf:
  - $ref: ufs-common.yaml

properties:
  compatible:
    const: amd,versal2-ufs

  reg:
    maxItems: 1

  clocks:
    maxItems: 3

  clock-names:
    items:
      - const: core_clk
      - const: phy_clk
      - const: ref_clk

  resets:
    minItems: 2
    maxItems: 2

  reset-names:
    items:
      - const: ufshc-rst
      - const: ufsphy-rst

required:
  - compatible
  - reg
  - clocks
  - clock-names
  - resets
  - reset-names

unevaluatedProperties: false

examples:
  - |
    #include <dt-bindings/interrupt-controller/arm-gic.h>
    ufs@f10b0000 {
        compatible = "amd,versal2-ufs";
        reg = <0xf10b0000 0x1000>;
        interrupts = <GIC_SPI 234 IRQ_TYPE_LEVEL_HIGH>;
        clocks = <&ufs_core_clk>, <&ufs_phy_clk>, <&ufs_ref_clk>;
        clock-names = "core_clk", "phy_clk", "ref_clk";
        freq-table-hz = <0 0>, <0 0>, <0 0>;
        resets = <&scmi_reset 4>, <&scmi_reset 35>;
        reset-names = "ufshc-rst", "ufsphy-rst";
    };
```

## Documentation/devicetree/bindings/uio/xilinx_apm.txt
```
* Xilinx AXI Performance monitor IP

Required properties:
- compatible: "xlnx,axi-perf-monitor"
- interrupts: Should contain APM interrupts.
- interrupt-parent: Must be core interrupt controller.
- reg: Should contain APM registers location and length.
- xlnx,enable-profile: Enables the profile mode.
- xlnx,enable-trace: Enables trace mode.
- xlnx,num-monitor-slots: Maximum number of slots in APM.
- xlnx,enable-event-count: Enable event count.
- xlnx,enable-event-log: Enable event logging.
- xlnx,have-sampled-metric-cnt:Sampled metric counters enabled in APM.
- xlnx,num-of-counters: Number of counters in APM
- xlnx,metric-count-width: Metric Counter width (32/64)
- xlnx,metrics-sample-count-width: Sampled metric counter width
- xlnx,global-count-width: Global Clock counter width
- clocks: Input clock specifier.

Optional properties:
- xlnx,id-filter-32bit: APM is in 32-bit mode

Example:
++++++++

apm: apm@44a00000 {
    compatible = "xlnx,axi-perf-monitor";
    interrupt-parent = <&axi_intc_1>;
    interrupts = <1 2>;
    reg = <0x44a00000 0x1000>;
    clocks = <&clkc 15>;
    xlnx,enable-profile = <0>;
    xlnx,enable-trace = <0>;
    xlnx,num-monitor-slots = <4>;
    xlnx,enable-event-count = <1>;
    xlnx,enable-event-log = <1>;
    xlnx,have-sampled-metric-cnt = <1>;
    xlnx,num-of-counters = <8>;
    xlnx,metric-count-width = <32>;
    xlnx,metrics-sample-count-width = <32>;
    xlnx,global-count-width = <32>;
    xlnx,metric-count-scale = <1>;
    xlnx,id-filter-32bit;
};
```

## Documentation/devicetree/bindings/usb/dwc3-xilinx.txt
```
Xilinx SuperSpeed DWC3 USB SoC controller

Required properties:
- compatible:	May contain "xlnx,zynqmp-dwc3" or "xlnx,versal-dwc3"
- reg:		Base address and length of the register control block
- clocks:	A list of phandles for the clocks listed in clock-names
- clock-names:	Should contain the following:
  "bus_clk"	 Master/Core clock, have to be >= 125 MHz for SS
		 operation and >= 60MHz for HS operation

  "ref_clk"	 Clock source to core during PHY power down
- resets:	A list of phandles for resets listed in reset-names
- reset-names:
  "usb_crst"	 USB core reset
  "usb_hibrst"	 USB hibernation reset
  "usb_apbrst"	 USB APB reset

Required child node:
A child node must exist to represent the core DWC3 IP block. The name of
the node is not important. The content of the node is defined in dwc3.txt.

Optional properties for snps,dwc3:
- dma-coherent:	Enable this flag if CCI is enabled in design. Adding this
		flag configures Global SoC bus Configuration Register and
		Xilinx USB 3.0 IP - USB coherency register to enable CCI.
- interrupt-names: Should contain the following:
  "dwc_usb3"	USB gadget mode interrupts
  "otg"		USB OTG mode interrupts
  "hiber"	USB hibernation interrupts
- reset-gpios: Should specify mode-pin GPIO for reset.

Example device node:

		usb@0 {
			#address-cells = <0x2>;
			#size-cells = <0x1>;
			compatible = "xlnx,zynqmp-dwc3";
			reg = <0x0 0xff9d0000 0x0 0x100>;
			clock-names = "bus_clk" "ref_clk";
			clocks = <&clk125>, <&clk125>;
			resets = <&zynqmp_reset ZYNQMP_RESET_USB0_CORERESET>,
				 <&zynqmp_reset ZYNQMP_RESET_USB0_HIBERRESET>,
				 <&zynqmp_reset ZYNQMP_RESET_USB0_APB>;
			reset-names = "usb_crst", "usb_hibrst", "usb_apbrst";
			reset-gpio = <&modepin_gpio 1 0>;
			ranges;

			dwc3@fe200000 {
				compatible = "snps,dwc3";
				reg = <0x0 0xfe200000 0x40000>;
				interrupt-names = "dwc_usb3", "otg", "hiber";
				interrupts = <0 65 4>, <0 69 4>, <0 75 4>;
				dr_mode = "host";
				dma-coherent;
			};
		};
```

## Documentation/devicetree/bindings/usb/ehci-xilinx.txt
```
Xilinx USB EHCI controller

Required properties:
- compatible: must be "xlnx,xps-usb-host-1.00.a"
- reg: physical base address of the controller and length of memory mapped
  region.
- interrupts: The EHCI interrupt

Optional properties:
- xlnx,ext-vbus-valid: Use external VBUS
- xlnx,support-usb-fs: Support for Full Speed USB
- xlnx,use-phy-bus-pwr: Use phy bus power in USB

Example:

	xps_usb_host_0: usb@82400000 {
		compatible = "xlnx,xps-usb-host-1.00.a";
		interrupt-parent = <&xps_intc_0>;
		interrupts = < 0 2 >;
		reg = < 0x82400000 0x200 >;
	} ;
```

## Documentation/devicetree/bindings/usb/microchip,usb2244.yaml
```yaml
# SPDX-License-Identifier: (GPL-2.0-only OR BSD-2-Clause)
%YAML 1.2
---
$id: "http://devicetree.org/schemas/usb/microchip,usb2244.yaml#"
$schema: "http://devicetree.org/meta-schemas/core.yaml#"

title: Bindings for the Microchip USB2244 Ultra Fast USB-SD Controller

description:
  Microchip’s USB224x is a USB 2.0 compliant, Hi-Speed bulk only mass
  storage class peripheral controller intended for reading and writing
  to popular flash media from the xDPicture Card™, Memory Stick® (MS),
  Secure Digital (SD), and MultiMediaCard™ (MMC) families.

  USB224x is a flash media card reader solution fully compliant with the
  USB 2.0 specification

maintainers:
  - Piyush Mehta <piyush.mehta@xilinx.com>

properties:
  compatible:
    const: microchip,usb2244

  reset-gpios:
    maxItems: 1
    description:
      The phandle and specifier for the GPIO that controls the RESET line of
      flash media controller.

required:
  - compatible

additionalProperties: false

examples:
  - |
    #include <dt-bindings/gpio/gpio.h>

    usb {
       compatible = "microchip,usb2244";
       reset-gpios = <&gpio 2 GPIO_ACTIVE_LOW>;
    };
```

## Documentation/devicetree/bindings/usb/microchip,usb5744.yaml
```yaml
# SPDX-License-Identifier: (GPL-2.0-only OR BSD-2-Clause)
%YAML 1.2
---
$id: "http://devicetree.org/schemas/usb/microchip,usb5744.yaml#"
$schema: "http://devicetree.org/meta-schemas/core.yaml#"

title: Bindings for the Microchip USB5744 4-port Hub Controller

description:
  Microchip’s USB5744 SmartHub™ IC is a 4 port, SuperSpeed (SS)/Hi-Speed (HS),
  low power, low pin count configurable and fully compliant with the USB 3.1
  Gen 1 specification. The USB5744 also supports Full Speed (FS) and Low Speed
  (LS) USB signaling, offering complete coverage of all defined USB operating
  speeds. The new SuperSpeed hubs operate in parallel with the USB 2.0
  controller, so 5 Gbps SuperSpeed data transfers are not affected by slower
  USB 2.0 traffic.

maintainers:
  - Piyush Mehta <piyush.mehta@xilinx.com>
  - Michal Simek <michal.simek@xilinx.com>

properties:
  compatible:
    const: microchip,usb5744

  reg:
    maxItems: 1
    description: |
      Specifies the i2c slave address, it is required and should be 0x2d
      if I2C is used.

  reset-gpios:
    maxItems: 1
    description:
      The phandle and specifier for the GPIO that controls the RESET line of
      USB hub.

required:
  - compatible

additionalProperties: false

examples:
  - |
    #include <dt-bindings/gpio/gpio.h>

    i2c {
        #address-cells = <1>;
        #size-cells = <0>;

        usb5744@2d {
            compatible = "microchip,usb5744";
            reg = <0x2d>;
            reset-gpios = <&gpio 44 GPIO_ACTIVE_LOW>;
        };
    };
```
