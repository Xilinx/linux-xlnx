## Documentation/devicetree/bindings/sound/xlnx,audio-formatter.yaml
```yaml
# SPDX-License-Identifier: (GPL-2.0-only OR BSD-2-Clause)
# %YAML 1.2
---
$id: http://devicetree.org/schemas/sound/xlnx,audio-formatter.yaml#
$schema: http://devicetree.org/meta-schemas/core.yaml#

title: Xilinx Audio DMA for Playback/Capture audio system

maintainers:
  - Katta Dhanunjanrao <katta.dhanunjanrao@amd.com>

description:
  The IP core supports DMA, data formatting(packing, conversion)
  of audio samples.The Audio formatter provides high-bandwidth direct
  memory access between memory and AXI4-Stream target peripherals.

properties:
  compatible:
    const: xlnx,audio-formatter-1.0

  reg:
    maxItems: 1

  interrupts:
    minItems: 1
    maxItems: 2

  interrupt-names:
    description: List of supported interrupts are
                 irq_mm2s interrupt from MM2S block and
                 irq_s2mm interrupt from S2MM block.
    items:
      - const: irq_mm2s
      - const: irq_s2mm

  clocks:
    maxItems: 4
    description: Input clock specifier. Refer to common clock bindings.

  clock-names:
    items:
      - const: s_axi_lite_aclk
      - const: m_axis_mm2s_aclk
      - const: aud_mclk
      - const: s_axis_s2mm_aclk

  xlnx,tx:
    description: connected audio sink node.
                 Should be one of below supported nodes
                 1. HDMI video Tx output
                 2. I2S transmitter
                 3. UHDSDI audio embed
                 4. DP video Tx output
                 5. SPDIF transmitter
                 Only these nodes were supported in sound card driver.
    $ref: /schemas/types.yaml#/definitions/phandle

  xlnx,rx:
    description: Audio formatter connected audio source node.
                 Should be one of below supported node.
                 1. HDMI video Rx input
                 2. I2S receiver
                 3. UHDSDI audio extract
                 4. DP video Rx output
                 5. SPDIF receiver
                 Only these nodes were supported in sound card driver.
    $ref: /schemas/types.yaml#/definitions/phandle

required:
  - reg
  - interrupts
  - interrupt-names
  - clock-names
  - clocks
  - xlnx,tx
  - xlnx,rx

additionalProperties: false

examples:
  - |
    audio-formatter@80010000 {
      compatible = "xlnx,audio-formatter-1.0";
      reg = <0x80010000 0x1000>;
      interrupts = <0 104 4>, <0 105 4>;
      interrupt-names = "irq_mm2s", "irq_s2mm";
      clock-names = "s_axi_lite_aclk", "m_axis_mm2s_aclk", "aud_mclk", "s_axis_s2mm_aclk";
      clocks = <&clk 71>, <&audio_ss_0_clk_wiz_0 0>, <&audio_ss_0_clk_wiz_0 0>, <&clk 71>;
      xlnx,tx = <&i2s_transmitter>;
      xlnx,rx = <&i2s_receiver>;
    };
...
```

## Documentation/devicetree/bindings/sound/xlnx,dp-snd-card.txt
```
Device-Tree bindings for Xilinx ZynqMP DisplayPort Audio Card

The card driver integrates codec and pcm components and represents as a single
audio device.

Required properties:
 - compatible: Should be "xlnx,dp-snd-card".
 - xlnx,dp-snd-pcm: phandle(s) to the ZynqMP DP PCM node.
 - xlnx,dp-snd-codec: phandle to the ZynqMP DP card node.

Example:

	xlnx_dp_snd_card: dp_snd_card {
		compatible = "xlnx,dp-snd-card";
		xlnx,dp-snd-pcm = <&xlnx_dp_snd_pcm0>, <&xlnx_dp_snd_pcm1>;
		xlnx,dp-snd-codec = <&xlnx_dp_snd_codec0>;
	};
```

## Documentation/devicetree/bindings/sound/xlnx,dp-snd-codec.txt
```
Device-Tree bindings for Xilinx ZynqMP DisplayPort Codec

The codec driver handles the audio clock and format management.

Required properties:
 - compatible: Should be "xlnx,dp-snd-codec".
 - clocks: The phandle for the audio clock. The audio clock should be
   configured to the correct audio clock rate, which should be one of
   (44100 * 512) or (48000 * 512).
 - clock-names: The identification string should be "aud_clk".

Example:

	xlnx_dp_snd_codec0: dp_snd_codec0 {
		compatible = "xlnx,dp-snd-codec";
		clocks = <&dp_aud_clk>;
		clock-names = "aud_clk";
	};
```

## Documentation/devicetree/bindings/sound/xlnx,dp-snd-pcm.txt
```
Device-Tree bindings for Xilinx ZynqMP DisplayPort PCM

The DPDMA driver of ZynqMP DisplayPort subsystem is based on DMA engine,
and the DP PCM driver is based on snd dmaengine helpers.

Required properties:
 - compatible: Should be "xlnx,dp-snd-pcm".
 - dmas: the phandle list of DMA specifiers. The dma channel ID should be one
   of 4 for audio0 channel or 5 for audio1 channel.
 - dma-names: the indentifier strings for DMAs. The value should be "tx".

Example:

	xlnx_dp_snd_pcm0: dp_snd_pcm0 {
		compatible = "xlnx,dp-snd-pcm";
		dmas = <&xlnx_dpdma 4>;
		dma-names = "tx";
	};
```

## Documentation/devicetree/bindings/sound/xlnx,i2s.txt
```
Device-Tree bindings for Xilinx I2S PL block

The IP supports I2S based playback/capture audio

Required property:
 - compatible: "xlnx,i2s-transmitter-1.0" for playback and
	       "xlnx,i2s-receiver-1.0" for capture

Required property common to both I2S playback and capture:
 - reg: Base address and size of the IP core instance.
 - xlnx,dwidth: sample data width. Can be any of 16, 24.
 - xlnx,num-channels: Number of I2S streams. Can be any of 1, 2, 3, 4.
		      supported channels = 2 * xlnx,num-channels
 - xlnx,snd-pcm: reference to audio formatter block
 - clock-names: List of input clocks.
   Required elements for I2S Tx: "s_axi_ctrl_aclk", "aud_mclk", "s_axis_aud_aclk".
   Required elements for I2S Rx: "s_axi_ctrl_aclk", "aud_mclk", "m_axis_aud_aclk".
 - clocks: Input clock specifier. Refer to common clock bindings.

Example:

	i2s_receiver@a0080000 {
		compatible = "xlnx,i2s-receiver-1.0";
		clock-names = "s_axi_ctrl_aclk", "aud_mclk", "m_axis_aud_aclk";
		clocks = <&clk 71>, <&audio_ss_0_clk_wiz_0 0>, <&clk 71>;
		reg = <0x0 0xa0080000 0x0 0x10000>;
		xlnx,dwidth = <0x18>;
		xlnx,num-channels = <1>;
		xlnx,snd-pcm = <&audio_ss_0_audio_formatter_0>;
	};
	i2s_transmitter@a0090000 {
		compatible = "xlnx,i2s-transmitter-1.0";
		clock-names = "s_axi_ctrl_aclk", "aud_mclk", "s_axis_aud_aclk";
		clocks = <&clk 71>, <&audio_ss_0_clk_wiz_0 0>, <&audio_ss_0_clk_wiz_0 0>;
		reg = <0x0 0xa0090000 0x0 0x10000>;
		xlnx,dwidth = <0x18>;
		xlnx,num-channels = <1>;
		xlnx,snd-pcm = <&audio_ss_0_audio_formatter_0>;
	};
	Documentation of "audio_ss_0_audio_formatter_0" node is located
	at Documentation/devicetree/bindings/sound/xlnx,audio-formatter.txt
```

## Documentation/devicetree/bindings/sound/xlnx,i2s.yaml
```yaml
# SPDX-License-Identifier: (GPL-2.0-only OR BSD-2-Clause)
# %YAML 1.2
---
$id: http://devicetree.org/schemas/sound/xlnx,i2s.yaml#
$schema: http://devicetree.org/meta-schemas/core.yaml#

title: Xilinx I2S Playback/Capture audio system

maintainers:
  - Katta Dhanunjanrao <katta.dhanunjanrao@amd.com>

description:
  IP I2S Transmitter and receiver cores are soft IP cores in AMD Vivado
  design suite which make it easy to implement Inter-IC-Sound (I2S)
  interface used to connect audio devices for transmitting and
  receiving PCM audio.

properties:
  compatible:
    items:
      - enum:
          - xlnx,i2s-transmitter-1.0
          - xlnx,i2s-receiver-1.0
  reg:
    maxItems: 1

  clocks:
    description: List of clock specifiers.
    items:
      - description: Input audio clock.
      - description: Input clock for AXI4-Lite Interface.
      - description: AXIS Audio streaming clock.

  clock-names:
    maxItems: 3

  interrupts:
    maxItems: 1

  xlnx,dwidth:
    description: Indicates the I2S data width of the core.
    $ref: /schemas/types.yaml#/definitions/uint32
    enum: [16, 24]

  xlnx,num-channels:
    description: Indicates the number of audio channels supported.
                 supported channels = 2 * xlnx,num-channels.
    $ref: /schemas/types.yaml#/definitions/uint32
    enum: [1, 2, 3, 4]

  xlnx,snd-pcm:
    description: Reference to audio formatter block.
    $ref: /schemas/types.yaml#/definitions/phandle

  xlnx,32bit-lr:
    type: boolean
    description: Core configuration either master or slave.

required:
  - reg
  - clocks
  - clock-names
  - xlnx,dwidth
  - xlnx,num-channels
  - xlnx,snd-pcm

additionalProperties: false

allOf:
  - if:
      properties:
        compatible:
          contains:
            const: xlnx,i2s-transmitter-1.0
    then:
      properties:
        clock-names:
          items:
            - const: aud_mclk
            - const: s_axi_ctrl_aclk
            - const: s_axis_aud_aclk
  - if:
      properties:
        compatible:
          contains:
            const: xlnx,i2s-receiver-1.0
    then:
      properties:
        clock-names:
          items:
            - const: aud_mclk
            - const: s_axi_ctrl_aclk
            - const: m_axis_aud_aclk

examples:
  - |
   i2s-transmitter@a00d0000 {
     compatible = "xlnx,i2s-transmitter-1.0";
     reg = <0xa00d0000 0x10000>;
     clocks = <&audio_ss_0_clk_wiz_0 0>, <&zynqmp_clk 71>, <&audio_ss_0_clk_wiz_0 0>;
     clock-names = "aud_mclk" , "s_axi_ctrl_aclk" , "s_axis_aud_aclk";
     xlnx,dwidth = <0x18>;
     xlnx,num-channels = <0x1>;
     xlnx,snd-pcm = <&audio_ss_0_audio_formatter_2>;
   };
   i2s-receiver@a00c0000 {
     compatible = "xlnx,i2s-receiver-1.0";
     reg = <0xa00d0000 0x10000>;
     clocks = <&audio_ss_0_clk_wiz_0 0>, <&zynqmp_clk 71>, <&audio_ss_0_clk_wiz_0 0>;
     clock-names = "aud_mclk" , "s_axi_ctrl_aclk", "m_axis_aud_aclk";
     xlnx,dwidth = <0x18>;
     xlnx,num-channels = <0x1>;
     xlnx,snd-pcm = <&audio_ss_0_audio_formatter_2>;
   };
...
```

## Documentation/devicetree/bindings/sound/xlnx,spdif.txt
```
Device-Tree bindings for Xilinx SPDIF PL IP

The IP supports SPDIF based playback and capture audio

Required properties:
 - compatible: "xlnx,spdif-2.0"
 - clock-names: List of input clocks.
   Required elements for SPDIF Tx: "aud_clk_i", "s_axi_aclk", "s_axis_aclk".
   Required elements for SPDIF Rx: "aud_clk_i", "s_axi_aclk", "m_axis_aclk".
 - clocks: Input clock specifier. Refer to common clock bindings.
 - reg: Base address and address length of the IP core instance.
 - interrupts-parent: Phandle for interrupt controller.
 - interrupts: List of Interrupt numbers.
 - xlnx,spdif-mode: 0 :- receiver mode ; 1 :- transmitter mode
 - xlnx,snd-pcm: phandle to audio formatter node

Example - SPDIF Rx:
	spdif_0: spdif@80010000 {
		clock-names = "aud_clk_i", "s_axi_aclk", "m_axis_aclk";
		clocks = <&si570_1>, <&clk 71>, <&clk 71>;
		compatible = "xlnx,spdif-2.0";
		interrupt-parent = <&gic>;
		interrupts = <0 91 4>;
		reg = <0x0 0x80010000 0x0 0x10000>;
		xlnx,spdif-mode = <1>;
		xlnx,snd-pcm = <&audio_formatter_0>;
	};
```

## Documentation/devicetree/bindings/sound/xlnx,spdif.yaml
```yaml
# SPDX-License-Identifier: (GPL-2.0-only OR BSD-2-Clause)
# %YAML 1.2
---
$id: http://devicetree.org/schemas/sound/xlnx,spdif.yaml#
$schema: http://devicetree.org/meta-schemas/core.yaml#

title: Xilinx S/PDIF/AES3 Playback/Capture audio system

maintainers:
  - Katta Dhanunjanrao <katta.dhanunjanrao@amd.com>

description:
  IP SPDIF/AES3 cores are soft IP cores in AMD Vivado.
  The Sony/Philips Digital Interconnect Format (SPDIF) and AES3
  are digital audio interfaces that implements the IEC 60958 interface
  for transmitting and receiving audio data.

properties:
  compatible:
    const: xlnx,spdif-2.0

  reg:
    maxItems: 1

  clocks:
    description: List of clock specifiers.
    items:
      - description: Audio clock input used at the SPDIF/AES3 interface.
      - description: Axi4-Lite clock.
      - description: Axi4-Stream global clock signal.

  clock-names:
    maxItems: 3

  interrupts:
    maxItems: 1

  xlnx,spdif-mode:
    description: Mode of spdif IP operation either playback or capture.
                 0 - is for receiver mode and 1 - is for the transmitter mode.
    $ref: /schemas/types.yaml#/definitions/uint32
    enum: [0, 1]

  xlnx,snd-pcm:
    description: Reference to audio formatter block.
    $ref: /schemas/types.yaml#/definitions/phandle

required:
  - reg
  - clocks
  - clock-names
  - interrupts
  - xlnx,spdif-mode
  - xlnx,snd-pcm

additionalProperties: false

allOf:
  - if:
      properties:
        xlnx,spdif-mode:
          const: 1 # Transmitter Mode
    then:
      properties:
        clock-names:
          items:
            - const: aud_clk_i
            - const: s_axi_aclk
            - const: s_axis_aclk
    else:
      properties:
        clock-names:
          items:
            - const: aud_clk_i
            - const: s_axi_aclk
            - const: m_axis_aclk

examples:
  - |
    spdif@800a0000 {
      compatible = "xlnx,spdif-2.0";
      reg = <0x800a0000 0x10000>;
      clocks = <&misc_clk_0>, <&zynqmp_clk 71>, <&misc_clk_0>;
      clock-names = "aud_clk_i", "s_axi_aclk", "s_axis_aclk";
      interrupts = <0 89 4>;
      xlnx,spdif-mode = <1>;
      xlnx,snd-pcm = <&audio_formatter>;
    };
    spdif@80090000 {
      compatible = "xlnx,spdif-2.0";
      reg = <0x80090000 0x10000>;
      clocks = <&misc_clk_0>, <&zynqmp_clk 71>, <&zynqmp_clk 71>;
      clock-names = "aud_clk_i" , "s_axi_aclk" , "m_axis_aclk";
      interrupts = <0 90 4>;
      xlnx,spdif-mode = <0>;
      xlnx,snd-pcm = <&audio_formatter>;
    };
...
```

## Documentation/devicetree/bindings/sound/xlnx,v-uhdsdi-audio.txt
```
Device-Tree bindings for Xilinx SDI audio

The IP core supports embed/extract of audio in SDI Tx and Rx
protocol respectively. Reference to PG:
https://www.xilinx.com/support/documentation/ip_documentation/v_uhdsdi_audio/v1_0/pg309-v-uhdsdi-audio.pdf

Required properties:
 - compatible: Should be one of:
		"xlnx,v-uhdsdi-audio-2.0"
		"xlnx,v-uhdsdi-audio-1.0"
   Note: v1.0 (xlnx,v-uhdsdi-audio-1.0) is deprecated
   and driver no longer supports it. Mandatory to upgrade to v2.0
 - interrupts: Interrupt number.
 - interrupts-parent: phandle for interrupt controller.
 - reg: Base address and size of the IP core instance.
 - xlnx,snd-pcm: reference to audio formatter block
 - clock-names: List of input clocks.
   Required elements for SDI Embed: "s_axi_aclk", "s_axis_clk", "sdi_embed_clk".
   Required elements for SDI Extract: "s_axi_aclk", "sdi_extract_clk", "m_axis_clk".
 - clocks: Input clock specifier. Refer to common clock bindings.

SDI embed contains a output port to remote endpoint of SDI video Tx node.
This pipeline should be described using the DT bindings defined in
Documentation/devicetree/bindings/graph.txt

Example:

	audio_ss_0_v_uhdsdi_audio_extract_0: v_uhdsdi_audio@80080000 {
		compatible = "xlnx,v-uhdsdi-audio-2.0";
		clock-names = "s_axi_aclk", "sdi_extract_clk", "m_axis_clk";
		clocks = <&misc_clk_0>, <&misc_clk_1>, <&misc_clk_0>;
		interrupt-names = "interrupt";
		interrupt-parent = <&gic>;
		interrupts = <0 106 4>;
		reg = <0x0 0x80080000 0x0 0x10000>;
		xlnx,snd-pcm = <&audio_ss_0_audio_formatter_0>;
	};

	audio_ss_0_v_uhdsdi_audio_embed_0: v_uhdsdi_audio@80090000 {
		compatible = "xlnx,v-uhdsdi-audio-2.0";
		clock-names = "s_axi_aclk", "s_axis_clk", "sdi_embed_clk";
		clocks = <&misc_clk_0>, <&misc_clk_0>, <&misc_clk_1>;
		interrupt-names = "interrupt";
		interrupt-parent = <&gic>;
		interrupts = <0 107 4>;
		reg = <0x0 0x80090000 0x0 0x10000>;
		xlnx,snd-pcm = <&audio_ss_0_audio_formatter_0>;
		sdi_av_port: port@0 {
			reg = <0>;
			sditx_audio_embed_src: endpoint {
				remote-endpoint = <&sdi_audio_sink_port>;
			};
		};
	};

	Node 'v_smpte_uhdsdi_tx_ss' is documented in SDI Tx video bindings,
	located at Documentation/devicetree/bindings/display/xlnx/xlnx,sdi-tx.txt.

	Node 'audio_ss_0_audio_formatter_0' node is documented
	at Documentation/devicetree/bindings/sound/xlnx,audio-formatter.txt
```
