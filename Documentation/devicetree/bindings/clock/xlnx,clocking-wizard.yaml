## Documentation/devicetree/bindings/media/xilinx/xlnx,v-dprxss.yaml
```yaml
# SPDX-License-Identifier: GPL-2.0
%YAML 1.2
---
$id: http://devicetree.org/schemas/media/xilinx/xlnx,v-dprxss.yaml#
$schema: http://devicetree.org/meta-schemas/core.yaml#

title: Xilinx DisplayPort Receiver Subsystem

maintainers:
  - Rajesh Gugulothu <gugulothu.rajesh@xilinx.com>

description: |
  The DisplayPort subsystem is a full feature, hierarchically packaged
  subsystem with a DisplayPort sink(RX). DP RX subsystem can capture
  video data in different formats at different resolutions.
  For more details, please refer to PG233 at
  https://www.xilinx.com/support/documentation/ip_documentation/dp_rx_subsystem/v2_1/pg233-displayport-rx-subsystem.pdf

properties:
  compatible:
    oneOf:
      - items:
          - enum:
              - xlnx,v-dp-rxss-3.1
              - xlnx,v-dp-rxss-3.0
          - const: xlnx,v-dp-rxss-3.0
      - enum:
          - xlnx,v-dp-rxss2-2.0
          - xlnx,v-dp-rxss2-1.0

  interrupt-names:
    description:
      dprxss_dp_irq is the subsystem interrupt and is always present.
      dprxss_hdcp_irq is raised by the HDCP1x cipher and dprxss_timer_irq by
      the HDCP2X timer, so each is only present when the matching HDCP
      property is set. The order of those two is not fixed.
    minItems: 1
    items:
      - const: dprxss_dp_irq
      - enum: [dprxss_hdcp_irq, dprxss_timer_irq]
      - enum: [dprxss_hdcp_irq, dprxss_timer_irq]

  reg:
    minItems: 1
    items:
      - description: DisplayPort Receiver Subsystem registers
      - description: EDID IP block registers

  reg-names:
    items:
      - const: dp_base
      - const: edid_base

  interrupts:
    minItems: 1
    maxItems: 3

  clocks:
    description: List of clock specifiers
    items:
      - description: AXI Lite clock
      - description: Link clock
      - description: Video clock

  clock-names:
    items:
      - const: s_axi_aclk
      - const: rx_lnk_clk
      - const: rx_vid_clk

  phys:
    description:
      PHY lanes carrying the DisplayPort main link. Designs built around
      the Video PHY Controller expose one PHY per lane, so the number of
      entries follows xlnx,lane-count. Designs built around the Versal
      Gen 2 GT Quad expose the whole quad as a single PHY.
    minItems: 1
    maxItems: 4

  phy-names:
    oneOf:
      - description:
          Per-lane names used with the Video PHY Controller, in lane
          order. Only the first xlnx,lane-count lanes are described.
        minItems: 1
        items:
          - const: dp-phy0
          - const: dp-phy1
          - const: dp-phy2
          - const: dp-phy3
      - description:
          Name used when the main link is wired to the Versal Gen 2 GT
          Quad, which the receiver drives as one PHY.
        items:
          - const: dp-gtquad

  xlnx,dp-retimer:
    description:
      Phandle to the DisplayPort retimer sitting between the connector
      and the PHY, typically on an FMC daughter card. The receiver
      pushes the link rate and the per-lane equalisation requested by
      the source through this device during link training. Omit the
      property on designs that route the main link straight to the PHY.
    $ref: /schemas/types.yaml#/definitions/phandle

  xlnx,vidphy:
    description:
      Phandle to the Video PHY Controller driving the main link, used to
      reconfigure the lanes for link-quality pattern requests. Only
      meaningful on the VPHY topology, i.e. when xlnx,versal-gt is
      absent.
    $ref: /schemas/types.yaml#/definitions/phandle

  xlnx,xilinx-vfmc:
    description:
      Phandle to the FMC mezzanine controller that powers up and clocks
      the DisplayPort connector. The receiver only uses it to order
      probing, deferring until the mezzanine is ready. Only meaningful
      on the GT Quad topology, i.e. when xlnx,versal-gt is present.
    $ref: /schemas/types.yaml#/definitions/phandle

  xlnx,link-rate:
    description: |
      Max link rate that IP configured with.Possible values are as below -
      0x6  - 1.62 Gb/s
      0xa  - 2.7 Gb/s
      0x14 - 5.4 Gb/s
      0x1e - 8.1 Gb/s

      The UHBR rates are a second encoding of the same field, selected by
      128B/132B channel coding instead of 8B/10B, so they are accepted
      only on the DP2.1 IP -
      0x1  - UHBR10, 10 Gb/s
      0x2  - UHBR20, 20 Gb/s
      0x4  - UHBR13.5, 13.5 Gb/s
    allOf:
      - $ref: /schemas/types.yaml#/definitions/uint32
      - enum: [0x1, 0x2, 0x4, 0x6, 0xa, 0x14, 0x1e]

  xlnx,lane-count:
    description: Max number of lanes that IP configured with.
                 Possible values are 1, 2, 4.
    allOf:
      - $ref: /schemas/types.yaml#/definitions/uint32
      - enum: [1, 2, 4]

  xlnx,bpc:
    description: |
      Max BPC value that IP configured with. For example if IP is
      configured
      with 12 BPC means it supports (6, 8, 10, 12) up to 12bpc.
      Possible values are 6, 8, 10, 12, 16.
    allOf:
      - $ref: /schemas/types.yaml#/definitions/uint32
      - enum: [6, 8, 10, 12, 16]

  xlnx,hdcp22-enable:
    description: |
      This denotes hdcp22 protocol is enabled in the IP.
    $ref: /schemas/types.yaml#/definitions/uint32

  xlnx,hdcp-enable:
    description: |
      This denotes hdcp1.4 protocol is enabled in the IP.
    $ref: /schemas/types.yaml#/definitions/uint32

  xlnx,audio-enable:
    description: |
      This denotes audio support has been enabled in the IP.
    $ref: /schemas/types.yaml#/definitions/uint32

  xlnx,audio-channels:
    description: |
      This denotes number of audio channels enabled in the IP
      configuration. Possible values are 2, 3, 4, 5, 6, 7, 8.
    allOf:
      - $ref: /schemas/types.yaml#/definitions/uint32
      - enum: [2, 3, 4, 5, 6, 7, 8]

  xlnx,hdcp1x-keymgmt:
    description:
      A phandle to a syscon device, used to access
      hdcp1x keymgmt registers.
    $ref: /schemas/types.yaml#/definitions/phandle

  xlnx,clk-wiz:
    description:
      Phandle to the clock-wizard IP block that sources the DP Rx
      decryption clock. The Versal Gen 2 series integrates the
      xlnx,clkx5-wiz-1.0 variant; earlier Versal and ZynqMP families
      integrate the MMCM-based xlnx,clk-wizard-1.0. The compatible
      string of the referenced node distinguishes the variant.
    $ref: /schemas/types.yaml#/definitions/phandle

  xlnx,versal-gt:
    description:
      Present on designs where the DP Rx is wired to the in-FPGA GT
      Quad PHY of the Versal Gen 2 series instead of the legacy
      Video PHY Controller. The PHYSTATUS readiness mask and per-lane
      semantics differ from the VPHY topology.
    type: boolean

  xlnx,mode:
    description:
      Selects the DisplayPort transport mode. 0 selects Single Stream
      Transport (SST); 1 selects Multi Stream Transport (MST), where up
      to four independent video streams are multiplexed over one DP 1.4
      link using Virtual Channel (VC) payload allocation.
    $ref: /schemas/types.yaml#/definitions/uint32
    enum: [0, 1]

  xlnx,num-streams:
    description:
      Number of active MST video streams (Virtual Channels). Each stream
      maps to an independent video output.
    $ref: /schemas/types.yaml#/definitions/uint32
    enum: [1, 2, 3, 4]

  ports:
    type: object
    $ref: /schemas/graph.yaml#/properties/ports

    properties:
      port@0:
        $ref: /schemas/graph.yaml#/$defs/port-base
        unevaluatedProperties: false
        description:
          Output port node for MST stream 1 or the sole SST stream.
          Endpoint describes the module connected downstream of the
          DisplayPort receiver.

        properties:
          reg:
            const: 0

    patternProperties:
      "^port@[1-3]$":
        $ref: /schemas/graph.yaml#/$defs/port-base
        unevaluatedProperties: false
        description:
          Output port node for an additional MST stream (stream 2..4).
          Typically populated when xlnx,mode = 1 and xlnx,num-streams
          covers this stream index (port@N is typically present when
          xlnx,num-streams > N).

        properties:
          reg:
            enum: [1, 2, 3]

    unevaluatedProperties: false

required:
  - clock-names
  - clocks
  - compatible
  - interrupts
  - reg
  - reg-names
  - xlnx,link-rate
  - xlnx,bpc
  - xlnx,lane-count
  - xlnx,mode
  - phy-names
  - phys
  - ports

allOf:
  - if:
      properties:
        xlnx,mode:
          const: 1
    then:
      required:
        - xlnx,num-streams
    else:
      properties:
        xlnx,num-streams: false

  # The two phy-names forms, xlnx,vidphy and xlnx,xilinx-vfmc each belong to
  # one topology only, so hold a node to the set its PHY wiring implies.
  - if:
      required:
        - xlnx,versal-gt
    then:
      properties:
        phys:
          maxItems: 1
        phy-names:
          items:
            - const: dp-gtquad
        xlnx,vidphy: false
    else:
      properties:
        phy-names:
          minItems: 1
          items:
            - const: dp-phy0
            - const: dp-phy1
            - const: dp-phy2
            - const: dp-phy3
        xlnx,xilinx-vfmc: false

  # The UHBR link rates require 128B/132B channel coding, which only the
  # DP2.1 IP implements.
  - if:
      not:
        properties:
          compatible:
            contains:
              enum:
                - xlnx,v-dp-rxss2-2.0
                - xlnx,v-dp-rxss2-1.0
    then:
      properties:
        xlnx,link-rate:
          enum: [0x6, 0xa, 0x14, 0x1e]

additionalProperties: false

examples:
  - |
   v-dp-rxss1@a0040000 {
       compatible = "xlnx,v-dp-rxss-3.1", "xlnx,v-dp-rxss-3.0";
       reg = <0xa0040000 0x40000>, <0xa0010000 0x1000>;
       reg-names = "dp_base", "edid_base";
       clocks = <&zynqmp_clk 71>, <&zynqmp_clk 72>, <&misc_clk_1>;
       clock-names = "s_axi_aclk", "rx_lnk_clk", "rx_vid_clk";
       interrupts = <0 89 4>, <0 90 4>, <0 91 4>;
       interrupt-names = "dprxss_dp_irq", "dprxss_hdcp_irq",
                         "dprxss_timer_irq";
       interrupt-parent = <&gic>;
       phys = <&vphy_lane0 0 1 1 0>, <&vphy_lane1 0 1 1 0>,
              <&vphy_lane2 0 1 1 0>, <&vphy_lane3 0 1 1 0>;
       phy-names = "dp-phy0", "dp-phy1", "dp-phy2", "dp-phy3";
       xlnx,audio-channels = <2>;
       xlnx,audio-enable = <1>;
       xlnx,bpc = <10>;
       xlnx,clk-wiz = <&clk_wiz_0>;
       xlnx,hdcp-enable = <1>;
       xlnx,hdcp1x-keymgmt = <&hdcp_keymngmt_blk_0>;
       xlnx,hdcp22-enable = <1>;
       xlnx,lane-count = <4>;
       xlnx,link-rate = <0x1e>;
       xlnx,mode = <0>;

       ports {
           #address-cells = <1>;
           #size-cells = <0>;

           port@0 {
               reg = <0>;
               dp_rxss_out: endpoint {
                   remote-endpoint = <&remap0_in>;
               };
           };
       };
   };
   hdcp_keymngmt_blk_0: hdcp-keymngmt-blk@a00c0000 {
       compatible = "xlnx,hdcp-keymngmt-blk-1.0", "syscon";
       reg = <0xa00c0000 0x10000>;
   };
   clk_wiz_0: clock-controller@a4000000 {
       compatible = "xlnx,clk-wizard-1.0";
       reg = <0xa4000000 0x10000>;
       #clock-cells = <1>;
       clocks = <&misc_clk_0>, <&zynqmp_clk 71>;
       clock-names = "clk_in1", "s_axi_aclk";
       clock-output-names = "clk_out1";
   };

  # Versal Gen 2 variant: clkx5-wiz-1.0 clocking wizard, GT Quad PHY.
  - |
   v-dp-rxss3@a0040000 {
       compatible = "xlnx,v-dp-rxss-3.1", "xlnx,v-dp-rxss-3.0";
       reg = <0xa0040000 0x40000>, <0xa0010000 0x1000>;
       reg-names = "dp_base", "edid_base";
       clocks = <&versal_clk 71>, <&versal_clk 72>, <&misc_clk_1>;
       clock-names = "s_axi_aclk", "rx_lnk_clk", "rx_vid_clk";
       interrupts = <0 89 4>;
       interrupt-names = "dprxss_dp_irq";
       interrupt-parent = <&gic>;
       phys = <&dp_gtquad 0 1 1 0>;
       phy-names = "dp-gtquad";
       xlnx,bpc = <10>;
       xlnx,clk-wiz = <&clkx5_wiz_0>;
       xlnx,lane-count = <4>;
       xlnx,link-rate = <0x1e>;
       xlnx,mode = <0>;
       xlnx,versal-gt;

       ports {
           #address-cells = <1>;
           #size-cells = <0>;

           port@0 {
               reg = <0>;
               dp_rxss3_out: endpoint {
                   remote-endpoint = <&remap1_in>;
               };
           };
       };
   };
   clkx5_wiz_0: clock-controller@a4010000 {
       compatible = "xlnx,clkx5-wiz-1.0";
       reg = <0xa4010000 0x10000>;
       #clock-cells = <1>;
       clocks = <&misc_clk_0>, <&versal_clk 71>;
       clock-names = "clk_in1", "s_axi_aclk";
       clock-output-names = "clk_out1";
   };
  - |
   v-dp-rxss2@a0040000 {
       compatible = "xlnx,v-dp-rxss-3.1", "xlnx,v-dp-rxss-3.0";
       reg = <0xa0040000 0x40000>, <0xa0010000 0x1000>;
       reg-names = "dp_base", "edid_base";
       clock-names = "s_axi_aclk", "rx_lnk_clk", "rx_vid_clk";
       clocks = <&zynqmp_clk 71>, <&zynqmp_clk 72>, <&misc_clk_1>;
       interrupt-names = "dprxss_dp_irq";
       interrupt-parent = <&gic>;
       interrupts = <0 89 4>;
       phy-names = "dp-phy0", "dp-phy1", "dp-phy2", "dp-phy3";
       phys = <&vphy_lane0 0 1 1 0>, <&vphy_lane1 0 1 1 0>,
              <&vphy_lane2 0 1 1 0>, <&vphy_lane3 0 1 1 0>;
       xlnx,audio-channels = <2>;
       xlnx,audio-enable = <1>;
       xlnx,bpc = <10>;
       xlnx,lane-count = <4>;
       xlnx,link-rate = <0x1e>;
       xlnx,mode = <1>;
       xlnx,num-streams = <4>;

       ports {
           #address-cells = <1>;
           #size-cells = <0>;

           port@0 {
               reg = <0>;
               endpoint {
                   remote-endpoint = <&remap0_in>;
               };
           };
           port@1 {
               reg = <1>;
               endpoint {
                   remote-endpoint = <&remap1_in>;
               };
           };
           port@2 {
               reg = <2>;
               endpoint {
                   remote-endpoint = <&remap2_in>;
               };
           };
           port@3 {
               reg = <3>;
               endpoint {
                   remote-endpoint = <&remap3_in>;
               };
           };
       };
   };

  # DP2.1 variant: UHBR link rate with 128B/132B channel coding.
  - |
   v-dp-rxss4@a0040000 {
       compatible = "xlnx,v-dp-rxss2-1.0";
       reg = <0xa0040000 0x40000>, <0xa0010000 0x1000>;
       reg-names = "dp_base", "edid_base";
       clock-names = "s_axi_aclk", "rx_lnk_clk", "rx_vid_clk";
       clocks = <&zynqmp_clk 71>, <&zynqmp_clk 72>, <&misc_clk_1>;
       interrupt-names = "dprxss_dp_irq";
       interrupt-parent = <&gic>;
       interrupts = <0 89 4>;
       phy-names = "dp-gtquad";
       phys = <&dp_gtquad 0 1 1 0>;
       xlnx,bpc = <10>;
       xlnx,lane-count = <4>;
       xlnx,link-rate = <0x1>;
       xlnx,mode = <0>;
       xlnx,versal-gt;

       ports {
           #address-cells = <1>;
           #size-cells = <0>;

           port@0 {
               reg = <0>;
               dp_rxss4_out: endpoint {
                   remote-endpoint = <&remap4_in>;
               };
           };
       };
   };
...
```
