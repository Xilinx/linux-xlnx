## Documentation/devicetree/bindings/media/xilinx/xlnx,v-hdmi-rxss1.yaml
```yaml
# SPDX-License-Identifier: (GPL-2.0-only OR BSD-2-Clause)
%YAML 1.2
---
$id: http://devicetree.org/schemas/media/xilinx/xlnx,v-hdmi-rxss1.yaml#
$schema: http://devicetree.org/meta-schemas/core.yaml#

title: Xilinx HDMI 2.1 Receiver Subsystem

maintainers:
  - Vishal Sagar <vishal.sagar@xilinx.com>

description: |
  The Xilinx HDMI 2.1 Receiver Subsystem is a feature rich soft IP incorporating
  all the necesssary logic to properly interface with PHY layer and provides HDMI
  decoding functionality. The subsystem is a hierarchical IP that bundles a
  collection of HDMI 2.1 Rx-related IP sub-cores and outputs them as a  single IP.
  The subsystem receives the captured TMDS data from the PHY layer. It then
  extracts the video and audio streams from the HDMI stream and converts it to
  video and audio streams.
  For more details refer to PG 351 Xilinx HDMI 2.1 Rx Subsystem.

properties:
  compatible:
    items:
      - enum:
          - xlnx,v-hdmi-rxss1-1.1
          - xlnx,v-hdmi-rxss1-1.2

  reg:
    maxItems: 1

  interrupts:
    maxItems: 5

  interrupt-names:
    description: Only irq is mandatory. Others are optional.
                 hdcp14_irq and  hdcp14_timer_irq will be present when HDCP 1x is selected.
                 hdcp22_irq and hdcp22_timer_irq will be present when HDCP 2x is selected.
    items:
      - const: hdcp14_irq
      - const: hdcp14_timer_irq
      - const: hdcp22_irq
      - const: hdcp22_timer_irq
      - const: irq

  clocks:
    description:
      Clock phandles, in clock-names order, for the AXI4-Lite control
      interface, the fixed FRL link clock and the AXI4-Stream interface.
    minItems: 1
    maxItems: 3

  clock-names:
    oneOf:
      - items:
          - const: s_axi_cpu_aclk
          - const: frl_clk
          - const: s_axis_video_aclk
      - items:
          - const: s_axi_cpu_aclk
          - const: frl_clk
      - items:
          - const: s_axi_cpu_aclk
          - const: s_axis_video_aclk
      - items:
          - const: s_axi_cpu_aclk

  xlnx,edid-ram-size:
    description: |
      This is size of EDID in BRAM.
      The possible values are 256, 512, 1024 or 4096.
      This property has to be specified as '/bits/ 16' value.
    $ref: /schemas/types.yaml#/definitions/uint16
    enum: [ 256, 512, 1024, 4096 ]

  xlnx,input-pixels-per-clock:
    description: |
      Number of pixels per clock on Video Interface.
      This property has to be specified as '/bits/ 8' value.
    $ref: /schemas/types.yaml#/definitions/uint8
    enum: [ 4, 8 ]

  xlnx,max-bits-per-component:
    description: |
      Maximum bits per component.
      This property has to be specified as '/bits/ 8' value.
    $ref: /schemas/types.yaml#/definitions/uint8
    enum: [ 8, 10, 12, 16 ]

  xlnx,max-frl-rate:
    description: |
      Maximum FRL rate.
      A value of 0 means that the IP is configured in TMDS-only mode.
      This property has to be specified as '/bits/ 8' value.
    $ref: /schemas/types.yaml#/definitions/uint8
    enum: [ 0, 4, 5, 6 ]

  xlnx,vid-interface:
    description: |
      Supported video interface.
      Possible values are 0 for AXI4-Stream, 1 for Native
      and 2 for Native-IDE interface.
      This property has to be specified as '/bits/ 8' value.
    $ref: /schemas/types.yaml#/definitions/uint8
    enum: [0, 1, 2]

  xlnx,frl-clk-freq-khz:
    description: |
      FRL clock frequency in KHz
    $ref: /schemas/types.yaml#/definitions/uint32

  xlnx,vid-clk-freq-khz:
    description: |
      Video clock frequency in KHz
    $ref: /schemas/types.yaml#/definitions/uint32

  xlnx,include-hdcp-1-4:
    type: boolean
    $ref: /schemas/types.yaml#/definitions/flag
    description: |
      Present when HDCP1x is enabled.

  xlnx,include-hdcp-2-2:
    type: boolean
    $ref: /schemas/types.yaml#/definitions/flag
    description: |
      Present when HDCP2x is enabled.

  xlnx,hdcp1x-keymgmt:
    description: |
      A phandle to a syscon device, used to access
      HDCP1x keymgmt registers.
    $ref: /schemas/types.yaml#/definitions/phandle

  phys:
    description: |
      One PHY phandle for each HDMI data lane. TMDS-only designs use three
      data lanes, while FRL-capable designs expose four.
    minItems: 3
    maxItems: 4

  phy-names:
    minItems: 3
    items:
      - const: hdmi-phy0
      - const: hdmi-phy1
      - const: hdmi-phy2
      - const: hdmi-phy3

  ports:
    type: object

    properties:
      "#address-cells":
        const: 1

      "#size-cells":
        const: 0

      port@0:
        type: object
        description: |
          Sink port node with one endpoint connected to a hdmi-connector node.
        properties:
          reg:
            const: 0
          endpoint:
            type: object
            properties:
              remote-endpoint: true
            required:
              - remote-endpoint
            additionalProperties: false
        additionalProperties: false

      port@1:
        type: object
        description: |
          Source port node with one endpoint.
        properties:
          reg:
            const: 1
          endpoint:
            type: object
            properties:
              remote-endpoint: true
            required:
              - remote-endpoint
            additionalProperties: false
        additionalProperties: false

    required:
      - "#address-cells"
      - "#size-cells"
      - port@0
      - port@1

    additionalProperties: false

required:
  - compatible
  - reg
  - interrupts
  - interrupt-names
  - clocks
  - clock-names
  - xlnx,edid-ram-size
  - xlnx,max-bits-per-component
  - xlnx,max-frl-rate
  - xlnx,vid-clk-freq-khz
  - xlnx,input-pixels-per-clock
  - xlnx,vid-interface
  - phys
  - phy-names
  - ports

allOf:
  - if:
      required:
        - xlnx,max-frl-rate
      properties:
        xlnx,max-frl-rate:
          const: 0
    then:
      properties:
        clocks:
          maxItems: 2
        clock-names:
          not:
            contains:
              const: frl_clk
        xlnx,frl-clk-freq-khz: false
        xlnx,vid-clk-freq-khz:
          minimum: 149000
          maximum: 151000
        phys:
          maxItems: 3
        phy-names:
          maxItems: 3
    else:
      required:
        - xlnx,frl-clk-freq-khz
      properties:
        clocks:
          minItems: 2
        clock-names:
          contains:
            const: frl_clk
        phys:
          minItems: 4
        phy-names:
          minItems: 4

  - if:
      required:
        - xlnx,max-frl-rate
      properties:
        xlnx,max-frl-rate:
          const: 4
    then:
      properties:
        xlnx,frl-clk-freq-khz:
          minimum: 324000
          maximum: 326000
        xlnx,vid-clk-freq-khz:
          minimum: 299000
          maximum: 301000

  - if:
      required:
        - xlnx,max-frl-rate
      properties:
        xlnx,max-frl-rate:
          const: 5
    then:
      properties:
        xlnx,frl-clk-freq-khz:
          minimum: 379000
          maximum: 381000
        xlnx,vid-clk-freq-khz:
          minimum: 374000
          maximum: 376000

  - if:
      required:
        - xlnx,max-frl-rate
      properties:
        xlnx,max-frl-rate:
          const: 6
    then:
      properties:
        xlnx,frl-clk-freq-khz:
          minimum: 449000
          maximum: 451000
        xlnx,vid-clk-freq-khz:
          minimum: 399000
          maximum: 401000

  - if:
      required:
        - xlnx,vid-interface
      properties:
        xlnx,vid-interface:
          const: 0
    then:
      properties:
        clock-names:
          contains:
            const: s_axis_video_aclk

additionalProperties: false

examples:
  - |
    v-hdmi-rxss1@80000000 {
      compatible = "xlnx,v-hdmi-rxss1-1.1";
      reg = <0x80000000 0x10000>;
      clock-names = "s_axi_cpu_aclk", "frl_clk", "s_axis_video_aclk";
      clocks = <&zynqmp_clk 71>, <&misc_clk_4>, <&misc_clk_5>;
      interrupt-parent = <&gic>;
      interrupt-names = "hdcp14_irq", "hdcp14_timer_irq", "hdcp22_irq", "hdcp22_timer_irq", "irq";
      interrupts = <0 106 4>, <0 107 4>, <0 110 4>, <0 111 4>, <0 91 4>;
      xlnx,edid-ram-size = /bits/ 16 <0x100>;
      xlnx,input-pixels-per-clock = /bits/ 8 <0x8>;
      xlnx,max-bits-per-component = /bits/ 8 <0xa>;
      xlnx,vid-interface = /bits/ 8 <0>;
      xlnx,max-frl-rate = /bits/ 8 <0x6>;
      xlnx,frl-clk-freq-khz = <449955>;
      xlnx,vid-clk-freq-khz = <400000>;
      xlnx,include-hdcp-1-4;
      xlnx,include-hdcp-2-2;
      xlnx,hdcp1x-keymgmt = <&hdcp_keymngmt_blk_1>;
      phy-names = "hdmi-phy0", "hdmi-phy1", "hdmi-phy2", "hdmi-phy3";
      phys = <&hdmiphy1_lane0 0 1 1 0>,
             <&hdmiphy1_lane1 0 1 1 0>,
             <&hdmiphy1_lane2 0 1 1 0>,
             <&hdmiphy1_lane3 0 1 1 0>;
      ports {
        #address-cells = <1>;
        #size-cells = <0>;
        port@0 {
           reg = <0>;
           hdmi_rx_in: endpoint {
             remote-endpoint = <&hdmi_connector_out>;
           };
        };
        port@1 {
           reg = <1>;
           hdmi_rx_out: endpoint {
             remote-endpoint = <&vpss_in>;
           };
        };
      };
    };
    hdcp_keymngmt_blk_1: hdcp-keymngmt-blk@80040000 {
       compatible = "xlnx,hdcp-keymngmt-blk-1.0", "syscon";
       reg = <0x80040000 0x10000>;
    };
  - |
    /* HDMI 2.1 RX subsystem configured without FRL support. */
    v-hdmi-rxss1@80000000 {
      compatible = "xlnx,v-hdmi-rxss1-1.2";
      reg = <0x80000000 0x10000>;
      clock-names = "s_axi_cpu_aclk", "s_axis_video_aclk";
      clocks = <&zynqmp_clk 71>, <&misc_clk_5>;
      interrupt-parent = <&gic>;
      interrupt-names = "hdcp14_irq", "hdcp14_timer_irq", "hdcp22_irq",
                        "hdcp22_timer_irq", "irq";
      interrupts = <0 106 4>, <0 107 4>, <0 110 4>, <0 111 4>, <0 91 4>;
      xlnx,edid-ram-size = /bits/ 16 <0x100>;
      xlnx,input-pixels-per-clock = /bits/ 8 <0x8>;
      xlnx,max-bits-per-component = /bits/ 8 <0xa>;
      xlnx,vid-interface = /bits/ 8 <0>;
      xlnx,max-frl-rate = /bits/ 8 <0>;
      xlnx,vid-clk-freq-khz = <150000>;
      xlnx,include-hdcp-1-4;
      xlnx,include-hdcp-2-2;
      phy-names = "hdmi-phy0", "hdmi-phy1", "hdmi-phy2";
      phys = <&hdmiphy1_lane0 0 1 1 0>,
             <&hdmiphy1_lane1 0 1 1 0>,
             <&hdmiphy1_lane2 0 1 1 0>;
      ports {
        #address-cells = <1>;
        #size-cells = <0>;
        port@0 {
           reg = <0>;
           hdmi_rx_tmds_in: endpoint {
             remote-endpoint = <&hdmi_connector_out>;
           };
        };
        port@1 {
           reg = <1>;
           hdmi_rx_tmds_out: endpoint {
             remote-endpoint = <&vpss_in>;
           };
        };
      };
    };
...
```

## Documentation/devicetree/bindings/misc/macom,sdi-redriver.yaml
```yaml
# SPDX-License-Identifier: (GPL-2.0-only OR BSD-2-Clause)
%YAML 1.2
---
$id: http://devicetree.org/schemas/misc/macom,sdi-redriver.yaml#
$schema: http://devicetree.org/meta-schemas/core.yaml#

title: MACOM SDI re-driver family

maintainers:
  - Katta Dhanunjanrao <katta.dhanunjanrao@amd.com>

description: |
  SPI-controlled SDI signal conditioning parts fitted to the Fidus/Zetta SDI
  FMC mezzanine.  Each is programmed over the same SPI bus and differs only in
  the role it plays in the signal chain:

    m23145  reclocker, used by both the Tx and Rx paths
    m23428  cable driver, used by the Tx path
    m23554  equalizer/receiver, used by the Rx path

  The parts have no readable configuration beyond a device-ID register, which
  selects which errata sequence applies to the die revision fitted.  Which role
  a given chip select plays is described by the mezzanine node's xlnx,rclkr,
  xlnx,drvr and xlnx,rcvr phandles rather than being inferred here.

  The controller must be able to issue 16-bit words: a register access is a
  single word carrying the address in bits [15:8] and the data in bits [7:0].

allOf:
  - $ref: /schemas/spi/spi-peripheral-props.yaml#

properties:
  compatible:
    enum:
      - macom,m23145
      - macom,m23428
      - macom,m23554

  reg:
    maxItems: 1

  spi-max-frequency:
    maximum: 10000000

required:
  - compatible
  - reg

additionalProperties: false

examples:
  - |
    spi {
        #address-cells = <1>;
        #size-cells = <0>;

        reclocker@0 {
            compatible = "macom,m23145";
            reg = <0>;
            spi-max-frequency = <9300000>;
        };
    };
...
```

## Documentation/devicetree/bindings/misc/ti,ds10cp154.yaml
```yaml
# SPDX-License-Identifier: (GPL-2.0-only OR BSD-2-Clause)
%YAML 1.2
---
$id: http://devicetree.org/schemas/misc/ti,ds10cp154.yaml#
$schema: http://devicetree.org/meta-schemas/core.yaml#

title: TI DS10CP154 clock crosspoint switch

maintainers:
  - Katta Dhanunjanrao <katta.dhanunjanrao@amd.com>

description: |
  A 4x4 LVDS clock crosspoint switch configured over I2C.  On the Fidus/Zetta
  SDI FMC mezzanine it routes the two SDI reference clocks (148.5 MHz and
  148.35 MHz) to the outputs feeding the SMPTE UHD-SDI Tx and Rx subsystems.

  The routing is fixed by the board and is programmed as part of mezzanine
  bring-up, so no routing properties are described here.

properties:
  compatible:
    const: ti,ds10cp154

  reg:
    maxItems: 1

required:
  - compatible
  - reg

additionalProperties: false

examples:
  - |
    i2c {
        #address-cells = <1>;
        #size-cells = <0>;

        clock-crosspoint@50 {
            compatible = "ti,ds10cp154";
            reg = <0x50>;
        };
    };
...
```
