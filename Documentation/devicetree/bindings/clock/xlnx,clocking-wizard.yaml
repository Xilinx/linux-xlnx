## Documentation/devicetree/bindings/i3c/xlnx,axi-i3c-1.0.yaml
```yaml
# SPDX-License-Identifier: GPL-2.0-only OR BSD-2-Clause
%YAML 1.2
---
$id: http://devicetree.org/schemas/i3c/xlnx,axi-i3c-1.0.yaml#
$schema: http://devicetree.org/meta-schemas/core.yaml#

title: AMD I3C master

maintainers:
  - Shubhrajyoti Datta <shubhrajyoti.datta@amd.com>
  - Shubham Patil <shubhamsanjay.patil@amd.com>

description:
  The AXI-I3C IP is an I3C Controller with an AXI4-Lite interface, compatible
  with the MIPI I3C Specification v1.1.1. The design includes bidirectional I/O
  buffers that implement open collector drivers for the SDA and SCL signals.
  External pull-up resistors are required to properly hold the bus at a Logic-1
  level when the drivers are released.

  For more details, please see https://docs.amd.com/r/en-US/pg439-axi-i3c

properties:
  compatible:
    const: xlnx,axi-i3c-1.0

  reg:
    maxItems: 1

  clocks:
    maxItems: 1

  interrupts:
    maxItems: 1

  xlnx,in-band-interrupt-capable:
    type: boolean
    description:
      The IP is synthesized with In-Band Interrupt support. An In-Band
      Interrupt lets a target signal the controller over the SDA and SCL
      pair instead of a dedicated side-band interrupt line, by driving its
      own dynamic address during bus arbitration. Such requests are
      reported through the controller interrupt.

  xlnx,hot-join-capable:
    type: boolean
    description:
      The IP is synthesized with Hot-Join support. Hot-Join lets a target
      attached or powered up after the bus is already running announce
      itself using the reserved Hot-Join address, so that the controller
      can assign it a dynamic address. The request is acknowledged by the
      same machinery as an In-Band Interrupt.

required:
  - compatible
  - reg
  - clocks

dependencies:
  xlnx,hot-join-capable: ["xlnx,in-band-interrupt-capable"]
  xlnx,in-band-interrupt-capable: [interrupts]

allOf:
  - $ref: i3c.yaml#

unevaluatedProperties: false

examples:
  - |
    #include <dt-bindings/interrupt-controller/arm-gic.h>

    i3c@80000000 {
        compatible = "xlnx,axi-i3c-1.0";
        reg = <0x80000000 0x10000>;
        clocks = <&zynqmp_clk 71>;
        interrupt-parent = <&imux>;
        interrupts = <GIC_SPI 89 IRQ_TYPE_LEVEL_HIGH>;
        #address-cells = <3>;
        #size-cells = <0>;
        xlnx,in-band-interrupt-capable;
        xlnx,hot-join-capable;
    };
...
```

## Documentation/devicetree/bindings/interrupt-controller/xlnx,smmu-irq-csr.yaml
```yaml
# SPDX-License-Identifier: (GPL-2.0 OR BSD-2-Clause)
%YAML 1.2
---
$id: http://devicetree.org/schemas/interrupt-controller/xlnx,smmu-irq-csr.yaml#
$schema: http://devicetree.org/meta-schemas/core.yaml#

title: Xilinx Versal NET SMMU CSR Interrupt Controller

maintainers:
  - Anirudha Sarangi <anirudha.sarangi@amd.com>
  - Tushar Nimkar <tushar.nimkar@amd.com>

description:
  The Versal Net platform includes a Xilinx-specific SMMU CSR (Control and
  Status Register) block that acts as an intermediate interrupt controller
  for ARM SMMUv3.

  This block provides registers to enable, disable, and clear the standard
  SMMUv3 interrupt sources, including EVENTQ, PRIQ, and GERROR.

  Xilinx Versal-Net SMMU CSR interrupt controller routes ARM SMMU interrupts
  through a vendor-specific SMMU_CSR register block. The block allows enabling
  and clearing of EVENTQ, PRIQ, and GERROR interrupts before forwarding
  them to the parent interrupt controller (typically GIC).

  The controller receives one parent interrupt, then demultiplexes CSR
  status bits into child interrupt IDs exposed by this irqchip domain
    0 - EVENTQ
    2 - GERROR (GLOBAL)
    3 - PRIQ

  Bit 1 (CMDQ_SYNC completion) is intentionally omitted, the Linux
  arm-smmu-v3 driver completes CMDQ_SYNC via polling or MSI and does not
  use a wired CMD_SYNC interrupt, so the binding exposes no child line
  for it.

allOf:
  - $ref: /schemas/interrupt-controller.yaml#

properties:
  compatible:
    const: xlnx,versal-net-smmu-csr

  reg:
    maxItems: 1

  interrupt-controller: true

  "#interrupt-cells":
    const: 1

  interrupts:
    maxItems: 1

  xlnx,smmu-csr-interrupt-mask:
    $ref: /schemas/types.yaml#/definitions/uint32
    description: >
      Bitmask selecting which SMMU CSR interrupt sources are enabled in the
      CSR block and forwarded to the parent interrupt controller. Each bit
      corresponds to a child interrupt line exposed by this controller:

        bit 0 - EVENTQ
        bit 1 - reserved (CMD_SYNC, not supported)
        bit 2 - GERROR
        bit 3 - PRIQ

    minimum: 0x0
    maximum: 0xd

required:
  - compatible
  - reg
  - interrupt-controller
  - "#interrupt-cells"
  - interrupts
  - xlnx,smmu-csr-interrupt-mask

additionalProperties: false

examples:
  - |
    #include <dt-bindings/interrupt-controller/arm-gic.h>
    #include <dt-bindings/interrupt-controller/irq.h>

    smmu_irq_csr: interrupt-controller@eca10000 {
        compatible = "xlnx,versal-net-smmu-csr";
        reg = <0xeca10000 0x1000>;
        interrupt-controller;
        #interrupt-cells = <1>;
        interrupt-parent = <&gic>;
        interrupts = <GIC_SPI 169 IRQ_TYPE_LEVEL_HIGH>;
        xlnx,smmu-csr-interrupt-mask = <0x5>;
    };

    iommu@ec000000 {
        compatible = "arm,smmu-v3";
        reg = <0xec000000 0x40000>;
        #iommu-cells = <1>;
        dma-coherent;
        interrupt-names = "eventq", "gerror", "priq";
        interrupt-parent = <&smmu_irq_csr>;
        interrupts = <0>, <2>, <3>;
    };
```
