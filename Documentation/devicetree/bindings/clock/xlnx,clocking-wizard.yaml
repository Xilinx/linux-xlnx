## Documentation/devicetree/bindings/display/xlnx/xlnx,pl-drm.yaml
```yaml
# SPDX-License-Identifier: (GPL-2.0-only OR BSD-2-Clause)
%YAML 1.2
---
$id: http://devicetree.org/schemas/display/xlnx/xlnx,pl-drm.yaml#
$schema: http://devicetree.org/meta-schemas/core.yaml#

title: Xilinx PL Aggregate Display Device

maintainers:
  - Anatoliy Klymenko <anatoliy.klymenko@amd.com>

description:
  The PL display aggregate node represents a programmable logic (PL) compound
  display pipeline. Its child nodes describe the pipeline's video processing
  components, such as video timing controllers, signal sources, converters and
  sinks. This logical device combines the whole display pipeline into a single
  entity. This binding has been proposed as an RFC to the upstream community
  and the design may still change. See the RFC discussion at
  https://lore.kernel.org/dri-devel/20260925155658.3108388-1-vishal.sagar@amd.com/T/#u

properties:
  compatible:
    const: xlnx,pl-drm-1.0

  '#address-cells':
    enum: [1, 2]

  '#size-cells':
    enum: [1, 2]

  ranges: true

patternProperties:
  "^av-pat-gen@[0-9a-f]+$":
    type: object
    $ref: /schemas/display/xlnx/xlnx,psdpdc-av-pat-gen.yaml#
    description: AMD Versal Gen2 Audio / Video Pattern Generator child node.

  "^pl-disp(@[0-9a-f]+)?$":
    type: object
    $ref: /schemas/display/xlnx/xlnx,pl-disp.yaml#
    description: Xilinx PL display CRTC child node.

required:
  - compatible
  - '#address-cells'
  - '#size-cells'
  - ranges

additionalProperties: false

examples:
  - |
    #include <dt-bindings/gpio/gpio.h>

    xlnx-pl-drm {
        compatible = "xlnx,pl-drm-1.0";
        #address-cells = <1>;
        #size-cells = <1>;
        ranges;

        av-pat-gen@b0400000 {
            compatible = "xlnx,psdpdc-av-pat-gen-2.0";
            reg = <0xb0400000 0x10000>;
            clocks = <&misc_clk_2>, <&misc_clk_2>, <&misc_clk_1>, <&vid_clk 0>;
            clock-names = "aud_clk", "aud_out_axi4s_aclk",
                          "av_axi_aclk", "vid_out_axi4s_aclk";
            clk-enable-gpios = <&axi_gpio_0 0 GPIO_ACTIVE_HIGH>,
                               <&axi_gpio_0 1 GPIO_ACTIVE_HIGH>;
            xlnx,bridge = <&v_tc_0>;
            xlnx,ppc = <2>;
            xlnx,bpc = <8>;
            xlnx,video-format = <0>;

            port {
                avpg_out: endpoint {
                    remote-endpoint = <&dc_live_in_0>;
                };
            };
        };

        pl-disp {
            compatible = "xlnx,pl-disp";
            dmas = <&v_frmbuf_rd_0 0>;
            dma-names = "dma0";
            xlnx,vformat = "XR24";
            xlnx,bridge = <&v_tc_1>;
            clocks = <&vid_clk 0>;

            port {
                fb_read_out: endpoint {
                    remote-endpoint = <&dc_live_in_1>;
                };
            };
        };
    };
```

## Documentation/devicetree/bindings/display/xlnx/xlnx,v-hdmi-txss1.yaml
```yaml
# SPDX-License-Identifier: (GPL-2.0-only OR BSD-2-Clause)
%YAML 1.2
---
$id: http://devicetree.org/schemas/display/xlnx/xlnx,v-hdmi-txss1.yaml#
$schema: http://devicetree.org/meta-schemas/core.yaml#

title: Xilinx HDMI Transmitter Subsystem

maintainers:
  - Venkateshwar Rao Gannavarapu <venkateshwar.rao.gannavarapu@xilinx.com>

description: |
  The Xilinx HDMI Tx Subsystem contains several subcores to implement
  a HDMI Transmitter and outputs video data using HDMI protocol.
  For more details refer to PG350 Xilinx HDMI-2.1 Tx Subsystem.

properties:
  compatible:
    items:
      - enum:
          - xlnx,v-hdmi-txss1-1.1
          - xlnx,v-hdmi-txss1-1.2

  reg:
    maxItems: 1

  interrupts:
    minItems: 1
    maxItems: 4

  interrupt-names:
    description: Only hdmitx interrupt is mandatory. Others are optional.
                 hdcp14 and hdcp14timer will be present when HDCP 1x
                 is selected.
                 hdcp22timer will be present when HDCP 2x is selected.
    minItems: 1
    items:
      - const: hdmitx
      - const: hdcp14
      - const: hdcp14timer
      - const: hdcp22timer

  clocks:
    description:
      Clock phandles in clock-names order.
    minItems: 3
    maxItems: 6

  clock-names:
    description: |
      s_axi_cpu_aclk, link_clk and video_clk are always first.
      frl_clk follows when the design supports FRL.
      s_axis_audio_aclk and s_axis_video_aclk follow those, and
      either of those two may be left out.
    minItems: 3
    maxItems: 6

  phys:
    description: This denotes phandles for phy lanes registered
                 for HDMI protocol. A design that supports FRL requires
                 4 lanes, a TMDS-only design 3.
    minItems: 3
    maxItems: 4

  phy-names:
    minItems: 3
    items:
      - const: hdmi-phy0
      - const: hdmi-phy1
      - const: hdmi-phy2
      - const: hdmi-phy3

  xlnx,input-pixels-per-clock:
    description: Configurable samples per clock.
                 Possible values are 4, 8.
    allOf:
      - $ref: /schemas/types.yaml#/definitions/uint32
      - enum: [4, 8]

  xlnx,max-bits-per-component:
    description: |
      Max BPC value that IP configured with. For example if IP is configured
      with 12 BPC means it supports (8, 10, 12) up to 12bpc.
      Possible values are 8, 10, 12, 16.
    allOf:
      - $ref: /schemas/types.yaml#/definitions/uint32
      - enum: [8, 10, 12, 16]

  xlnx,vid-interface:
    description: Supported video interface.
                 Possible values are 0 for AXI4-Stream,
                 1 for Native and 2 for Native-IDE interface.
    allOf:
      - $ref: /schemas/types.yaml#/definitions/uint32
      - enum: [0, 1, 2]

  xlnx,max-frl-rate:
    description: Maximum FRL rate the IP is configured for.
                 0 means the FRL rate is unused. Whether the FRL block
                 is built is indicated by xlnx,hdmi-mode.
    allOf:
      - $ref: /schemas/types.yaml#/definitions/uint32
      - enum: [0, 1, 2, 3, 4, 5, 6]

  xlnx,hdmi-mode:
    description: |
      HDMI 2.1 TX IP configuration (C_HDMI_MODE).
      0 is HDMI 2.1 TMDS-only, with no FRL block.
      1 is HDMI 2.1 FRL plus TMDS.
      Absent means the FRL block is present.
    allOf:
      - $ref: /schemas/types.yaml#/definitions/uint32
      - enum: [0, 1]

  xlnx,include-hdcp-1-4:
    type: boolean
    $ref: /schemas/types.yaml#/definitions/flag
    description: |
      Present when HDCP1.4 is present in design.

  xlnx,include-hdcp-2-2:
    type: boolean
    $ref: /schemas/types.yaml#/definitions/flag
    description: |
      Present when HDCP2.2 is present in design.

  xlnx,hdcp1x-keymgmt:
    description:
      A phandle to a syscon device, used to access
      hdcp1x keymgmt registers.
    $ref: /schemas/types.yaml#/definitions/phandle

  ports:
    type: object

    properties:
      "#address-cells":
        const: 1

      "#size-cells":
        const: 0

      port@0:
        type: object
        description: |
          Output / source port node, endpoint describing modules
          connected the HDMI transmitter

        properties:
          reg:
            const: 0

          endpoint:
            type: object

            properties:

              remote-endpoint: true

            required:
              - remote-endpoint

            additionalProperties: false

        additionalProperties: false

    additionalProperties: false

required:
  - compatible
  - reg
  - interrupts
  - clocks
  - clock-names
  - phys
  - phy-names
  - xlnx,input-pixels-per-clock
  - xlnx,max-bits-per-component
  - xlnx,vid-interface
  - xlnx,max-frl-rate
  - ports

additionalProperties: false

dependencies:
  xlnx,include-hdcp-1-4: [ 'xlnx,hdcp1x-keymgmt' ]
  xlnx,hdcp1x-keymgmt: [ 'xlnx,include-hdcp-1-4' ]

allOf:
  # Audio and the AXI-Stream video clock may each be left out, so each
  # legal sequence is listed. The three leading clocks are always present.
  - oneOf:
      - properties:
          clocks:
            minItems: 3
            maxItems: 3
          clock-names:
            items:
              - const: s_axi_cpu_aclk
              - const: link_clk
              - const: video_clk
      - properties:
          clocks:
            minItems: 4
            maxItems: 4
          clock-names:
            items:
              - const: s_axi_cpu_aclk
              - const: link_clk
              - const: video_clk
              - const: s_axis_audio_aclk
      - properties:
          clocks:
            minItems: 4
            maxItems: 4
          clock-names:
            items:
              - const: s_axi_cpu_aclk
              - const: link_clk
              - const: video_clk
              - const: s_axis_video_aclk
      - properties:
          clocks:
            minItems: 5
            maxItems: 5
          clock-names:
            items:
              - const: s_axi_cpu_aclk
              - const: link_clk
              - const: video_clk
              - const: s_axis_audio_aclk
              - const: s_axis_video_aclk
      - properties:
          clocks:
            minItems: 4
            maxItems: 4
          clock-names:
            items:
              - const: s_axi_cpu_aclk
              - const: link_clk
              - const: video_clk
              - const: frl_clk
      - properties:
          clocks:
            minItems: 5
            maxItems: 5
          clock-names:
            items:
              - const: s_axi_cpu_aclk
              - const: link_clk
              - const: video_clk
              - const: frl_clk
              - const: s_axis_audio_aclk
      - properties:
          clocks:
            minItems: 5
            maxItems: 5
          clock-names:
            items:
              - const: s_axi_cpu_aclk
              - const: link_clk
              - const: video_clk
              - const: frl_clk
              - const: s_axis_video_aclk
      - properties:
          clocks:
            minItems: 6
            maxItems: 6
          clock-names:
            items:
              - const: s_axi_cpu_aclk
              - const: link_clk
              - const: video_clk
              - const: frl_clk
              - const: s_axis_audio_aclk
              - const: s_axis_video_aclk

  # Mode 0 has no FRL block, so the rate is 0. An absent mode keeps
  # the old rule, including a rate of 0 on an FRL instance.
  - if:
      required:
        - xlnx,hdmi-mode
      properties:
        xlnx,hdmi-mode:
          const: 0
    then:
      properties:
        xlnx,max-frl-rate:
          const: 0
        clocks:
          minItems: 3
          maxItems: 5
        clock-names:
          minItems: 3
          maxItems: 5
          not:
            contains:
              const: frl_clk
        phys:
          minItems: 3
          maxItems: 3
        phy-names:
          minItems: 3
          maxItems: 3
    else:
      properties:
        clocks:
          minItems: 4
          maxItems: 6
        clock-names:
          minItems: 4
          maxItems: 6
          contains:
            const: frl_clk
        phys:
          minItems: 4
          maxItems: 4
        phy-names:
          minItems: 4
          maxItems: 4

  - if:
      properties:
        xlnx,vid-interface:
          const: 0
    then:
      required:
        - clock-names
      properties:
        clock-names:
          contains:
            const: s_axis_video_aclk

examples:
  - |
    #include <dt-bindings/interrupt-controller/arm-gic.h>

    v-hdmi-txss1@80020000 {
        compatible = "xlnx,v-hdmi-txss1-1.1";
        reg = <0x80020000 0x20000>;
        interrupt-names = "hdmitx", "hdcp14", "hdcp14timer",
                          "hdcp22timer";
        interrupts = <GIC_SPI 91 IRQ_TYPE_LEVEL_HIGH>, <GIC_SPI 106 IRQ_TYPE_LEVEL_HIGH>,
                     <GIC_SPI 107 IRQ_TYPE_LEVEL_HIGH>, <GIC_SPI 111 IRQ_TYPE_LEVEL_HIGH>;
        clock-names = "s_axi_cpu_aclk", "link_clk", "video_clk", "frl_clk", "s_axis_video_aclk";
        clocks = <&zynqmp_clk 71>, <&misc_clk_1>, <&misc_clk_3>, <&misc_clk_4>, <&misc_clk_5>;
        xlnx,input-pixels-per-clock = <4>;
        xlnx,max-bits-per-component = <0x8>;
        xlnx,vid-interface = <0>;
        xlnx,max-frl-rate = <0x6>;
        xlnx,include-hdcp-1-4;
        xlnx,include-hdcp-2-2;
        xlnx,hdcp1x-keymgmt = <&hdcp_keymngmt_blk_0>;
        phy-names = "hdmi-phy0", "hdmi-phy1", "hdmi-phy2", "hdmi-phy3";
        phys = <&hdmiphy_lane0 0 1 1 1>, <&hdmiphy_lane1 0 1 1 1>,
               <&hdmiphy_lane2 0 1 1 1>, <&hdmiphy_lane3 0 1 1 1>;
        ports {
            #address-cells = <1>;
            #size-cells = <0>;

            port@0 {
                reg = <0>;
                hdmi_encoder: endpoint {
                    remote-endpoint = <&dmaengine_crtc>;
                };
            };
        };
    };

    hdcp_keymngmt_blk_0: hdcp-keymngmt-blk@80030000 {
        compatible = "xlnx,hdcp-keymngmt-blk-1.0", "syscon";
        reg = <0x80030000 0x10000>;
    };

  - |
    /* HDMI 2.1 TX, TMDS-only: no FRL block, three PHY lanes, no frl_clk. */
    v-hdmi-txss1@80060000 {
        compatible = "xlnx,v-hdmi-txss1-1.2";
        reg = <0x80060000 0x20000>;
        interrupt-names = "hdmitx";
        interrupts = <0 91 4>;
        clock-names = "s_axi_cpu_aclk", "link_clk", "video_clk",
                      "s_axis_audio_aclk", "s_axis_video_aclk";
        clocks = <&zynqmp_clk 71>, <&misc_clk_1>, <&misc_clk_3>,
                 <&misc_clk_4>, <&misc_clk_5>;
        xlnx,input-pixels-per-clock = <4>;
        xlnx,max-bits-per-component = <8>;
        xlnx,vid-interface = <0>;
        xlnx,max-frl-rate = <0>;
        xlnx,hdmi-mode = <0>;
        phy-names = "hdmi-phy0", "hdmi-phy1", "hdmi-phy2";
        phys = <&hdmiphy_lane0 0 1 1 1>, <&hdmiphy_lane1 0 1 1 1>,
               <&hdmiphy_lane2 0 1 1 1>;
        ports {
            #address-cells = <1>;
            #size-cells = <0>;

            port@0 {
                reg = <0>;
                hdmi_encoder_tmds: endpoint {
                    remote-endpoint = <&dmaengine_crtc_tmds>;
                };
            };
        };
    };
...
```
