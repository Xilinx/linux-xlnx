## Documentation/devicetree/bindings/clock/xlnx,clocking-wizard.yaml
```yaml
# SPDX-License-Identifier: (GPL-2.0-only OR BSD-2-Clause)
%YAML 1.2
---
$id: http://devicetree.org/schemas/clock/xlnx,clocking-wizard.yaml#
$schema: http://devicetree.org/meta-schemas/core.yaml#

title: Xilinx clocking wizard

maintainers:
  - Shubhrajyoti Datta <shubhrajyoti.datta@amd.com>

description:
  The clocking wizard is a soft ip clocking block of Xilinx versal. It
  reads required input clock frequencies from the devicetree and acts as clock
  clock output.

properties:
  compatible:
    enum:
      - xlnx,clocking-wizard
      - xlnx,clocking-wizard-v5.2
      - xlnx,clocking-wizard-v6.0
      - xlnx,versal-clk-wizard


  reg:
    maxItems: 1

  "#clock-cells":
    const: 1

  clocks:
    minItems: 1
    items:
      - description: clock input
      - description: axi clock

  clock-names:
    minItems: 1
    items:
      - const: clk_in1
      - const: s_axi_aclk

  xlnx,static-config:
    $ref: /schemas/types.yaml#/definitions/flag
    description:
      Indicate whether the core has been configured without support for dynamic
      runtime reconfguration of the clocking primitive MMCM/PLL.

  xlnx,speed-grade:
    $ref: /schemas/types.yaml#/definitions/uint32
    enum: [1, 2, 3]
    description:
      Speed grade of the device. Higher the speed grade faster is the FPGA device.

  xlnx,nr-outputs:
    $ref: /schemas/types.yaml#/definitions/uint32
    minimum: 1
    maximum: 8
    description:
      Number of outputs.

  xlnx,clk-mul-div:
    $ref: /schemas/types.yaml#/definitions/uint32-matrix
    description:
      Fixed MMCM/PLL multiply/divide ratios, one (multiplier, divisor)
      pair per clock output relative to clk_in1. The number of entries
      must equal xlnx,nr-outputs.
    minItems: 1
    maxItems: 8
    items:
      items:
        - description: multiplier
          minimum: 1
        - description: divisor
          minimum: 1

required:
  - compatible
  - "#clock-cells"
  - clocks
  - clock-names
  - xlnx,speed-grade
  - xlnx,nr-outputs

allOf:
  - if:
      required:
        - xlnx,static-config
    then:
      required:
        - xlnx,clk-mul-div
    else:
      required:
        - reg
      properties:
        clocks:
          minItems: 2
        clock-names:
          minItems: 2

additionalProperties: false

examples:
  - |
    clock-controller@b0000000 {
        compatible = "xlnx,clocking-wizard";
        reg = <0xb0000000 0x10000>;
        #clock-cells = <1>;
        clocks = <&clkc 15>, <&clkc 18>;
        clock-names = "clk_in1", "s_axi_aclk";
        xlnx,nr-outputs = <6>;
        xlnx,speed-grade = <1>;
    };

  - |
    clock-controller {
        compatible = "xlnx,clocking-wizard";
        #clock-cells = <1>;
        clocks = <&clkc 15>;
        clock-names = "clk_in1";
        xlnx,nr-outputs = <6>;
        xlnx,speed-grade = <1>;
        xlnx,static-config;
        xlnx,clk-mul-div = <12 1>, <10 2>, <8 1>, <6 1>, <4 2>, <2 1>;
    };
...
```

## Documentation/devicetree/bindings/display/xlnx/xlnx,dp-tx.yaml
```yaml
# SPDX-License-Identifier: GPL-2.0
%YAML 1.2
---
$id: http://devicetree.org/schemas/display/xlnx/xlnx,dp-tx.yaml#
$schema: http://devicetree.org/meta-schemas/core.yaml#

title: Xilinx DisplayPort Transmitter Subsystem

maintainers:
  - Rajesh Gugulothu <gugulothu.rajesh@xilinx.com>

description: |
  The Xilinx DisplayPort Tx Subsystem contains several subcores to implement
  a DisplayPort Transmitter and outputs video data using DisplayPort protocol.
  For more details, please refer to PG199 at
  https://www.xilinx.com/support/documentation/ip_documentation/dp_tx_subsystem/v2_1/pg199-displayport-tx-subsystem.pdf

properties:
  compatible:
    enum:
      - xlnx,v-dp-txss-3.0
      - xlnx,v-dp-txss-3.1
      - xlnx,v-dp-txss2-1.0
      - xlnx,v-dp-txss2-2.0

  reg:
    maxItems: 2
    description: DisplayPort Transmitter Subsystem registers

  reg-names:
    items:
      - const: dp_base
      - const: gt_quad_base

  interrupts:
    minItems: 1
    maxItems: 4

  interrupt-names:
    description: Only dptxss_dp_irq is mandatory. Others are optional.
                 dptxss_timer_irq will be present when HDCP 1x or 2x is selected.
                 dptxss_hdcp_irq will be present when HDCP 1x is selected.
                 dptxss_hdcp22_cipher_irq will be present when HDCP 2x is selected.
    items:
      - const: dptxss_dp_irq
      - const: dptxss_timer_irq
      - const: dptxss_hdcp_irq
      - const: dptxss_hdcp22_cipher_irq

  clocks:
    description: |
      Clock specifiers. Always the AXI-Lite clock and the stream-1 video
      clock; optionally the per-stream video clocks for streams 2..N.
    minItems: 2
    items:
      - description: AXI Lite clock (s_axi_aclk)
      - description: Stream-1 video clock
      - description: Stream-2 video clock
      - description: Stream-3 video clock
      - description: Stream-4 video clock

  clock-names:
    minItems: 2
    items:
      - const: s_axi_aclk
      - const: tx_vid_clk
      - const: tx_vid_clk_stream2
      - const: tx_vid_clk_stream3
      - const: tx_vid_clk_stream4

  phys:
    description: This denotes phandles for phy lanes registered
                 for DP protocol.DisplayPort always require 4 lanes

  phy-names:
    items:
      - const: dp-phy0
      - const: dp-phy1
      - const: dp-phy2
      - const: dp-phy3

  xlnx,vtc-offset:
    description: |
      Register offset address of the VTC sub-core(s) of the DisplayPort
      Transmitter Subsystem. Each stream is driven by its own VTC generator,
      so this must list one offset per stream, i.e. exactly xlnx,num-streams
      entries (a single entry for SST).
    $ref: /schemas/types.yaml#/definitions/uint32-array
    minItems: 1
    maxItems: 4

  xlnx,num-streams:
    description: |
      Number of video streams the IP drives. 1 (or the property being absent)
      selects Single-Stream Transport (SST); 2 to 4 enables Multi-Stream
      Transport (MST) with that many streams. One xlnx,vtc-offset entry is
      required per stream.
    allOf:
      - $ref: /schemas/types.yaml#/definitions/uint32
      - enum: [1, 2, 3, 4]
    default: 1

  xlnx,pixel-mode:
    description: |
      Number of pixels processed per video clock (PL pixel packing). MST pins
      the pixels-per-clock to this value. Defaults to 4 (quad-pixel) when
      absent.
    allOf:
      - $ref: /schemas/types.yaml#/definitions/uint32
      - enum: [1, 2, 4]
    default: 4

  xlnx,max-lanes:
    description: Max number of lanes that IP configured with.
                 Possible values are 1, 2, 4.
    allOf:
      - $ref: /schemas/types.yaml#/definitions/uint32
      - enum: [1, 2, 4]

  xlnx,max-link-rate:
    description: |
      Max link rate that IP configured with.Possible values are as below -
      162000 - 1.6 Gb/s
      270000 - 2.7 Gb/s
      540000 - 5.4 Gb/s
      810000 - 8.1 Gb/s
      1000000 - UHBR10 (DP2.1 128b/132b)
      1350000 - UHBR13.5 (DP2.1 128b/132b)
      2000000 - UHBR20 (DP2.1 128b/132b)
    allOf:
      - $ref: /schemas/types.yaml#/definitions/uint32
      - enum: [162000, 270000, 540000, 810000, 1000000, 1350000, 2000000]

  xlnx,bpc:
    description: |
      Max BPC value that IP configured with. For example if IP is configured
      with 10 BPC means it supports (6, 8, 10) up to 10bpc.
      Possible values are 6, 8, 10, 12, 16.
    allOf:
      - $ref: /schemas/types.yaml#/definitions/uint32
      - enum: [6, 8, 10, 12, 16]

  xlnx,audio-channels:
    description: |
      This denotes number of audio channels enabled in the IP
      configuration. Possible values are 2, 3, 4, 5, 6, 7, 8.
    allOf:
      - $ref: /schemas/types.yaml#/definitions/uint32
      - enum: [2, 3, 4, 5, 6, 7, 8]

  xlnx,hdcp22-enable:
    type: boolean
    description: |
      Present when HDCP2.2 is present in design.

  xlnx,hdcp-enable:
    type: boolean
    description: |
      Present when HDCP1.4 is present in design.

  xlnx,versal-gt:
    type: boolean
    description: |
      Boolean property present when versal GT is present in design.

  xlnx,xilinx-vfmc:
    description: phandle of xilinx video FMC node
    $ref: /schemas/types.yaml#/definitions/phandle

  ports:
    type: object
    $ref: /schemas/graph.yaml#/properties/ports

    patternProperties:
      "^port@[0-3]$":
        type: object
        description: |
          Output / source port node, endpoint describing modules
          connected the DisplayPort transmitter. One port per video stream
          (port@0 for SST; port@0..port@3 for MST, per xlnx,num-streams).

        properties:
          reg:
            minimum: 0
            maximum: 3

          endpoint:
            type: object

            properties:

              remote-endpoint: true

            required:
              - remote-endpoint

            additionalProperties: false

        additionalProperties: false
    unevaluatedProperties: false

required:
  - compatible
  - reg
  - reg-names
  - interrupts
  - clocks
  - clock-names
  - xlnx,max-link-rate
  - xlnx,bpc
  - xlnx,max-lanes
  - phy-names
  - phys
  - ports

additionalProperties: false

allOf:
  - if:
      properties:
        compatible:
          contains:
            enum:
              - xlnx,v-dp-txss-3.1
              - xlnx,v-dp-txss2-1.0
              - xlnx,v-dp-txss2-2.0
    then:
      required:
        - xlnx,vtc-offset

  # The v3.0 core has a single VTC and no per-stream offsets.
  - if:
      properties:
        compatible:
          contains:
            const: xlnx,v-dp-txss-3.0
    then:
      properties:
        xlnx,num-streams:
          const: 1

  # UHBR (128b/132b) rates are only available on the DP2.1 cores.
  - if:
      properties:
        compatible:
          contains:
            enum:
              - xlnx,v-dp-txss-3.0
              - xlnx,v-dp-txss-3.1
    then:
      properties:
        xlnx,max-link-rate:
          enum: [162000, 270000, 540000, 810000]

  # Exactly one xlnx,vtc-offset entry is required per stream.
  - if:
      not:
        required:
          - xlnx,num-streams
    then:
      properties:
        xlnx,vtc-offset:
          minItems: 1
          maxItems: 1
  - if:
      properties:
        xlnx,num-streams:
          const: 1
      required:
        - xlnx,num-streams
    then:
      properties:
        xlnx,vtc-offset:
          minItems: 1
          maxItems: 1
  - if:
      properties:
        xlnx,num-streams:
          const: 2
      required:
        - xlnx,num-streams
    then:
      properties:
        xlnx,vtc-offset:
          minItems: 2
          maxItems: 2
  - if:
      properties:
        xlnx,num-streams:
          const: 3
      required:
        - xlnx,num-streams
    then:
      properties:
        xlnx,vtc-offset:
          minItems: 3
          maxItems: 3
  - if:
      properties:
        xlnx,num-streams:
          const: 4
      required:
        - xlnx,num-streams
    then:
      properties:
        xlnx,vtc-offset:
          minItems: 4
          maxItems: 4

examples:
  - |
   bus {
       #address-cells = <2>;
       #size-cells = <2>;

       v-dp-txss1@a0100000 {
           compatible = "xlnx,v-dp-txss-3.1";
           reg = <0x0 0xa0100000 0x0 0x40000>, <0x0 0xa4080000 0x0 0x10000>;
           reg-names = "dp_base", "gt_quad_base";
           clock-names = "s_axi_aclk", "tx_vid_clk", "tx_vid_clk_stream2",
                         "tx_vid_clk_stream3", "tx_vid_clk_stream4";
           clocks = <&zynqmp_clk 71>, <&si570_1>, <&si570_2>, <&si570_3>,
                    <&si570_4>;
           interrupt-names = "dptxss_dp_irq", "dptxss_timer_irq", "dptxss_hdcp_irq",
                              "dptxss_hdcp22_cipher_irq";
           interrupts = <0 92 4>, <0 108 4>, <0 111 4>, <0 109 4>;
           xlnx,num-streams = <4>;
           xlnx,vtc-offset = <0x8000 0x9000 0xa000 0xb000>;
           xlnx,pixel-mode = <4>;
           xlnx,max-lanes = <4>;
           xlnx,max-link-rate = <810000>;
           xlnx,bpc = <8>;
           xlnx,audio-channels = <2>;
           xlnx,hdcp22-enable;
           xlnx,hdcp-enable;
           xlnx,versal-gt;
           xlnx,xilinx-vfmc = <&xfmc>;
           phy-names = "dp-phy0", "dp-phy1", "dp-phy2", "dp-phy3";
           phys = <&vphy_lane0 0 1 1 0>, <&vphy_lane1 0 1 1 0>,
                  <&vphy_lane2 0 1 1 0>, <&vphy_lane3 0 1 1 0>;

           ports {
               #address-cells = <1>;
               #size-cells = <0>;

               port@0 {
                   reg = <0>;
                   dp_transmitter0: endpoint {
                       remote-endpoint = <&display_controller0>;
                   };
               };
               port@1 {
                   reg = <1>;
                   dp_transmitter1: endpoint {
                       remote-endpoint = <&display_controller1>;
                   };
               };
               port@2 {
                   reg = <2>;
                   dp_transmitter2: endpoint {
                       remote-endpoint = <&display_controller2>;
                   };
               };
               port@3 {
                   reg = <3>;
                   dp_transmitter3: endpoint {
                       remote-endpoint = <&display_controller3>;
                   };
               };
           };
       };

       v-dp-txss2@b0100000 {
           compatible = "xlnx,v-dp-txss2-1.0";
           reg = <0x0 0xb0100000 0x0 0x40000>, <0x0 0xb4080000 0x0 0x10000>;
           reg-names = "dp_base", "gt_quad_base";
           clock-names = "s_axi_aclk", "tx_vid_clk";
           clocks = <&zynqmp_clk 71>, <&si570_2>;
           interrupt-names = "dptxss_dp_irq", "dptxss_timer_irq", "dptxss_hdcp_irq",
                              "dptxss_hdcp22_cipher_irq";
           interrupts = <0 93 4>, <0 110 4>, <0 112 4>, <0 113 4>;
           xlnx,vtc-offset = <0x8000>;
           xlnx,max-lanes = <4>;
           xlnx,max-link-rate = <1000000>;
           xlnx,bpc = <8>;
           phy-names = "dp-phy0", "dp-phy1", "dp-phy2", "dp-phy3";
           phys = <&vphy_lane4 0 1 1 0>, <&vphy_lane5 0 1 1 0>,
                  <&vphy_lane6 0 1 1 0>, <&vphy_lane7 0 1 1 0>;

           ports {
               #address-cells = <1>;
               #size-cells = <0>;

               port@0 {
                   reg = <0>;
                   dp_transmitter4: endpoint {
                       remote-endpoint = <&display_controller4>;
                   };
               };
           };
       };
   };
...
```
