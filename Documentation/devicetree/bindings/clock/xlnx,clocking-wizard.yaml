## Documentation/devicetree/bindings/misc/xlnx,sdi-fmc.yaml
```yaml
# SPDX-License-Identifier: (GPL-2.0-only OR BSD-2-Clause)
%YAML 1.2
---
$id: http://devicetree.org/schemas/misc/xlnx,sdi-fmc.yaml#
$schema: http://devicetree.org/meta-schemas/core.yaml#

title: Xilinx SDI FMC mezzanine

maintainers:
  - Katta Dhanunjanrao <katta.dhanunjanrao@amd.com>

description: |
  The Fidus/Zetta SDI FMC mezzanine conditions the physical SDI signal for the
  SMPTE UHD-SDI Tx and Rx subsystems on boards such as the VEK385.

  Per SDI channel it carries a MACOM reclocker, a cable driver and an
  equalizer, all on one SPI bus, plus a DS10CP15A clock crosspoint on I2C.  A
  GPIO selects which of the four physical channels is routed onto the SPI bus,
  and a second GPIO raises an "init-done" strobe when configuration completes.

  The parts are children of their respective controllers rather than of this
  node, because that is where they sit on the buses.  This node describes how
  they are wired together as one mezzanine and is what an SDI endpoint points
  at with its "xlnx,fmc" phandle.  One configuration pass programs the
  equalizer (Rx path), the cable driver (Tx path) and the reclocker (both), so
  a single node serves both directions.

properties:
  compatible:
    const: xlnx,sdi-fmc

  xlnx,xbar:
    $ref: /schemas/types.yaml#/definitions/phandle
    description: The DS10CP15A clock crosspoint on the I2C bus.

  xlnx,rclkr:
    $ref: /schemas/types.yaml#/definitions/phandle
    description: The MACOM reclocker on the SPI bus, used by both directions.

  xlnx,drvr:
    $ref: /schemas/types.yaml#/definitions/phandle
    description: The MACOM cable driver on the SPI bus, used by the Tx path.

  xlnx,rcvr:
    $ref: /schemas/types.yaml#/definitions/phandle
    description: The MACOM equalizer on the SPI bus, used by the Rx path.

  channel-gpios:
    description:
      The channel-select mux, least significant bit first, selecting which of
      the four physical SDI channels is presented on the SPI bus during
      configuration.
    minItems: 1
    maxItems: 2

  init-done-gpios:
    description:
      Strobe raised once every channel has been configured.
    maxItems: 1

required:
  - compatible
  - xlnx,xbar
  - xlnx,rclkr
  - xlnx,drvr
  - xlnx,rcvr

additionalProperties: false

examples:
  - |
    fmc_gpio: gpio-controller {
        gpio-controller;
        #gpio-cells = <2>;
    };

    i2c {
        #address-cells = <1>;
        #size-cells = <0>;

        xbar: clock-crosspoint@50 {
            compatible = "ti,ds10cp154";
            reg = <0x50>;
        };
    };

    spi {
        #address-cells = <1>;
        #size-cells = <0>;

        rclkr: reclocker@0 {
            compatible = "macom,m23145";
            reg = <0>;
            spi-max-frequency = <9300000>;
        };

        drvr: cable-driver@1 {
            compatible = "macom,m23428";
            reg = <1>;
            spi-max-frequency = <9300000>;
        };

        rcvr: equalizer@2 {
            compatible = "macom,m23554";
            reg = <2>;
            spi-max-frequency = <9300000>;
        };
    };

    sdi_fmc: sdi-fmc {
        compatible = "xlnx,sdi-fmc";
        xlnx,xbar = <&xbar>;
        xlnx,rclkr = <&rclkr>;
        xlnx,drvr = <&drvr>;
        xlnx,rcvr = <&rcvr>;
        channel-gpios = <&fmc_gpio 0 0>, <&fmc_gpio 1 0>;
        init-done-gpios = <&fmc_gpio 7 0>;
    };
...
```

## Documentation/devicetree/bindings/pci/amd,versal2-mdb-host.yaml
```yaml
# SPDX-License-Identifier: (GPL-2.0-only OR BSD-2-Clause)
%YAML 1.2
---
$id: http://devicetree.org/schemas/pci/amd,versal2-mdb-host.yaml#
$schema: http://devicetree.org/meta-schemas/core.yaml#

title: AMD Versal2 MDB(Multimedia DMA Bridge) Host Controller

maintainers:
  - Thippeswamy Havalige <thippeswamy.havalige@amd.com>

properties:
  compatible:
    enum:
      - amd,versal2-mdb-host
      - amd,versal2-cpm6-host
      - amd,versal2-cpm6-host1

  reg:
    minItems: 4
    items:
      - description: MDB System Level Control and Status Register (SLCR) Base
      - description: configuration region
      - description: data bus interface
      - description: address translation unit register
      - description: CPM6 PCIe error and event interrupt registers

  reg-names:
    minItems: 4
    items:
      - const: slcr
      - const: config
      - const: dbi
      - const: atu
      - const: intr

  ranges:
    maxItems: 2

  msi-map:
    maxItems: 1

  interrupts:
    maxItems: 1

  interrupt-map-mask:
    items:
      - const: 0
      - const: 0
      - const: 0
      - const: 7

  interrupt-map:
    maxItems: 4

  "#interrupt-cells":
    const: 1

  interrupt-controller:
    description: identifies the node as an interrupt controller
    type: object
    additionalProperties: false
    properties:
      interrupt-controller: true

      "#address-cells":
        const: 0

      "#interrupt-cells":
        const: 1

    required:
      - interrupt-controller
      - "#address-cells"
      - "#interrupt-cells"

patternProperties:
  '^pcie@[0-2],0$':
    type: object
    $ref: /schemas/pci/pci-pci-bridge.yaml#

    properties:
      reg:
        maxItems: 1

    unevaluatedProperties: false

required:
  - reg
  - reg-names
  - interrupts
  - interrupt-map
  - interrupt-map-mask
  - msi-map
  - "#interrupt-cells"
  - interrupt-controller

allOf:
  - $ref: /schemas/pci/pci-host-bridge.yaml#
  - $ref: /schemas/pci/snps,dw-pcie.yaml#
  - if:
      properties:
        compatible:
          contains:
            const: amd,versal2-mdb-host
    then:
      properties:
        reg:
          maxItems: 4
        reg-names:
          maxItems: 4
  - if:
      properties:
        compatible:
          contains:
            enum:
              - amd,versal2-cpm6-host
              - amd,versal2-cpm6-host1
    then:
      properties:
        reg:
          minItems: 5
        reg-names:
          minItems: 5

unevaluatedProperties: false

examples:
  - |
    #include <dt-bindings/interrupt-controller/arm-gic.h>
    #include <dt-bindings/interrupt-controller/irq.h>
    #include <dt-bindings/gpio/gpio.h>

    soc {
        #address-cells = <2>;
        #size-cells = <2>;
        pcie@ed931000 {
            compatible = "amd,versal2-mdb-host";
            reg = <0x0 0xed931000 0x0 0x2000>,
                  <0x1000 0x100000 0x0 0xff00000>,
                  <0x1000 0x0 0x0 0x1000>,
                  <0x0 0xed860000 0x0 0x2000>;
            reg-names = "slcr", "config", "dbi", "atu";
            ranges = <0x2000000 0x00 0xa0000000 0x00 0xa0000000 0x00 0x10000000>,
                     <0x43000000 0x1100 0x00 0x1100 0x00 0x00 0x1000000>;
            interrupts = <GIC_SPI 165 IRQ_TYPE_LEVEL_HIGH>;
            interrupt-parent = <&gic>;
            interrupt-map-mask = <0 0 0 7>;
            interrupt-map = <0 0 0 1 &pcie_intc_0 0>,
                            <0 0 0 2 &pcie_intc_0 1>,
                            <0 0 0 3 &pcie_intc_0 2>,
                            <0 0 0 4 &pcie_intc_0 3>;
            msi-map = <0x0 &gic_its 0x00 0x10000>;
            #address-cells = <3>;
            #size-cells = <2>;
            #interrupt-cells = <1>;
            device_type = "pci";

            pcie@0,0 {
                device_type = "pci";
                reg = <0x0 0x0 0x0 0x0 0x0>;
                reset-gpios = <&tca6416_u37 7 GPIO_ACTIVE_LOW>;
                #address-cells = <3>;
                #size-cells = <2>;
                ranges;
            };

            pcie_intc_0: interrupt-controller {
                #address-cells = <0>;
                #interrupt-cells = <1>;
                interrupt-controller;
            };
        };
    };
```
